AUTOSAR XML (schema 00049)
package /RB/UBK/Project/EcucModuleConfigurationValuess
  module config EcuC
    EcucPartitionCollection
      5 x EcucPartition:
        EcucPartition_OsApp_0_A_1: EcucPartitionSoftwareComponentInstanceRef=CPT_rba_OsArSchedExtn_OS, EcucPartitionSoftwareComponentInstanceRef=CPT_esc_stack, EcucPartitionSoftwareComponentInstanceRef=CPT_rba_OsArSchedExtn_mcop
        EcucPartition_OsApp_0_B_1: EcucPartitionSoftwareComponentInstanceRef=CPT_FiM, EcucPartitionSoftwareComponentInstanceRef=CPT_rba_OsArSchedExtn_OS, EcucPartitionSoftwareComponentInstanceRef=CPT_Dem, EcucPartitionSoftwareComponentInstanceRef=CPT_esc_stack, EcucPartitionSoftwareComponentInstanceRef=CPT_SWAdp, EcucPartitionSoftwareComponentInstanceRef=CPT_rba_OsArSchedExtn_mcop
        EcucPartition_OsApp_1_A_1: EcucPartitionSoftwareComponentInstanceRef=CPT_esc_stack, EcucPartitionSoftwareComponentInstanceRef=CPT_rba_OsArSchedExtn_mcop
        EcucPartition_OsApp_1_B_1: EcucPartitionSoftwareComponentInstanceRef=CPT_Dem, EcucPartitionSoftwareComponentInstanceRef=CPT_rba_SyC_States_Cfg_1_B_1, EcucPartitionSoftwareComponentInstanceRef=CPT_esc_stack, EcucPartitionSoftwareComponentInstanceRef=CPT_MoCCom_Co, EcucPartitionSoftwareComponentInstanceRef=Lvl2Data, EcucPartitionSoftwareComponentInstanceRef=EssOccptSenMgr
        EcucPartition_OsApp_2_Q_1: EcucPartitionSoftwareComponentInstanceRef=ShoRunrVlvActrCtrl, EcucPartitionSoftwareComponentInstanceRef=CPT_EGSHeatr_SnsrCoorn, EcucPartitionSoftwareComponentInstanceRef=FiveVoltOutpAdcInpSwc, EcucPartitionSoftwareComponentInstanceRef=SysSftyComAbORC, EcucPartitionSoftwareComponentInstanceRef=CPT_XcpAppl, EcucPartitionSoftwareComponentInstanceRef=GdiFuRailP1AdcInpSwc
