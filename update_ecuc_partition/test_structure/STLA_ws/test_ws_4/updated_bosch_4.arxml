AUTOSAR XML (schema 4-0-2)
package /RB/UBK/Project/EcucModuleConfigurationValuess
  module config EcuC
    EcucPartitionCollection
      EcucPartition_OsApp_1_B_1 (EcucPartition):
        EcucPartitionBswModuleExecution = false
        PartitionCanBeRestarted = false
        EcucPartitionSoftwareComponentInstanceRef = CPT_ComScl_NetMtrxTxAdapt
        EcucPartitionSoftwareComponentInstanceRef = CPT_Dem
        EcucPartitionSoftwareComponentInstanceRef = CPT_rba_SyC_States_Cfg_1_B_1
        EcucPartitionSoftwareComponentInstanceRef = CPT_esc_stack
        EcucPartitionSoftwareComponentInstanceRef = CPT_MoCCom_Co
        EcucPartitionSoftwareComponentInstanceRef = Lvl2Data
        EcucPartitionSoftwareComponentInstanceRef = EssOccptSenMgr
