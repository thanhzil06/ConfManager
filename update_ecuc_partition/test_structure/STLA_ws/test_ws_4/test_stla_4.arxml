AUTOSAR XML (schema 00049)
package /RB/UBK/Project/EcucModuleConfigurationValuess
  module config EcuC
    EcucPartitionCollection
      EcucPartition_OsApp_1_B_1 (EcucPartition):
        EcucPartitionSoftwareComponentInstanceRef = CPT_Dem
        EcucPartitionSoftwareComponentInstanceRef = CPT_rba_SyC_States_Cfg_1_B_1
        EcucPartitionSoftwareComponentInstanceRef = CPT_esc_stack
        EcucPartitionSoftwareComponentInstanceRef = CPT_MoCCom_Co
        EcucPartitionSoftwareComponentInstanceRef = Lvl2Data
        EcucPartitionSoftwareComponentInstanceRef = EssOccptSenMgr
