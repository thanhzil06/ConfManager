AUTOSAR XML (schema 4-0-2)
package /RB/UBK/Project/EcucModuleConfigurationValuess
  module config EcuC
    EcucPartitionCollection
      5 x EcucPartition, all with PartitionCanBeRestarted=false:
        EcucPartition_OsApp_0_A_1: EcucPartitionBswModuleExecution=false
        EcucPartition_OsApp_1_A_1: EcucPartitionBswModuleExecution=false
        EcucPartition_OsApp_0_B_1: EcucPartitionBswModuleExecution=false
        EcucPartition_OsApp_1_B_1: EcucPartitionBswModuleExecution=false, EcucPartitionSoftwareComponentInstanceRef=CPT_ComScl_NetMtrxTxAdapt
        EcucPartition_OsApp_2_Q_1: EcucPartitionBswModuleExecution=0, EcucPartitionSoftwareComponentInstanceRef=CPT_ComScl_NetMtrxTxAdapt, EcucPartitionSoftwareComponentInstanceRef=CPT_ComScl_EngLinTxAdapt
