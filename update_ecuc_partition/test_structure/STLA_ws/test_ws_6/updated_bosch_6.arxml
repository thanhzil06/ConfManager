AUTOSAR XML (schema 4-0-2)
package /RB/UBK/Project/EcucModuleConfigurationValuess
  module config EcuC
    EcucPartitionCollection
      EcucPartition_OsApp_1_A_1 (EcucPartition):
        EcucPartitionBswModuleExecution = false
        PartitionCanBeRestarted = false
        EcucPartitionSoftwareComponentInstanceRef = CPT_esc_stack
        EcucPartitionSoftwareComponentInstanceRef = CPT_rba_OsArSchedExtn_mcop
      EcucPartition_OsApp_1_B_1 (EcucPartition):
        EcucPartitionBswModuleExecution = false
        PartitionCanBeRestarted = false
        EcucPartitionSoftwareComponentInstanceRef = CPT_Dem
        EcucPartitionSoftwareComponentInstanceRef = EssOccptSenMgr
        EcucPartitionSoftwareComponentInstanceRef = CPT_ComScl_NetMtrxTxAdapt
