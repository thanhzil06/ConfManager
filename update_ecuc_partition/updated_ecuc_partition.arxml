AUTOSAR XML (schema 4-0-2)
package /RB/UBK/Project/EcucModuleConfigurationValuess
  module config EcuC
    EcucPartitionCollection
      5 x EcucPartition, all with PartitionCanBeRestarted=false:
        EcucPartition_OsApp_0_A_1: EcucPartitionBswModuleExecution=false, EcucPartitionSoftwareComponentInstanceRef=CPT_esc_stack, EcucPartitionSoftwareComponentInstanceRef=CPT_rba_OsArSchedExtn_OS, EcucPartitionSoftwareComponentInstanceRef=CPT_rba_OsArSchedExtn_mcop
        EcucPartition_OsApp_0_B_1: EcucPartitionBswModuleExecution=false, EcucPartitionSoftwareComponentInstanceRef=CPT_Dem, EcucPartitionSoftwareComponentInstanceRef=CPT_FiM, EcucPartitionSoftwareComponentInstanceRef=CPT_SWAdp, EcucPartitionSoftwareComponentInstanceRef=CPT_esc_stack, EcucPartitionSoftwareComponentInstanceRef=CPT_rba_OsArSchedExtn_OS, EcucPartitionSoftwareComponentInstanceRef=CPT_rba_OsArSchedExtn_mcop
        EcucPartition_OsApp_1_A_1: EcucPartitionBswModuleExecution=false, EcucPartitionSoftwareComponentInstanceRef=CPT_esc_stack, EcucPartitionSoftwareComponentInstanceRef=CPT_rba_OsArSchedExtn_mcop
        EcucPartition_OsApp_1_B_1: EcucPartitionBswModuleExecution=false, EcucPartitionSoftwareComponentInstanceRef=CPT_ComScl_NetMtrxTxAdapt, EcucPartitionSoftwareComponentInstanceRef=CPT_Dem, EcucPartitionSoftwareComponentInstanceRef=CPT_MoCCom_Co, EcucPartitionSoftwareComponentInstanceRef=CPT_esc_stack, EcucPartitionSoftwareComponentInstanceRef=CPT_rba_SyC_States_Cfg_1_B_1, EcucPartitionSoftwareComponentInstanceRef=EssOccptSenMgr, EcucPartitionSoftwareComponentInstanceRef=Lvl2Data
        EcucPartition_OsApp_2_Q_1: EcucPartitionBswModuleExecution=0, EcucPartitionSoftwareComponentInstanceRef=CPT_ComScl_EngLinTxAdapt, EcucPartitionSoftwareComponentInstanceRef=CPT_ComScl_NetMtrxTxAdapt, EcucPartitionSoftwareComponentInstanceRef=CPT_EGSHeatr_SnsrCoorn, EcucPartitionSoftwareComponentInstanceRef=CPT_XcpAppl, EcucPartitionSoftwareComponentInstanceRef=FiveVoltOutpAdcInpSwc, EcucPartitionSoftwareComponentInstanceRef=GdiFuRailP1AdcInpSwc, EcucPartitionSoftwareComponentInstanceRef=ShoRunrVlvActrCtrl, EcucPartitionSoftwareComponentInstanceRef=SysSftyComAbORC
