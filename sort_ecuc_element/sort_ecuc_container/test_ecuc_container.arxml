AUTOSAR XML (schema 4-2-2)
package /RB/UBK/Project/EcucModuleConfigurationValuess
  module config EcuC
    EcucPartitionCollection
      7 x EcucPartition:
        BTestA: EcucPartitionBswModuleExecution=false, PartitionCanBeRestarted=false
        ATestB: PartitionCanBeRestarted=false
        ATestA: EcucPartitionBswModuleExecution=false
        CTestD
        EcucPartition_OsApp_1_B_1: EcucPartitionBswModuleExecution=false, PartitionCanBeRestarted=false
        EcucPartition_OsApp_2_Q_1: EcucPartitionBswModuleExecution=false, PartitionCanBeRestarted=false, EcucPartitionSoftwareComponentInstanceRef=CPT_ComScl_NetMtrxTxAdapt
        EcucPartition_OsApp_0_B_1: EcucPartitionBswModuleExecution=0, PartitionCanBeRestarted=false, EcucPartitionSoftwareComponentInstanceRef=CPT_ComScl_NetMtrxTxAdapt, EcucPartitionSoftwareComponentInstanceRef=CPT_ComScl_EngLinTxAdapt
