AUTOSAR XML (schema 4-0-2)
package /RB/UBK/Project/EcucModuleConfigurationValuess
  module config EcuC
    EcucPartitionCollection
      EcucPartition_OsApp_0_A_1 (EcucPartition):
        PartitionCanBeRestarted = false
        EcucPartitionBswModuleExecution = 1
        EcucPartitionSoftwareComponentInstanceRef = CPT_ComScl_EngLin_Scl
        EcucPartitionSoftwareComponentInstanceRef = CPT_ComScl_NetMtrx0_Scl
        EcucPartitionSoftwareComponentInstanceRef = CPT_ComScl_NetMtrx1_Scl
        EcucPartitionSoftwareComponentInstanceRef = CPT_ComScl_NetMtrxTxAdapt
        EcucPartitionSoftwareComponentInstanceRef = CPT_SWC_VcodProxi
      EcucPartition_OsApp_1_A_1 (EcucPartition):
        EcucPartitionBswModuleExecution = 0
        PartitionCanBeRestarted = false
        EcucPartitionSoftwareComponentInstanceRef = CPT_ComScl_AngLinTxAdapt
        EcucPartitionSoftwareComponentInstanceRef = CPT_ComScl_BetMtrxTxAdapt
