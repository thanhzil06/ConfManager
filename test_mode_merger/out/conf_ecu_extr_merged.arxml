[part 1 of 2: package /RB/PT/PCFG_ECU]
AUTOSAR XML (schema 4-3-0)
package /RB/PT/PCFG_ECU
  system MDG1_EXTR: category=ECU_EXTRACT, ecu-extract-version=1.0.0, system-version=1.0.0
    system mapping SYSMPG_MDG1
      data-mappings:
        sender-receiver-to-signal-group-mapping={data-element=CPT_MDG1_FlatView.Lvl2DataTxSignals.Lvl2SftyComTX_AXLE_TORQUE_FD_1_FD14_Pkt, signal-group=SystemSignalGroup_COM_Tx_AXLE_TORQUE_FD_1_FD14_Pkt, type-mapping=sender-rec-record-type-mapping=record-element-mappings=[{implementation-record-element=CRC_AXLE_TORQUE_FD_1, system-signal=SystemSignal_COM_Tx_CRC_AXLE_TORQUE_FD_1_FD14}, {implementation-record-element=MessageCounter_AXLE_TORQUE_FD_1, system-signal=SystemSignal_COM_Tx_MessageCounter_AXLE_TORQUE_FD_1_FD14}, {implementation-record-element=Rear_Axle_Regen_Capacity, system-signal=SystemSignal_COM_Tx_Rear_Axle_Regen_Capacity_FD14}, {implementation-record-element=Rear_Axle_Est_Regen_Torq, system-signal=SystemSignal_COM_Tx_Rear_Axle_Est_Regen_Torq_FD14}, {implementation-record-element=Front_Axle_Regen_Capacity, system-signal=SystemSignal_COM_Tx_Front_Axle_Regen_Capacity_FD14}, {implementation-record-element=Front_Axle_Est_Regen_Torq, system-signal=SystemSignal_COM_Tx_Front_Axle_Est_Regen_Torq_FD14}, {implementation-record-element=Rear_AxleTorque_Min, system-signal=SystemSignal_COM_Tx_Rear_AxleTorque_Min_FD14}, {implementation-record-element=Rear_AxleTorque_Max, system-signal=SystemSignal_COM_Tx_Rear_AxleTorque_Max_FD14}, {implementation-record-element=Front_AxleTorque_Min, system-signal=SystemSignal_COM_Tx_Front_AxleTorque_Min_FD14}, {implementation-record-element=Front_AxleTorque_Max, system-signal=SystemSignal_COM_Tx_Front_AxleTorque_Max_FD14}, {implementation-record-element=Axle_Torque_DrvReqMod, system-signal=SystemSignal_COM_Tx_Axle_Torque_DrvReqMod_FD14}, {implementation-record-element=Axle_TorqueStatic_D_TTC, system-signal=SystemSignal_COM_Tx_Axle_TorqueStatic_D_TTC_FD14}, {implementation-record-element=Total_AxleTorque_Min, system-signal=SystemSignal_COM_Tx_Total_AxleTorque_Min_FD14}, {implementation-record-element=Total_AxleTorque_Max, system-signal=SystemSignal_COM_Tx_Total_AxleTorque_Max_FD14}]}
        sender-receiver-to-signal-group-mapping={data-element=CPT_MDG1_FlatView.Lvl2DataTxSignals.Lvl2SftyComTX_ENGINE_FD_2_FD14_Pkt, signal-group=SystemSignalGroup_COM_Tx_ENGINE_FD_2_FD14_Pkt, type-mapping=sender-rec-record-type-mapping=record-element-mappings=[{implementation-record-element=EngineSpeed_W, system-signal=SystemSignal_COM_Tx_EngineSpeed_W_FD14}, {implementation-record-element=EngineSts_W, system-signal=SystemSignal_COM_Tx_EngineSts_W_FD14}, {implementation-record-element=GasPedalPosition_W, system-signal=SystemSignal_COM_Tx_GasPedalPosition_W_FD14}, {implementation-record-element=GasPedalPositionFailSts_W, system-signal=SystemSignal_COM_Tx_GasPedalPositionFailSts_W_FD14}, {implementation-record-element=ESS_ENG_ST_W, system-signal=SystemSignal_COM_Tx_ESS_ENG_ST_W_FD14}, {implementation-record-element=LV12PwrFreeRq_W, system-signal=SystemSignal_COM_Tx_LV12PwrFreeRq_W_FD14}, {implementation-record-element=PowertrainPrplsnActv, system-signal=SystemSignal_COM_Tx_PowertrainPrplsnActv_FD14}, {implementation-record-element=FeedbackASR_ESCReq_W, system-signal=SystemSignal_COM_Tx_FeedbackASR_ESCReq_W_FD14}, {implementation-record-element=ECM_LHOM_W, system-signal=SystemSignal_COM_Tx_ECM_LHOM_W_FD14}, {implementation-record-element=MessageCounter_ENGINE2, system-signal=SystemSignal_COM_Tx_MessageCounter_ENGINE2_FD14}, {implementation-record-element=CRC_ENGINE2, system-signal=SystemSignal_COM_Tx_CRC_ENGINE2_FD14}]}
        sender-receiver-to-signal-group-mapping={data-element=CPT_MDG1_FlatView.Lvl2DataTxSignals.Lvl2SftyComTX_ENGINE_FD_2_FD16_Pkt, signal-group=SystemSignalGroup_COM_Tx_ENGINE_FD_2_FD16_Pkt, type-mapping=sender-rec-record-type-mapping=record-element-mappings=[{implementation-record-element=EngineSpeed_W, system-signal=SystemSignal_COM_Tx_EngineSpeed_W}, {implementation-record-element=CompressionTest, system-signal=SystemSignal_COM_Tx_CompressionTest}, {implementation-record-element=EssEngStrtIsNotAllwd, system-signal=SystemSignal_COM_Tx_EssEngStrtIsNotAllwd}, {implementation-record-element=EngineIdleRefSpeed, system-signal=SystemSignal_COM_Tx_ENGINE_FD_2_FD16_EngineIdleRefSpeed}, {implementation-record-element=EssEngStopIsNotAllwdID, system-signal=SystemSignal_COM_Tx_EssEngStopIsNotAllwdID}, {implementation-record-element=EssEngStrtIsNotAllwdID, system-signal=SystemSignal_COM_Tx_EssEngStrtIsNotAllwdID}, {implementation-record-element=TRANS_CLU_SLIP_MODE_W, system-signal=SystemSignal_COM_Tx_ENGINE_FD_2_FD16_TRANS_CLU_SLIP_MODE_W}, {implementation-record-element=EngineSts_W, system-signal=SystemSignal_COM_Tx_EngineSts_W}, {implementation-record-element=ESS_RqShftPark_W, system-signal=SystemSignal_COM_Tx_ENGINE_FD_2_FD16_ESS_RqShftPark_W}, {implementation-record-element=ECM_LHOM_Trans_W, system-signal=SystemSignal_COM_Tx_ENGINE_FD_2_FD16_ECM_LHOM_Trans_W}, {implementation-record-element=EngineFrictionTorque_W, system-signal=SystemSignal_COM_Tx_ENGINE_FD_2_FD16_EngineFrictionTorque_W}, {implementation-record-element=GasPedalPosition_W, system-signal=SystemSignal_COM_Tx_GasPedalPosition_W}, {implementation-record-element=IntakeAirTemperature_W, system-signal=SystemSignal_COM_Tx_ENGINE_FD_2_FD16_IntakeAirTemperature_W}, {implementation-record-element=EngineSpeedFailSts_W, system-signal=SystemSignal_COM_Tx_ENGINE_FD_2_FD16_EngineSpeedFailSts_W}, {implementation-record-element=GasPedalPositionFailSts_W, system-signal=SystemSignal_COM_Tx_GasPedalPositionFailSts_W}, {implementation-record-element=ESS_ENG_ST_W, system-signal=SystemSignal_COM_Tx_ESS_ENG_ST_W}, {implementation-record-element=LV12PwrFreeRq_W, system-signal=SystemSignal_COM_Tx_LV12PwrFreeRq_W}, {implementation-record-element=EngTrq_Enbl_Rq_TCM_W, system-signal=SystemSignal_COM_Tx_ENGINE_FD_2_FD16_EngTrq_Enbl_Rq_TCM_W}, {implementation-record-element=CrankHold_W, system-signal=SystemSignal_COM_Tx_ENGINE_FD_2_FD16_CrankHold_W}, {implementation-record-element=PowertrainPrplsnActv, system-signal=SystemSignal_COM_Tx_PowertrainPrplsnActv}, {implementation-record-element=KickDownRequest_W, system-signal=SystemSignal_COM_Tx_ENGINE_FD_2_FD16_KickDownRequest_W}, {implementation-record-element=ECM_LHOM_W, system-signal=SystemSignal_COM_Tx_ECM_LHOM_W}, {implementation-record-element=TxAC_EMCC_rq_W, system-signal=SystemSignal_COM_Tx_ENGINE_FD_2_FD16_TxAC_EMCC_rq_W}, {implementation-record-element=Engine_Stall_Detected, system-signal=SystemSignal_COM_Tx_ENGINE_FD_2_FD16_Engine_Stall_Detected}, {implementation-record-element=EssEngSt, system-signal=SystemSignal_COM_Tx_EssEngSt}, {implementation-record-element=EssEngModReq, system-signal=SystemSignal_COM_Tx_EssEngModReq}, {implementation-record-element=EssEngStopIsNotAllwd, system-signal=SystemSignal_COM_Tx_EssEngStopIsNotAllwd}, {implementation-record-element=ESS_EBOOST_BRKHLD_STATUS, system-signal=SystemSignal_COM_Tx_ENGINE_FD_2_FD16_ESS_EBOOST_BRKHLD_STATUS}, {implementation-record-element=MessageCounter_ENGINE2, system-signal=SystemSignal_COM_Tx_MessageCounter_ENGINE2}, {implementation-record-element=CRC_ENGINE2, system-signal=SystemSignal_COM_Tx_CRC_ENGINE2}]}
        sender-receiver-to-signal-group-mapping={data-element=CPT_MDG1_FlatView.Lvl2DataTxSignals.Lvl2SftyComTX_AXLE_TORQUE_FD_1_FD3_Pkt, signal-group=SystemSignalGroup_COM_Tx_AXLE_TORQUE_FD_1_FD3_Pkt, type-mapping=sender-rec-record-type-mapping=record-element-mappings=[{implementation-record-element=Total_AxleTorque_Max, system-signal=SystemSignal_COM_Tx_Total_AxleTorque_Max_FD3}, {implementation-record-element=Total_AxleTorque_Min, system-signal=SystemSignal_COM_Tx_Total_AxleTorque_Min_FD3}, {implementation-record-element=Axle_TorqueStatic_D_TTC, system-signal=SystemSignal_COM_Tx_Axle_TorqueStatic_D_TTC_FD3}, {implementation-record-element=Axle_Torque_DrvReqMod, system-signal=SystemSignal_COM_Tx_Axle_Torque_DrvReqMod_FD3}, {implementation-record-element=Front_AxleTorque_Max, system-signal=SystemSignal_COM_Tx_Front_AxleTorque_Max_FD3}, {implementation-record-element=Front_AxleTorque_Min, system-signal=SystemSignal_COM_Tx_Front_AxleTorque_Min_FD3}, {implementation-record-element=Rear_AxleTorque_Max, system-signal=SystemSignal_COM_Tx_Rear_AxleTorque_Max_FD3}, {implementation-record-element=Rear_AxleTorque_Min, system-signal=SystemSignal_COM_Tx_Rear_AxleTorque_Min_FD3}, {implementation-record-element=MaxRegen_Diff_Axle_Torq_Active, system-signal=SystemSignal_COM_Tx_MaxRegen_Diff_Axle_Torq_Active}, {implementation-record-element=MaxRegen_Diff_Axle_Torq, system-signal=SystemSignal_COM_Tx_MaxRegen_Diff_Axle_Torq}, {implementation-record-element=Front_Axle_Est_Regen_Torq, system-signal=SystemSignal_COM_Tx_Front_Axle_Est_Regen_Torq_FD3}, {implementation-record-element=Front_Axle_Regen_Capacity, system-signal=SystemSignal_COM_Tx_Front_Axle_Regen_Capacity_FD3}, {implementation-record-element=Rear_Axle_Est_Regen_Torq, system-signal=SystemSignal_COM_Tx_Rear_Axle_Est_Regen_Torq_FD3}, {implementation-record-element=Rear_Axle_Regen_Capacity, system-signal=SystemSignal_COM_Tx_Rear_Axle_Regen_Capacity_FD3}, {implementation-record-element=MessageCounter_AXLE_TORQUE_FD_1, system-signal=SystemSignal_COM_Tx_MessageCounter_AXLE_TORQUE_FD_1_FD3}, {implementation-record-element=CRC_AXLE_TORQUE_FD_1, system-signal=SystemSignal_COM_Tx_CRC_AXLE_TORQUE_FD_1_FD3}]}
        sender-receiver-to-signal-group-mapping={data-element=CPT_MDG1_FlatView.Lvl2DataTxSignals.Lvl2SftyComTX_ENGINE_FD_2_FD3_Pkt, signal-group=SystemSignalGroup_COM_Tx_ENGINE_FD_2_FD3_Pkt, type-mapping=sender-rec-record-type-mapping=record-element-mappings=[{implementation-record-element=EngRPM_Tach, system-signal=SystemSignal_COM_Tx_EngRPM_Tach}, {implementation-record-element=ECM_IMMO_STAT_CANC_W, system-signal=SystemSignal_COM_Tx_ECM_IMMO_STAT_CANC_W}, {implementation-record-element=EngineSpeed_W, system-signal=SystemSignal_COM_Tx_EngineSpeed_W_FD3}, {implementation-record-element=EngineIdleRefSpeed, system-signal=SystemSignal_COM_Tx_ENGINE_FD_2_FD3_EngineIdleRefSpeed}, {implementation-record-element=ECM_Ack_DriveMode, system-signal=SystemSignal_COM_Tx_ECM_Ack_DriveMode}, {implementation-record-element=TRANS_CLU_SLIP_MODE_W, system-signal=SystemSignal_COM_Tx_ENGINE_FD_2_FD3_TRANS_CLU_SLIP_MODE_W}, {implementation-record-element=EngineSts_W, system-signal=SystemSignal_COM_Tx_EngineSts_W_FD3}, {implementation-record-element=AlternatorFail_W, system-signal=SystemSignal_COM_Tx_AlternatorFail_W}, {implementation-record-element=ESS_RqShftPark_W, system-signal=SystemSignal_COM_Tx_ENGINE_FD_2_FD3_ESS_RqShftPark_W}, {implementation-record-element=ECM_LHOM_Trans_W, system-signal=SystemSignal_COM_Tx_ENGINE_FD_2_FD3_ECM_LHOM_Trans_W}, {implementation-record-element=EngineFrictionTorque_W, system-signal=SystemSignal_COM_Tx_ENGINE_FD_2_FD3_EngineFrictionTorque_W}, {implementation-record-element=EVRDesiredSetpoint, system-signal=SystemSignal_COM_Tx_EVRDesiredSetpoint}, {implementation-record-element=GasPedalPosition_W, system-signal=SystemSignal_COM_Tx_GasPedalPosition_W_FD3}, {implementation-record-element=IntakeAirTemperature_W, system-signal=SystemSignal_COM_Tx_ENGINE_FD_2_FD3_IntakeAirTemperature_W}, {implementation-record-element=GasPedalGradient_W, system-signal=SystemSignal_COM_Tx_GasPedalGradient_W}, {implementation-record-element=EngineSpeedFailSts_W, system-signal=SystemSignal_COM_Tx_ENGINE_FD_2_FD3_EngineSpeedFailSts_W}, {implementation-record-element=GasPedalPositionFailSts_W, system-signal=SystemSignal_COM_Tx_GasPedalPositionFailSts_W_FD3}, {implementation-record-element=ECM_AllwEV_W, system-signal=SystemSignal_COM_Tx_ECM_AllwEV_W}, {implementation-record-element=ESS_ENG_ST_W, system-signal=SystemSignal_COM_Tx_ESS_ENG_ST_W_FD3}, {implementation-record-element=LV12PwrFreeRq_W, system-signal=SystemSignal_COM_Tx_LV12PwrFreeRq_W_FD3}, {implementation-record-element=EngTrq_Enbl_Rq_TCM_W, system-signal=SystemSignal_COM_Tx_ENGINE_FD_2_FD3_EngTrq_Enbl_Rq_TCM_W}, {implementation-record-element=CrankHold_W, system-signal=SystemSignal_COM_Tx_ENGINE_FD_2_FD3_CrankHold_W}, {implementation-record-element=PowertrainPrplsnActv, system-signal=SystemSignal_COM_Tx_PowertrainPrplsnActv_FD3}, {implementation-record-element=KickDownRequest_W, system-signal=SystemSignal_COM_Tx_ENGINE_FD_2_FD3_KickDownRequest_W}, {implementation-record-element=FullOFC_Actv, system-signal=SystemSignal_COM_Tx_FullOFC_Actv}, {implementation-record-element=EngineSailingRq, system-signal=SystemSignal_COM_Tx_EngineSailingRq}, {implementation-record-element=FeedbackASR_ESCReq_W, system-signal=SystemSignal_COM_Tx_FeedbackASR_ESCReq_W_FD3}, {implementation-record-element=StartRelayBCMCmd_W, system-signal=SystemSignal_COM_Tx_StartRelayBCMCmd_W}, {implementation-record-element=ECM_LHOM_W, system-signal=SystemSignal_COM_Tx_ECM_LHOM_W_FD3}, {implementation-record-element=TxAC_EMCC_rq_W, system-signal=SystemSignal_COM_Tx_ENGINE_FD_2_FD3_TxAC_EMCC_rq_W}, {implementation-record-element=Engine_Stall_Detected, system-signal=SystemSignal_COM_Tx_ENGINE_FD_2_FD3_Engine_Stall_Detected}, {implementation-record-element=FuelConsumption_GAG_3, system-signal=SystemSignal_COM_Tx_FuelConsumption_GAG_3}, {implementation-record-element=ESS_EBOOST_BRKHLD_STATUS, system-signal=SystemSignal_COM_Tx_ENGINE_FD_2_FD3_ESS_EBOOST_BRKHLD_STATUS}, {implementation-record-element=EngTrqTgt_SEM, system-signal=SystemSignal_COM_Tx_EngTrqTgt_SEM}, {implementation-record-element=MessageCounter_ENGINE2, system-signal=SystemSignal_COM_Tx_MessageCounter_ENGINE2_FD3}, {implementation-record-element=ECM_ParkSL_Status, system-signal=SystemSignal_COM_Tx_ECM_ParkSL_Status}, {implementation-record-element=CRC_ENGINE2, system-signal=SystemSignal_COM_Tx_CRC_ENGINE2_FD3}]}
        sender-receiver-to-signal-group-mapping={data-element=CPT_MDG1_FlatView.Lvl2DataTxSignals.Lvl2SftyComTX_ENGINE_FD_5_FD14_Pkt, signal-group=SystemSignalGroup_COM_Tx_ENGINE_FD_5_FD14_Pkt, type-mapping=sender-rec-record-type-mapping=record-element-mappings=[{implementation-record-element=PdlPosActual, system-signal=SystemSignal_COM_Tx_PdlPosActual_FD14}, {implementation-record-element=EngTrqEnblRq_DAS_W, system-signal=SystemSignal_COM_Tx_EngTrqEnblRq_DAS_W_FD14}, {implementation-record-element=RPMOverRev_W, system-signal=SystemSignal_COM_Tx_RPMOverRev_W_FD14}, {implementation-record-element=MessageCounter_ENGINE5, system-signal=SystemSignal_COM_Tx_MessageCounter_ENGINE5_FD14}, {implementation-record-element=CRC_ENGINE5, system-signal=SystemSignal_COM_Tx_CRC_ENGINE5_FD14}]}
        sender-receiver-to-signal-group-mapping={data-element=CPT_MDG1_FlatView.Lvl2DataTxSignals.Lvl2SftyComTX_ENGINE_FD_5_FD16_Pkt, signal-group=SystemSignalGroup_COM_Tx_ENGINE_FD_5_FD16_Pkt, type-mapping=sender-rec-record-type-mapping=record-element-mappings=[{implementation-record-element=RPMOverRev_W, system-signal=SystemSignal_COM_Tx_RPMOverRev_W}, {implementation-record-element=EngineReadyForESS_W, system-signal=SystemSignal_COM_Tx_ENGINE_FD_5_FD16_EngineReadyForESS_W}, {implementation-record-element=EngTrqMaxCorrFctr_W, system-signal=SystemSignal_COM_Tx_ENGINE_FD_5_FD16_EngTrqMaxCorrFctr_W}, {implementation-record-element=GrMax_Rq_ECM_W, system-signal=SystemSignal_COM_Tx_ENGINE_FD_5_FD16_GrMax_Rq_ECM_W}, {implementation-record-element=GrMin_Rq_ECM_W, system-signal=SystemSignal_COM_Tx_ENGINE_FD_5_FD16_GrMin_Rq_ECM_W}, {implementation-record-element=ECM_READINESS_RESET_W, system-signal=SystemSignal_COM_Tx_ENGINE_FD_5_FD16_ECM_READINESS_RESET_W}, {implementation-record-element=ECM_CODE_CLR_W, system-signal=SystemSignal_COM_Tx_ENGINE_FD_5_FD16_ECM_CODE_CLR_W}, {implementation-record-element=MessageCounter_ENGINE5, system-signal=SystemSignal_COM_Tx_MessageCounter_ENGINE5}, {implementation-record-element=CRC_ENGINE5, system-signal=SystemSignal_COM_Tx_CRC_ENGINE5}]}
        sender-receiver-to-signal-group-mapping={data-element=CPT_MDG1_FlatView.Lvl2DataTxSignals.Lvl2SftyComTX_ENGINE_FD_5_FD3_Pkt, signal-group=SystemSignalGroup_COM_Tx_ENGINE_FD_5_FD3_Pkt, type-mapping=sender-rec-record-type-mapping=record-element-mappings=[{implementation-record-element=LTR_CoolantTemp, system-signal=SystemSignal_COM_Tx_LTR_CoolantTemp}, {implementation-record-element=PdlPosActual, system-signal=SystemSignal_COM_Tx_PdlPosActual_FD3}, {implementation-record-element=EngTrqEnblRq_DAS_W, system-signal=SystemSignal_COM_Tx_EngTrqEnblRq_DAS_W_FD3}, {implementation-record-element=RPMOverRev_W, system-signal=SystemSignal_COM_Tx_RPMOverRev_W_FD3}, {implementation-record-element=EngineReadyForESS_W, system-signal=SystemSignal_COM_Tx_ENGINE_FD_5_FD3_EngineReadyForESS_W}, {implementation-record-element=EngTrqMaxCorrFctr_W, system-signal=SystemSignal_COM_Tx_ENGINE_FD_5_FD3_EngTrqMaxCorrFctr_W}, {implementation-record-element=RaceModeSts_ECM, system-signal=SystemSignal_COM_Tx_RaceModeSts_ECM}, {implementation-record-element=GrMax_Rq_ECM_W, system-signal=SystemSignal_COM_Tx_ENGINE_FD_5_FD3_GrMax_Rq_ECM_W}, {implementation-record-element=GrMin_Rq_ECM_W, system-signal=SystemSignal_COM_Tx_ENGINE_FD_5_FD3_GrMin_Rq_ECM_W}, {implementation-record-element=ECM_READINESS_RESET_W, system-signal=SystemSignal_COM_Tx_ENGINE_FD_5_FD3_ECM_READINESS_RESET_W}, {implementation-record-element=ECM_CODE_CLR_W, system-signal=SystemSignal_COM_Tx_ENGINE_FD_5_FD3_ECM_CODE_CLR_W}, {implementation-record-element=IntkAirTempIntrClr, system-signal=SystemSignal_COM_Tx_IntkAirTempIntrClr}, {implementation-record-element=AirFuelRatio, system-signal=SystemSignal_COM_Tx_AirFuelRatio}, {implementation-record-element=MessageCounter_ENGINE5, system-signal=SystemSignal_COM_Tx_MessageCounter_ENGINE5_FD3}, {implementation-record-element=Prplsn_Raceoptions_Status_ECM, system-signal=SystemSignal_COM_Tx_Prplsn_Raceoptions_Status_ECM}, {implementation-record-element=CRC_ENGINE5, system-signal=SystemSignal_COM_Tx_CRC_ENGINE5_FD3}]}
        sender-receiver-to-signal-group-mapping={data-element=CPT_MDG1_FlatView.Lvl2DataTxSignals.Lvl2SftyComTX_ENGINE_HYBD_FD_1_FD16_Pkt, signal-group=SystemSignalGroup_COM_Tx_ENGINE_HYBD_FD_1_FD16_Pkt, type-mapping=sender-rec-record-type-mapping=record-element-mappings=[{implementation-record-element=EngMinSparkNomCurrAirTorqCap, system-signal=SystemSignal_COM_Tx_ENGINE_HYBD_FD_1_FD16_EngMinSparkNomCurrAirTorqCap}, {implementation-record-element=EngActuatorsStat, system-signal=SystemSignal_COM_Tx_ENGINE_HYBD_FD_1_FD16_EngActuatorsStat}, {implementation-record-element=HybActEngTorqRespTyp, system-signal=SystemSignal_COM_Tx_ENGINE_HYBD_FD_1_FD16_HybActEngTorqRespTyp}, {implementation-record-element=MaxOffEngTorqCap, system-signal=SystemSignal_COM_Tx_ENGINE_HYBD_FD_1_FD16_MaxOffEngTorqCap}, {implementation-record-element=MaxPrdtdEngTorqCap, system-signal=SystemSignal_COM_Tx_ENGINE_HYBD_FD_1_FD16_MaxPrdtdEngTorqCap}, {implementation-record-element=MinEngTorqCapV, system-signal=SystemSignal_COM_Tx_ENGINE_HYBD_FD_1_FD16_MinEngTorqCapV}, {implementation-record-element=MinAirFlowMinSparkTorqCapV, system-signal=SystemSignal_COM_Tx_ENGINE_HYBD_FD_1_FD16_MinAirFlowMinSparkTorqCapV}, {implementation-record-element=MaxPrdtdEngTorqCapV, system-signal=SystemSignal_COM_Tx_ENGINE_HYBD_FD_1_FD16_MaxPrdtdEngTorqCapV}, {implementation-record-element=MinAirFlowMinSparkTorqCap, system-signal=SystemSignal_COM_Tx_ENGINE_HYBD_FD_1_FD16_MinAirFlowMinSparkTorqCap}, {implementation-record-element=MinPrdtdEngRunTorqCapV, system-signal=SystemSignal_COM_Tx_ENGINE_HYBD_FD_1_FD16_MinPrdtdEngRunTorqCapV}, {implementation-record-element=MinImmedEngTorqCapV, system-signal=SystemSignal_COM_Tx_ENGINE_HYBD_FD_1_FD16_MinImmedEngTorqCapV}, {implementation-record-element=MinEngTorqCap, system-signal=SystemSignal_COM_Tx_ENGINE_HYBD_FD_1_FD16_MinEngTorqCap}, {implementation-record-element=MinImmedEngTorqCap, system-signal=SystemSignal_COM_Tx_ENGINE_HYBD_FD_1_FD16_MinImmedEngTorqCap}, {implementation-record-element=MinPrdtdEngRunTorqCap, system-signal=SystemSignal_COM_Tx_ENGINE_HYBD_FD_1_FD16_MinPrdtdEngRunTorqCap}, {implementation-record-element=EngAirFlwStdyStTorqV, system-signal=SystemSignal_COM_Tx_ENGINE_HYBD_FD_1_FD16_EngAirFlwStdyStTorqV}, {implementation-record-element=EngActStdyStTorqV, system-signal=SystemSignal_COM_Tx_ENGINE_HYBD_FD_1_FD16_EngActStdyStTorqV}, {implementation-record-element=EngActStdyStTorq, system-signal=SystemSignal_COM_Tx_ENGINE_HYBD_FD_1_FD16_EngActStdyStTorq}, {implementation-record-element=EngAirFlwStdyStTorq, system-signal=SystemSignal_COM_Tx_ENGINE_HYBD_FD_1_FD16_EngAirFlwStdyStTorq}, {implementation-record-element=Feedback_HCP, system-signal=SystemSignal_COM_Tx_ENGINE_HYBD_FD_1_FD16_Feedback_HCP}, {implementation-record-element=EngRunCrnkAct, system-signal=SystemSignal_COM_Tx_ENGINE_HYBD_FD_1_FD16_EngRunCrnkAct}, {implementation-record-element=RedSpkAuthorityAvbl, system-signal=SystemSignal_COM_Tx_ENGINE_HYBD_FD_1_FD16_RedSpkAuthorityAvbl}, {implementation-record-element=Sum_FW_ID_Slw, system-signal=SystemSignal_COM_Tx_ENGINE_HYBD_FD_1_FD16_Sum_FW_ID_Slw}, {implementation-record-element=EngTrqReserveReq, system-signal=SystemSignal_COM_Tx_ENGINE_HYBD_FD_1_FD16_EngTrqReserveReq}, {implementation-record-element=ETRQ_Mode, system-signal=SystemSignal_COM_Tx_ENGINE_HYBD_FD_1_FD16_ETRQ_Mode}, {implementation-record-element=Sum_FW_ID_Fst, system-signal=SystemSignal_COM_Tx_ENGINE_HYBD_FD_1_FD16_Sum_FW_ID_Fst}, {implementation-record-element=EngTrqFSO_CurrAir, system-signal=SystemSignal_COM_Tx_EngTrqFSO_CurrAir}, {implementation-record-element=MAP_4_BAR_PHEV, system-signal=SystemSignal_COM_Tx_ENGINE_HYBD_FD_1_FD16_MAP_4_BAR_PHEV}, {implementation-record-element=MessageCounter_ENGINE_HYBD_FD_1, system-signal=SystemSignal_COM_Tx_ENGINE_HYBD_FD_1_FD16_MessageCounter_ENGINE_HYBD_FD_1}, {implementation-record-element=CRC_ENGINE_HYBD_FD_1, system-signal=SystemSignal_COM_Tx_ENGINE_HYBD_FD_1_FD16_CRC_ENGINE_HYBD_FD_1}]}
        sender-receiver-to-signal-group-mapping={data-element=CPT_MDG1_FlatView.Lvl2DataTxSignals.Lvl2SftyComTX_PT_TORQUE_FD_1_FD14_Pkt, signal-group=SystemSignalGroup_COM_Tx_PT_TORQUE_FD_1_FD14_Pkt, type-mapping=sender-rec-record-type-mapping=record-element-mappings=[{implementation-record-element=PPPA_TrqEnblRq_Allowed, system-signal=SystemSignal_COM_Tx_PPPA_TrqEnblRq_Allowed_FD14}, {implementation-record-element=SSC_TrqEnblRq_Allowed, system-signal=SystemSignal_COM_Tx_SSC_TrqEnblRq_Allowed_FD14}, {implementation-record-element=ACC_NCC_TrqEnblRq_Allowed, system-signal=SystemSignal_COM_Tx_ACC_NCC_TrqEnblRq_Allowed_FD14}, {implementation-record-element=SumTorque_DrvReqMod, system-signal=SystemSignal_COM_Tx_SumTorque_DrvReqMod_FD14}, {implementation-record-element=Accel_Pedal_Override, system-signal=SystemSignal_COM_Tx_Accel_Pedal_Override_FD14}, {implementation-record-element=ESC_TrqEnblRq_Allowed, system-signal=SystemSignal_COM_Tx_ESC_TrqEnblRq_Allowed_FD14}, {implementation-record-element=RRCC_TrqEnblRq_Allowed, system-signal=SystemSignal_COM_Tx_RRCC_TrqEnblRq_Allowed_FD14}, {implementation-record-element=SumTorqueExp, system-signal=SystemSignal_COM_Tx_SumTorqueExp_FD14}, {implementation-record-element=SumTorqueMax, system-signal=SystemSignal_COM_Tx_SumTorqueMax_FD14}, {implementation-record-element=SumTorqueMin, system-signal=SystemSignal_COM_Tx_SumTorqueMin_FD14}, {implementation-record-element=SumTorqueSel_D_TTC, system-signal=SystemSignal_COM_Tx_SumTorqueSel_D_TTC_FD14}, {implementation-record-element=SumTorqueStatic, system-signal=SystemSignal_COM_Tx_SumTorqueStatic_FD14}, {implementation-record-element=Total_AxleTorque_Static, system-signal=SystemSignal_COM_Tx_Total_AxleTorque_Static_FD14}, {implementation-record-element=Front_AxleTorque_Static, system-signal=SystemSignal_COM_Tx_Front_AxleTorque_Static_FD14}, {implementation-record-element=Rear_AxleTorque_Static, system-signal=SystemSignal_COM_Tx_Rear_AxleTorque_Static_FD14}, {implementation-record-element=MessageCounter_PT_TORQUE_FD_1, system-signal=SystemSignal_COM_Tx_MessageCounter_PT_TORQUE_FD_1_FD14}, {implementation-record-element=CRC_PT_TORQUE_FD_1, system-signal=SystemSignal_COM_Tx_CRC_PT_TORQUE_FD_1_FD14}]}
        sender-receiver-to-signal-group-mapping={data-element=CPT_MDG1_FlatView.Lvl2DataTxSignals.Lvl2SftyComTX_PT_TORQUE_FD_1_FD16_Pkt, signal-group=SystemSignalGroup_COM_Tx_PT_TORQUE_FD_1_FD16_Pkt, type-mapping=sender-rec-record-type-mapping=record-element-mappings=[{implementation-record-element=SumTorque_DrvReqMod, system-signal=SystemSignal_COM_Tx_SumTorque_DrvReqMod}, {implementation-record-element=Accel_Pedal_Override, system-signal=SystemSignal_COM_Tx_Accel_Pedal_Override}, {implementation-record-element=SumTorqueMax, system-signal=SystemSignal_COM_Tx_SumTorqueMax}, {implementation-record-element=SumTorqueMin, system-signal=SystemSignal_COM_Tx_SumTorqueMin}, {implementation-record-element=SumTorqueSel_D_TTC, system-signal=SystemSignal_COM_Tx_SumTorqueSel_D_TTC}, {implementation-record-element=SumTorqueStatic, system-signal=SystemSignal_COM_Tx_SumTorqueStatic}, {implementation-record-element=SumTorqueStatic_SEM, system-signal=SystemSignal_COM_Tx_PT_TORQUE_FD_1_FD16_SumTorqueStatic_SEM}, {implementation-record-element=SumTorqueTgt_SEM, system-signal=SystemSignal_COM_Tx_PT_TORQUE_FD_1_FD16_SumTorqueTgt_SEM}, {implementation-record-element=MessageCounter_PT_TORQUE_FD_1, system-signal=SystemSignal_COM_Tx_MessageCounter_PT_TORQUE_FD_1}, {implementation-record-element=CRC_PT_TORQUE_FD_1, system-signal=SystemSignal_COM_Tx_CRC_PT_TORQUE_FD_1}]}
        sender-receiver-to-signal-group-mapping={data-element=CPT_MDG1_FlatView.Lvl2DataTxSignals.Lvl2SftyComTX_PT_TORQUE_FD_1_FD3_Pkt, signal-group=SystemSignalGroup_COM_Tx_PT_TORQUE_FD_1_FD3_Pkt, type-mapping=sender-rec-record-type-mapping=record-element-mappings=[{implementation-record-element=MotorB_Speed, system-signal=SystemSignal_COM_Tx_MotorB_Speed}, {implementation-record-element=PPPA_TrqEnblRq_Allowed, system-signal=SystemSignal_COM_Tx_PPPA_TrqEnblRq_Allowed_FD3}, {implementation-record-element=SSC_TrqEnblRq_Allowed, system-signal=SystemSignal_COM_Tx_SSC_TrqEnblRq_Allowed_FD3}, {implementation-record-element=ACC_NCC_TrqEnblRq_Allowed, system-signal=SystemSignal_COM_Tx_ACC_NCC_TrqEnblRq_Allowed_FD3}, {implementation-record-element=SumTorque_DrvReqMod, system-signal=SystemSignal_COM_Tx_SumTorque_DrvReqMod_FD3}, {implementation-record-element=Accel_Pedal_Override, system-signal=SystemSignal_COM_Tx_Accel_Pedal_Override_FD3}, {implementation-record-element=ESC_TrqEnblRq_Allowed, system-signal=SystemSignal_COM_Tx_ESC_TrqEnblRq_Allowed_FD3}, {implementation-record-element=RRCC_TrqEnblRq_Allowed, system-signal=SystemSignal_COM_Tx_RRCC_TrqEnblRq_Allowed_FD3}, {implementation-record-element=SumTorqueExp, system-signal=SystemSignal_COM_Tx_SumTorqueExp_FD3}, {implementation-record-element=SumTorqueMax, system-signal=SystemSignal_COM_Tx_SumTorqueMax_FD3}, {implementation-record-element=SumTorqueMin, system-signal=SystemSignal_COM_Tx_SumTorqueMin_FD3}, {implementation-record-element=SumTorqueSel_D_TTC, system-signal=SystemSignal_COM_Tx_SumTorqueSel_D_TTC_FD3}, {implementation-record-element=SumTorqueStatic, system-signal=SystemSignal_COM_Tx_SumTorqueStatic_FD3}, {implementation-record-element=SumTorqueStatic_SEM, system-signal=SystemSignal_COM_Tx_PT_TORQUE_FD_1_FD3_SumTorqueStatic_SEM}, {implementation-record-element=SumTorqueTgt_SEM, system-signal=SystemSignal_COM_Tx_PT_TORQUE_FD_1_FD3_SumTorqueTgt_SEM}, {implementation-record-element=Total_AxleTorque_Static, system-signal=SystemSignal_COM_Tx_Total_AxleTorque_Static_FD3}, {implementation-record-element=Front_AxleTorque_Static, system-signal=SystemSignal_COM_Tx_Front_AxleTorque_Static_FD3}, {implementation-record-element=Rear_AxleTorque_Static, system-signal=SystemSignal_COM_Tx_Rear_AxleTorque_Static_FD3}, {implementation-record-element=MessageCounter_PT_TORQUE_FD_1, system-signal=SystemSignal_COM_Tx_MessageCounter_PT_TORQUE_FD_1_FD3}, {implementation-record-element=CRC_PT_TORQUE_FD_1, system-signal=SystemSignal_COM_Tx_CRC_PT_TORQUE_FD_1_FD3}]}
        sender-receiver-to-signal-group-mapping={data-element=CPT_MDG1_FlatView.Lvl2DataTxSignals.Lvl2SftyComTX_ENGINE_HYBD_FD_1_FD3_Pkt, signal-group=SystemSignalGroup_COM_Tx_ENGINE_HYBD_FD_1_Pkt, type-mapping=sender-rec-record-type-mapping=record-element-mappings=[{implementation-record-element=T_Min_Mgate, system-signal=SystemSignal_COM_Tx_T_Min_Mgate}, {implementation-record-element=DrvrIntndedAxleTorqRaw, system-signal=SystemSignal_COM_Tx_DrvrIntndedAxleTorqRaw}, {implementation-record-element=T_min_raw_Aggressive, system-signal=SystemSignal_COM_Tx_T_min_raw_Aggressive}, {implementation-record-element=T_max_raw, system-signal=SystemSignal_COM_Tx_T_max_raw}, {implementation-record-element=T_min_raw, system-signal=SystemSignal_COM_Tx_T_min_raw}, {implementation-record-element=ECM_VTD_Freeze, system-signal=SystemSignal_COM_Tx_ECM_VTD_Freeze}, {implementation-record-element=ECM_IMMO_STAT_CANePT, system-signal=SystemSignal_COM_Tx_ECM_IMMO_STAT_CANePT}, {implementation-record-element=EngMinSparkNomCurrAirTorqCap, system-signal=SystemSignal_COM_Tx_ENGINE_HYBD_FD_1_EngMinSparkNomCurrAirTorqCap}, {implementation-record-element=EngRqStTyp, system-signal=SystemSignal_COM_Tx_EngRqStTyp}, {implementation-record-element=CmndFlyWheelTorqPotential, system-signal=SystemSignal_COM_Tx_CmndFlyWheelTorqPotential}, {implementation-record-element=ESS_Engine_State_EE, system-signal=SystemSignal_COM_Tx_ESS_Engine_State_EE}, {implementation-record-element=CmndFlyWheelTorqPrdtd, system-signal=SystemSignal_COM_Tx_CmndFlyWheelTorqPrdtd}, {implementation-record-element=EngActuatorsStat, system-signal=SystemSignal_COM_Tx_ENGINE_HYBD_FD_1_EngActuatorsStat}, {implementation-record-element=ECMReq_Remedial_Stop, system-signal=SystemSignal_COM_Tx_ECMReq_Remedial_Stop}, {implementation-record-element=DrvrIntndedFlyWheelTorq, system-signal=SystemSignal_COM_Tx_DrvrIntndedFlyWheelTorq}, {implementation-record-element=HybActEngTorqRespTyp, system-signal=SystemSignal_COM_Tx_ENGINE_HYBD_FD_1_HybActEngTorqRespTyp}, {implementation-record-element=EngCylDeactMd, system-signal=SystemSignal_COM_Tx_EngCylDeactMd}, {implementation-record-element=DrvrIntndedFlyWheelTorqRaw, system-signal=SystemSignal_COM_Tx_DrvrIntndedFlyWheelTorqRaw}, {implementation-record-element=CmndFlyWheelTorqRespTyp, system-signal=SystemSignal_COM_Tx_CmndFlyWheelTorqRespTyp}, {implementation-record-element=CmndAxleTorqRespTyp, system-signal=SystemSignal_COM_Tx_CmndAxleTorqRespTyp}, {implementation-record-element=MaxOffEngTorqCap, system-signal=SystemSignal_COM_Tx_ENGINE_HYBD_FD_1_MaxOffEngTorqCap}, {implementation-record-element=DrvrIntndedFlyWheelTorqV, system-signal=SystemSignal_COM_Tx_DrvrIntndedFlyWheelTorqV}, {implementation-record-element=DrvrIntndedFlyWheelTorqRawV, system-signal=SystemSignal_COM_Tx_DrvrIntndedFlyWheelTorqRawV}, {implementation-record-element=DrvrIntndedAxleTorqRawV, system-signal=SystemSignal_COM_Tx_DrvrIntndedAxleTorqRawV}, {implementation-record-element=MaxPrdtdEngTorqCap, system-signal=SystemSignal_COM_Tx_ENGINE_HYBD_FD_1_MaxPrdtdEngTorqCap}, {implementation-record-element=MinEngTorqCapV, system-signal=SystemSignal_COM_Tx_ENGINE_HYBD_FD_1_MinEngTorqCapV}, {implementation-record-element=MinAirFlowMinSparkTorqCapV, system-signal=SystemSignal_COM_Tx_ENGINE_HYBD_FD_1_MinAirFlowMinSparkTorqCapV}, {implementation-record-element=MaxPrdtdEngTorqCapV, system-signal=SystemSignal_COM_Tx_ENGINE_HYBD_FD_1_MaxPrdtdEngTorqCapV}, {implementation-record-element=EngCmbstnCmnd, system-signal=SystemSignal_COM_Tx_EngCmbstnCmnd}, {implementation-record-element=MinAirFlowMinSparkTorqCap, system-signal=SystemSignal_COM_Tx_ENGINE_HYBD_FD_1_MinAirFlowMinSparkTorqCap}, {implementation-record-element=MinPrdtdEngRunTorqCapV, system-signal=SystemSignal_COM_Tx_ENGINE_HYBD_FD_1_MinPrdtdEngRunTorqCapV}, {implementation-record-element=AccPosV, system-signal=SystemSignal_COM_Tx_AccPosV}, {implementation-record-element=MinImmedEngTorqCapV, system-signal=SystemSignal_COM_Tx_ENGINE_HYBD_FD_1_MinImmedEngTorqCapV}, {implementation-record-element=MinEngTorqCap, system-signal=SystemSignal_COM_Tx_ENGINE_HYBD_FD_1_MinEngTorqCap}, {implementation-record-element=Cam_Int_2_Locked, system-signal=SystemSignal_COM_Tx_Cam_Int_2_Locked}, {implementation-record-element=Cam_Int_1_Locked, system-signal=SystemSignal_COM_Tx_Cam_Int_1_Locked}, {implementation-record-element=Cam_Exh_2_Locked, system-signal=SystemSignal_COM_Tx_Cam_Exh_2_Locked}, {implementation-record-element=Cam_Exh_1_Locked, system-signal=SystemSignal_COM_Tx_Cam_Exh_1_Locked}, {implementation-record-element=MinImmedEngTorqCap, system-signal=SystemSignal_COM_Tx_ENGINE_HYBD_FD_1_MinImmedEngTorqCap}, {implementation-record-element=ECU_A2D_Failure, system-signal=SystemSignal_COM_Tx_ECU_A2D_Failure}, {implementation-record-element=CylOff, system-signal=SystemSignal_COM_Tx_CylOff}, {implementation-record-element=Crank_Maturing_Fault, system-signal=SystemSignal_COM_Tx_Crank_Maturing_Fault}, {implementation-record-element=Crank_Locked, system-signal=SystemSignal_COM_Tx_Crank_Locked}, {implementation-record-element=MinPrdtdEngRunTorqCap, system-signal=SystemSignal_COM_Tx_ENGINE_HYBD_FD_1_MinPrdtdEngRunTorqCap}, {implementation-record-element=EngDFCO_Allw, system-signal=SystemSignal_COM_Tx_EngDFCO_Allw}, {implementation-record-element=EngCylDeactEnCondMet, system-signal=SystemSignal_COM_Tx_EngCylDeactEnCondMet}, {implementation-record-element=EngAirFlwStdyStTorqV, system-signal=SystemSignal_COM_Tx_ENGINE_HYBD_FD_1_EngAirFlwStdyStTorqV}, {implementation-record-element=EngActStdyStTorqV, system-signal=SystemSignal_COM_Tx_ENGINE_HYBD_FD_1_EngActStdyStTorqV}, {implementation-record-element=EngActStdyStTorq, system-signal=SystemSignal_COM_Tx_ENGINE_HYBD_FD_1_EngActStdyStTorq}, {implementation-record-element=EngOffRecom, system-signal=SystemSignal_COM_Tx_EngOffRecom}, {implementation-record-element=Engine_Sync_720, system-signal=SystemSignal_COM_Tx_Engine_Sync_720}, {implementation-record-element=EngDFCO_St, system-signal=SystemSignal_COM_Tx_EngDFCO_St}, {implementation-record-element=EngDFCO_Req, system-signal=SystemSignal_COM_Tx_EngDFCO_Req}, {implementation-record-element=EngAirFlwStdyStTorq, system-signal=SystemSignal_COM_Tx_ENGINE_HYBD_FD_1_EngAirFlwStdyStTorq}, {implementation-record-element=PT_BrkPedDscrtInpStat, system-signal=SystemSignal_COM_Tx_PT_BrkPedDscrtInpStat}, {implementation-record-element=Feedback_HCP, system-signal=SystemSignal_COM_Tx_ENGINE_HYBD_FD_1_Feedback_HCP}, {implementation-record-element=EngSysFld, system-signal=SystemSignal_COM_Tx_EngSysFld}, {implementation-record-element=EngRunCrnkAct, system-signal=SystemSignal_COM_Tx_ENGINE_HYBD_FD_1_EngRunCrnkAct}, {implementation-record-element=T_max_FW, system-signal=SystemSignal_COM_Tx_T_max_FW}, {implementation-record-element=RedSpkAuthorityAvbl, system-signal=SystemSignal_COM_Tx_ENGINE_HYBD_FD_1_RedSpkAuthorityAvbl}, {implementation-record-element=PTCrnkAbrted, system-signal=SystemSignal_COM_Tx_PTCrnkAbrted}, {implementation-record-element=PT_CrnkAct, system-signal=SystemSignal_COM_Tx_PT_CrnkAct}, {implementation-record-element=PT_BrkPedDscrtInpStatV, system-signal=SystemSignal_COM_Tx_PT_BrkPedDscrtInpStatV}, {implementation-record-element=T_min_FW, system-signal=SystemSignal_COM_Tx_T_min_FW}, {implementation-record-element=TLC_LRN_Rq, system-signal=SystemSignal_COM_Tx_TLC_LRN_Rq}, {implementation-record-element=Sum_FW_ID_Slw, system-signal=SystemSignal_COM_Tx_ENGINE_HYBD_FD_1_Sum_FW_ID_Slw}, {implementation-record-element=AccPos, system-signal=SystemSignal_COM_Tx_AccPos}, {implementation-record-element=EngTrqReserveReq, system-signal=SystemSignal_COM_Tx_ENGINE_HYBD_FD_1_EngTrqReserveReq}, {implementation-record-element=ETRQ_Mode, system-signal=SystemSignal_COM_Tx_ENGINE_HYBD_FD_1_ETRQ_Mode}, {implementation-record-element=Sum_FW_ID_Fst, system-signal=SystemSignal_COM_Tx_ENGINE_HYBD_FD_1_Sum_FW_ID_Fst}, {implementation-record-element=ECM_Crank_Phase, system-signal=SystemSignal_COM_Tx_ECM_Crank_Phase}, {implementation-record-element=ECM_Comm_Fail_CAN, system-signal=SystemSignal_COM_Tx_ECM_Comm_Fail_CAN}, {implementation-record-element=PT_BrakePdlPosn, system-signal=SystemSignal_COM_Tx_PT_BrakePdlPosn}, {implementation-record-element=MAP_4_BAR_PHEV, system-signal=SystemSignal_COM_Tx_ENGINE_HYBD_FD_1_MAP_4_BAR_PHEV}, {implementation-record-element=MessageCounter_ENGINE_HYBD_FD_1, system-signal=SystemSignal_COM_Tx_ENGINE_HYBD_FD_1_MessageCounter_ENGINE_HYBD_FD_1}, {implementation-record-element=CRC_ENGINE_HYBD_FD_1, system-signal=SystemSignal_COM_Tx_ENGINE_HYBD_FD_1_CRC_ENGINE_HYBD_FD_1}]}
        sender-receiver-to-signal-group-mapping={data-element=CPT_MDG1_FlatView.SysSftyComAGSMRxSignalsSR.SftyComRX_AGSM_FD_2_Pkt, signal-group=SystemSignalGroup_COM_Rx_AGSM_FD_2_Pkt, type-mapping=sender-rec-record-type-mapping=record-element-mappings=[{implementation-record-element=ShiftLeverPositionReq, system-signal=SystemSignal_COM_Rx_ShiftLeverPositionReq}, {implementation-record-element=MessageCounter_AGSM2, system-signal=SystemSignal_COM_Rx_MessageCounter_AGSM2}, {implementation-record-element=CRC_AGSM2, system-signal=SystemSignal_COM_Rx_CRC_AGSM2}]}
        sender-receiver-to-signal-group-mapping={data-element=CPT_MDG1_FlatView.SysSftyComBCMRxSignalsSR.SftyComRX_EPS_FD_1_FD3_Pkt, signal-group=SystemSignalGroup_COM_Rx_EPS_FD_1_Pkt, type-mapping=sender-rec-record-type-mapping=record-element-mappings=[{implementation-record-element=LwsAngle, system-signal=SystemSignal_COM_Rx_LwsAngle}, {implementation-record-element=LwsSpeed, system-signal=SystemSignal_COM_Rx_LwsSpeed}, {implementation-record-element=ElectricSteeringFailSts, system-signal=SystemSignal_COM_Rx_ElectricSteeringFailSts}, {implementation-record-element=EngineFanRequestActivation, system-signal=SystemSignal_COM_Rx_EngineFanRequestActivation}, {implementation-record-element=MessageCounter_EPS1, system-signal=SystemSignal_COM_Rx_MessageCounter_EPS1}, {implementation-record-element=CRC_EPS1, system-signal=SystemSignal_COM_Rx_CRC_EPS1}]}
        sender-receiver-to-signal-group-mapping={data-element=CPT_MDG1_FlatView.SysSftyComBCMRxSignalsSR.SftyComRX_BCM_FD_9_FD3_Pkt, signal-group=SystemSignalGroup_COM_Rx_BCM_FD_9_Pkt, type-mapping=sender-rec-record-type-mapping=record-element-mappings=[{implementation-record-element=LHRDoorSts, system-signal=SystemSignal_COM_Rx_LHRDoorSts}, {implementation-record-element=DriverDoorSts, system-signal=SystemSignal_COM_Rx_DriverDoorSts}, {implementation-record-element=RHRDoorSts, system-signal=SystemSignal_COM_Rx_RHRDoorSts}, {implementation-record-element=ASBM_AUX6_On, system-signal=SystemSignal_COM_Rx_ASBM_AUX6_On}, {implementation-record-element=PsngrDoorSts, system-signal=SystemSignal_COM_Rx_PsngrDoorSts}, {implementation-record-element=LowFuelWarningSts, system-signal=SystemSignal_COM_Rx_LowFuelWarningSts}, {implementation-record-element=FrontWiperMoveSts, system-signal=SystemSignal_COM_Rx_FrontWiperMoveSts}, {implementation-record-element=FuelLevel, system-signal=SystemSignal_COM_Rx_FuelLevel}, {implementation-record-element=FuelLevel2, system-signal=SystemSignal_COM_Rx_FuelLevel2}, {implementation-record-element=PowerModeSts, system-signal=SystemSignal_COM_Rx_PowerModeSts}, {implementation-record-element=MessageCounter_BCM9, system-signal=SystemSignal_COM_Rx_MessageCounter_BCM9}, {implementation-record-element=ParkBrakeSts, system-signal=SystemSignal_COM_Rx_ParkBrakeSts}, {implementation-record-element=CRC_BCM9, system-signal=SystemSignal_COM_Rx_CRC_BCM9}]}
        sender-receiver-to-signal-group-mapping={data-element=CPT_MDG1_FlatView.SysSftyComBCMRxSignalsSR.SftyComRX_BCM_FD_2_FD3_Pkt, signal-group=SystemSignalGroup_COM_Rx_BCM_FD_2_Pkt, type-mapping=sender-rec-record-type-mapping=record-element-mappings=[{implementation-record-element=RemStActvSts_R, system-signal=SystemSignal_COM_Rx_RemStActvSts_R}, {implementation-record-element=RefuelRequest, system-signal=SystemSignal_COM_Rx_RefuelRequest}, {implementation-record-element=EB_SW_PSD, system-signal=SystemSignal_COM_Rx_EB_SW_PSD}, {implementation-record-element=OperationalModeSts, system-signal=SystemSignal_COM_Rx_OperationalModeSts}, {implementation-record-element=StartRelayBCMFault, system-signal=SystemSignal_COM_Rx_StartRelayBCMFault}, {implementation-record-element=StartRelayBCMSts, system-signal=SystemSignal_COM_Rx_StartRelayBCMSts}, {implementation-record-element=EngineOffRequest, system-signal=SystemSignal_COM_Rx_EngineOffRequest}, {implementation-record-element=MessageCounter_BCM2, system-signal=SystemSignal_COM_Rx_MessageCounter_BCM2}, {implementation-record-element=CRC_BCM2, system-signal=SystemSignal_COM_Rx_CRC_BCM2}]}
        sender-receiver-to-signal-group-mapping={data-element=CPT_MDG1_FlatView.SysSftyComBCMRxSignalsSR.SftyComRX_BCM_FD_18_FD3_Pkt, signal-group=SystemSignalGroup_COM_Rx_BCM_FD_18_Pkt, type-mapping=sender-rec-record-type-mapping=record-element-mappings=[{implementation-record-element=DriverDoor2AjarRawValSts_8, system-signal=SystemSignal_COM_Rx_DriverDoor2AjarRawValSts_8}, {implementation-record-element=BonnetAjarRawValSts_8, system-signal=SystemSignal_COM_Rx_BonnetAjarRawValSts_8}, {implementation-record-element=DriverDoorAjarRawValSts_8, system-signal=SystemSignal_COM_Rx_DriverDoorAjarRawValSts_8}, {implementation-record-element=DriverDoor2AjarXtionSts, system-signal=SystemSignal_COM_Rx_DriverDoor2AjarXtionSts}, {implementation-record-element=DriverDoorAjarXtionSts, system-signal=SystemSignal_COM_Rx_DriverDoorAjarXtionSts}, {implementation-record-element=LeakCheckTimerExpired, system-signal=SystemSignal_COM_Rx_LeakCheckTimerExpired}, {implementation-record-element=FuelDrRelSwRawSt, system-signal=SystemSignal_COM_Rx_FuelDrRelSwRawSt}, {implementation-record-element=MessageCounter_BCM18, system-signal=SystemSignal_COM_Rx_MessageCounter_BCM18}, {implementation-record-element=CRC_BCM18, system-signal=SystemSignal_COM_Rx_CRC_BCM18}]}
        sender-receiver-to-signal-group-mapping={data-element=CPT_MDG1_FlatView.SysSftyComBCMRxSignalsSR.SftyComRX_BCM_FD_13_FD3_Pkt, signal-group=SystemSignalGroup_COM_Rx_BCM_FD_13_Pkt, type-mapping=sender-rec-record-type-mapping=record-element-mappings=[{implementation-record-element=SpeedLimiterOnOffSts, system-signal=SystemSignal_COM_Rx_SpeedLimiterOnOffSts}, {implementation-record-element=CrusCnclSwitch, system-signal=SystemSignal_COM_Rx_CrusCnclSwitch}, {implementation-record-element=ACC_On, system-signal=SystemSignal_COM_Rx_ACC_On}, {implementation-record-element=CruiseControlFailSts, system-signal=SystemSignal_COM_Rx_CruiseControlFailSts}, {implementation-record-element=ResumeSwitch, system-signal=SystemSignal_COM_Rx_ResumeSwitch}, {implementation-record-element=DeceleratorSts, system-signal=SystemSignal_COM_Rx_DeceleratorSts}, {implementation-record-element=AcceleratorSts, system-signal=SystemSignal_COM_Rx_AcceleratorSts}, {implementation-record-element=CruiseControlOnOffSts, system-signal=SystemSignal_COM_Rx_CruiseControlOnOffSts}, {implementation-record-element=MessageCounter_BCM13, system-signal=SystemSignal_COM_Rx_MessageCounter_BCM13}, {implementation-record-element=CRC_BCM13, system-signal=SystemSignal_COM_Rx_CRC_BCM13}]}
        sender-receiver-to-signal-group-mapping={data-element=CPT_MDG1_FlatView.SysSftyComBSMRxSignalsSR.SftyComRX_BRAKE_FD_1_FD3_Pkt, signal-group=SystemSignalGroup_COM_Rx_BRAKE_FD_1_FD3_Pkt, type-mapping=sender-rec-record-type-mapping=record-element-mappings=[{implementation-record-element=REF_VEH_SPEED, system-signal=SystemSignal_COM_Rx_REF_VEH_SPEED}, {implementation-record-element=HILL_DES_STAT, system-signal=SystemSignal_COM_Rx_HILL_DES_STAT}, {implementation-record-element=EngSpdIntervReq, system-signal=SystemSignal_COM_Rx_EngSpdIntervReq}, {implementation-record-element=BrkTrq, system-signal=SystemSignal_COM_Rx_BrkTrq}, {implementation-record-element=ShftChrDsp_Rq_ESC, system-signal=SystemSignal_COM_Rx_ShftChrDsp_Rq_ESC}, {implementation-record-element=BrkTrq_Driver, system-signal=SystemSignal_COM_Rx_BrkTrq_Driver}, {implementation-record-element=SelectSpdSts, system-signal=SystemSignal_COM_Rx_SelectSpdSts}, {implementation-record-element=MessageCounter_BRAKE1, system-signal=SystemSignal_COM_Rx_MessageCounter_BRAKE1}, {implementation-record-element=EngSpdInterv, system-signal=SystemSignal_COM_Rx_EngSpdInterv}, {implementation-record-element=CRC_BRAKE1, system-signal=SystemSignal_COM_Rx_CRC_BRAKE1}]}
        sender-receiver-to-signal-group-mapping={data-element=CPT_MDG1_FlatView.SysSftyComBSMRxSignalsSR.SftyComRX_BRAKE_FD_2_FD14_Pkt, signal-group=SystemSignalGroup_COM_Rx_BRAKE_FD_2_FD14_Pkt, type-mapping=sender-rec-record-type-mapping=record-element-mappings=[{implementation-record-element=VehicleSpeedVSOSig, system-signal=SystemSignal_COM_Rx_VehicleSpeedVSOSig_FD14}, {implementation-record-element=ABSActive, system-signal=SystemSignal_COM_Rx_ABSActive_FD14}, {implementation-record-element=ACC_Wheel_Torque_Enabled_BSM, system-signal=SystemSignal_COM_Rx_ACC_Wheel_Torque_Enabled_BSM}, {implementation-record-element=TorqueRequest, system-signal=SystemSignal_COM_Rx_TorqueRequest}, {implementation-record-element=TorqueReduct, system-signal=SystemSignal_COM_Rx_TorqueReduct}, {implementation-record-element=TorqueIncrease, system-signal=SystemSignal_COM_Rx_TorqueIncrease}, {implementation-record-element=Brk_Stat, system-signal=SystemSignal_COM_Rx_Brk_Stat_FD14}, {implementation-record-element=BrakeBoostPressure, system-signal=SystemSignal_COM_Rx_BrakeBoostPressure_FD14}, {implementation-record-element=BrakePedalPressure, system-signal=SystemSignal_COM_Rx_BrakePedalPressure_FD14}, {implementation-record-element=ACC_Wheel_Torque_BSM, system-signal=SystemSignal_COM_Rx_ACC_Wheel_Torque_BSM}, {implementation-record-element=MessageCounter_BRAKE2, system-signal=SystemSignal_COM_Rx_MessageCounter_BRAKE2_FD14}, {implementation-record-element=CRC_BRAKE2, system-signal=SystemSignal_COM_Rx_CRC_BRAKE2_FD14}]}
        sender-receiver-to-signal-group-mapping={data-element=CPT_MDG1_FlatView.SysSftyComBSMRxSignalsSR.SftyComRX_BRAKE_FD_2_FD3_Pkt, signal-group=SystemSignalGroup_COM_Rx_BRAKE_FD_2_FD3_Pkt, type-mapping=sender-rec-record-type-mapping=record-element-mappings=[{implementation-record-element=VehicleSpeedVSOSig, system-signal=SystemSignal_COM_Rx_VehicleSpeedVSOSig_FD3}, {implementation-record-element=LatAcceleration_BSM, system-signal=SystemSignal_COM_Rx_LatAcceleration_BSM}, {implementation-record-element=LongAcceleration_BSM, system-signal=SystemSignal_COM_Rx_LongAcceleration_BSM}, {implementation-record-element=LatAccelerationFailSts_BSM, system-signal=SystemSignal_COM_Rx_LatAccelerationFailSts_BSM}, {implementation-record-element=LongAccelerationFailSts_BSM, system-signal=SystemSignal_COM_Rx_LongAccelerationFailSts_BSM}, {implementation-record-element=ESP_Sys_Stat, system-signal=SystemSignal_COM_Rx_ESP_Sys_Stat}, {implementation-record-element=ABSActive, system-signal=SystemSignal_COM_Rx_ABSActive_FD3}, {implementation-record-element=ESCActive, system-signal=SystemSignal_COM_Rx_ESCActive}, {implementation-record-element=BrakeInterventionSts, system-signal=SystemSignal_COM_Rx_BrakeInterventionSts}, {implementation-record-element=TotIntdTotalBrkTorq_FW, system-signal=SystemSignal_COM_Rx_TotIntdTotalBrkTorq_FW}, {implementation-record-element=ImpendingSkid, system-signal=SystemSignal_COM_Rx_ImpendingSkid}, {implementation-record-element=CmndTotBrkFrictTorq_FW, system-signal=SystemSignal_COM_Rx_CmndTotBrkFrictTorq_FW}, {implementation-record-element=Brk_Stat, system-signal=SystemSignal_COM_Rx_Brk_Stat_FD3}, {implementation-record-element=BrakeBoostPressure, system-signal=SystemSignal_COM_Rx_BrakeBoostPressure_FD3}, {implementation-record-element=BrakePedalPressure, system-signal=SystemSignal_COM_Rx_BrakePedalPressure_FD3}, {implementation-record-element=MessageCounter_BRAKE2, system-signal=SystemSignal_COM_Rx_MessageCounter_BRAKE2_FD3}, {implementation-record-element=CRC_BRAKE2, system-signal=SystemSignal_COM_Rx_CRC_BRAKE2_FD3}]}
        sender-receiver-to-signal-group-mapping={data-element=CPT_MDG1_FlatView.SysSftyComBSMRxSignalsSR.SftyComRX_BRAKE_FD_3_FD3_Pkt, signal-group=SystemSignalGroup_COM_Rx_BRAKE_FD_3_Pkt, type-mapping=sender-rec-record-type-mapping=record-element-mappings=[{implementation-record-element=RHF_Spin, system-signal=SystemSignal_COM_Rx_RHF_Spin}, {implementation-record-element=LHRWheelSpeed, system-signal=SystemSignal_COM_Rx_LHRWheelSpeed}, {implementation-record-element=LHF_Spin, system-signal=SystemSignal_COM_Rx_LHF_Spin}, {implementation-record-element=LHFWheelSpeed, system-signal=SystemSignal_COM_Rx_LHFWheelSpeed}, {implementation-record-element=RHFWheelSpeed, system-signal=SystemSignal_COM_Rx_RHFWheelSpeed}, {implementation-record-element=RHRWheelSpeed, system-signal=SystemSignal_COM_Rx_RHRWheelSpeed}, {implementation-record-element=LHR_Spin, system-signal=SystemSignal_COM_Rx_LHR_Spin}, {implementation-record-element=LHR_WheelSensorFailSts, system-signal=SystemSignal_COM_Rx_LHR_WheelSensorFailSts}, {implementation-record-element=RHR_Spin, system-signal=SystemSignal_COM_Rx_RHR_Spin}, {implementation-record-element=RHR_WheelSensorFailSts, system-signal=SystemSignal_COM_Rx_RHR_WheelSensorFailSts}, {implementation-record-element=LHR_FastPulseCounter, system-signal=SystemSignal_COM_Rx_LHR_FastPulseCounter}, {implementation-record-element=RHR_FastPulseCounter, system-signal=SystemSignal_COM_Rx_RHR_FastPulseCounter}, {implementation-record-element=LHF_FastPulseCounter, system-signal=SystemSignal_COM_Rx_LHF_FastPulseCounter}, {implementation-record-element=RHF_FastPulseCounter, system-signal=SystemSignal_COM_Rx_RHF_FastPulseCounter}, {implementation-record-element=MessageCounter_BRAKE3, system-signal=SystemSignal_COM_Rx_MessageCounter_BRAKE3}, {implementation-record-element=LHF_WheelSensorFailSts, system-signal=SystemSignal_COM_Rx_LHF_WheelSensorFailSts}, {implementation-record-element=RHF_WheelSensorFailSts, system-signal=SystemSignal_COM_Rx_RHF_WheelSensorFailSts}, {implementation-record-element=CRC_BRAKE3, system-signal=SystemSignal_COM_Rx_CRC__BRAKE3}]}
        sender-receiver-to-signal-group-mapping={data-element=CPT_MDG1_FlatView.SysSftyComBSMRxSignalsSR.SftyComRX_BRAKE_FD_7_FD3_Pkt, signal-group=SystemSignalGroup_COM_Rx_BRAKE_FD_7_FD3_Pkt, type-mapping=sender-rec-record-type-mapping=record-element-mappings=[{implementation-record-element=AutoVehHoldSts, system-signal=SystemSignal_COM_Rx_AutoVehHoldSts}, {implementation-record-element=BrakePdlPosn, system-signal=SystemSignal_COM_Rx_BrakePdlPosn_FD3}, {implementation-record-element=BrkPdl_Stat, system-signal=SystemSignal_COM_Rx_BrkPdl_Stat_FD3}, {implementation-record-element=BrkPdl_Flt, system-signal=SystemSignal_COM_Rx_BrkPdl_Flt_FD3}, {implementation-record-element=MessageCounter_BRAKE7, system-signal=SystemSignal_COM_Rx_MessageCounter_BRAKE7}, {implementation-record-element=BSM_ReadyForESS, system-signal=SystemSignal_COM_Rx_BSM_ReadyForESS}, {implementation-record-element=CRC_BRAKE7, system-signal=SystemSignal_COM_Rx_CRC_BRAKE7}]}
        sender-receiver-to-signal-group-mapping={data-element=CPT_MDG1_FlatView.SysSftyComBSMRxSignalsSR.SftyComRX_BRAKE_FD_6_FD14_Pkt, signal-group=SystemSignalGroup_COM_Rx_BRAKE_FD_6_FD14_Pkt, type-mapping=sender-rec-record-type-mapping=record-element-mappings=[{implementation-record-element=TotalAxle_Min_Rq_BSM, system-signal=SystemSignal_COM_Rx_TotalAxle_Min_Rq_BSM}, {implementation-record-element=TotalAxle_Max_Rq_BSM, system-signal=SystemSignal_COM_Rx_TotalAxle_Max_Rq_BSM}, {implementation-record-element=TotalAxle_Rq_BSM, system-signal=SystemSignal_COM_Rx_TotalAxle_Rq_BSM}, {implementation-record-element=DriverRequested_AxleTrq_BSM, system-signal=SystemSignal_COM_Rx_DriverRequested_AxleTrq_BSM}, {implementation-record-element=DriverReq_AxleTrq_Enabled_BSM, system-signal=SystemSignal_COM_Rx_DriverReq_AxleTrq_Enabled_BSM}, {implementation-record-element=MessageCounter_BRAKE_FD_6, system-signal=SystemSignal_COM_Rx_MessageCounter_BRAKE_FD_6}, {implementation-record-element=CRC_BRAKE_FD_6, system-signal=SystemSignal_COM_Rx_CRC_BRAKE_FD_6}]}
        sender-receiver-to-signal-group-mapping={data-element=CPT_MDG1_FlatView.SysSftyComBSMRxSignalsSR.SftyComRX_BRAKE_FD_5_FD3_Pkt, signal-group=SystemSignalGroup_COM_Rx_BRAKE_FD_5_FD3_Pkt, type-mapping=sender-rec-record-type-mapping=record-element-mappings=[{implementation-record-element=CRC_BRAKE5, system-signal=SystemSignal_COM_Rx_CRC_BRAKE5_FD3}, {implementation-record-element=MessageCounter_BRAKE5, system-signal=SystemSignal_COM_Rx_MessageCounter_BRAKE5_FD3}, {implementation-record-element=ACCEngaged, system-signal=SystemSignal_COM_Rx_ACCEngaged_FD3}, {implementation-record-element=RollsModeAct, system-signal=SystemSignal_COM_Rx_RollsModeAct}, {implementation-record-element=ABSFailSts, system-signal=SystemSignal_COM_Rx_ABSFailSts_FD3}, {implementation-record-element=ESCFailSts, system-signal=SystemSignal_COM_Rx_ESCFailSts}]}
        sender-receiver-to-signal-group-mapping={data-element=CPT_MDG1_FlatView.SysSftyComBSMRxSignalsSR.SftyComRX_BRAKE_FD_5_FD14_Pkt, signal-group=SystemSignalGroup_COM_Rx_BRAKE_FD_5_FD14_Pkt, type-mapping=sender-rec-record-type-mapping=record-element-mappings=[{implementation-record-element=CMMIntervention, system-signal=SystemSignal_COM_Rx_CMMIntervention}, {implementation-record-element=CRC_BRAKE5, system-signal=SystemSignal_COM_Rx_CRC_BRAKE5_FD14}, {implementation-record-element=MessageCounter_BRAKE5, system-signal=SystemSignal_COM_Rx_MessageCounter_BRAKE5_FD14}, {implementation-record-element=ACCEngaged, system-signal=SystemSignal_COM_Rx_ACCEngaged_FD14}, {implementation-record-element=ABSFailSts, system-signal=SystemSignal_COM_Rx_ABSFailSts_FD14}]}
        sender-receiver-to-signal-group-mapping={data-element=CPT_MDG1_FlatView.SysSftyComBSMRxSignalsSR.SftyComRX_BRAKE_FD_4_FD3_Pkt, signal-group=SystemSignalGroup_COM_Rx_BRAKE_FD_4_Pkt, type-mapping=sender-rec-record-type-mapping=record-element-mappings=[{implementation-record-element=CRC_BRAKE4, system-signal=SystemSignal_COM_Rx_CRC_BRAKE4}, {implementation-record-element=BSM_LnchAbrtSts, system-signal=SystemSignal_COM_Rx_BSM_LnchAbrtSts}, {implementation-record-element=MessageCounter_BRAKE4, system-signal=SystemSignal_COM_Rx_MessageCounter_BRAKE4}, {implementation-record-element=REPRGD_PFC_CLR_BSM, system-signal=SystemSignal_COM_Rx_REPRGD_PFC_CLR_BSM}, {implementation-record-element=MIL_OnRq_BSM, system-signal=SystemSignal_COM_Rx_MIL_OnRq_BSM}, {implementation-record-element=CODE_CLR_BSM, system-signal=SystemSignal_COM_Rx_CODE_CLR_BSM}, {implementation-record-element=EPBSts, system-signal=SystemSignal_COM_Rx_EPBSts}, {implementation-record-element=MSRActive, system-signal=SystemSignal_COM_Rx_MSRActive}, {implementation-record-element=ASRActive, system-signal=SystemSignal_COM_Rx_ASRActive}, {implementation-record-element=TravelDistance, system-signal=SystemSignal_COM_Rx_TravelDistance}, {implementation-record-element=BSM_LnchMode, system-signal=SystemSignal_COM_Rx_BSM_LnchMode}]}
        sender-receiver-to-signal-group-mapping={data-element=CPT_MDG1_FlatView.SysSftyComCADMRxSignalsSR.SftyComRX_ADAS_FD_INFO_FD14_Pkt, signal-group=SystemSignalGroup_COM_Rx_ADAS_FD_INFO_FD14_Pkt, type-mapping=sender-rec-record-type-mapping=record-element-mappings=[{implementation-record-element=CRC_ADAS_FD_INFO, system-signal=SystemSignal_COM_Rx_CRC_ADAS_FD_INFO}, {implementation-record-element=ACC_Systemsts, system-signal=SystemSignal_COM_Rx_ACC_Systemsts_FD14}, {implementation-record-element=MessageCounter_ADAS_FD_INFO, system-signal=SystemSignal_COM_Rx_MessageCounter_ADAS_FD_INFO}, {implementation-record-element=Object_Dist, system-signal=SystemSignal_COM_Rx_Object_Dist}, {implementation-record-element=ACC_DsrSpeedKPH, system-signal=SystemSignal_COM_Rx_ACC_DsrSpeedKPH}, {implementation-record-element=ACC_StopStart, system-signal=SystemSignal_COM_Rx_ACC_StopStart_FD14}, {implementation-record-element=MRM_STATUS, system-signal=SystemSignal_COM_Rx_MRM_STATUS_FD14}]}
        sender-receiver-to-signal-group-mapping={data-element=CPT_MDG1_FlatView.SysSftyComCADMRxSignalsSR.SftyComRX_ADAS_FD_INFO_FD3_Pkt, signal-group=SystemSignalGroup_COM_Rx_ADAS_FD_INFO_FD3_Pkt, type-mapping=sender-rec-record-type-mapping=record-element-mappings=[{implementation-record-element=ACC_EB_Req, system-signal=SystemSignal_COM_Rx_ACC_EB_Req}, {implementation-record-element=MRM_STATUS, system-signal=SystemSignal_COM_Rx_MRM_STATUS_FD3}, {implementation-record-element=ACC_StopStart, system-signal=SystemSignal_COM_Rx_ACC_StopStart_FD3}, {implementation-record-element=ACC_Systemsts, system-signal=SystemSignal_COM_Rx_ACC_Systemsts_FD3}]}
        sender-receiver-to-signal-group-mapping={data-element=CPT_MDG1_FlatView.SysSftyComDTCMRxSignalsSR.SftyComRX_DRIVETRAIN_FD_1_FD3_Pkt, signal-group=SystemSignalGroup_COM_Rx_DRIVETRAIN_FD_1_Pkt, type-mapping=sender-rec-record-type-mapping=record-element-mappings=[{implementation-record-element=CRC_DRIVETRAIN1, system-signal=SystemSignal_COM_Rx_CRC_DRIVETRAIN1}, {implementation-record-element=MessageCounter_DRIVETRAIN1, system-signal=SystemSignal_COM_Rx_MessageCounter_DRIVETRAIN1}, {implementation-record-element=DrvLnTrqRq, system-signal=SystemSignal_COM_Rx_DrvLnTrqRq}, {implementation-record-element=AWDSysStat, system-signal=SystemSignal_COM_Rx_AWDSysStat}, {implementation-record-element=DrvLnMinTrqMd, system-signal=SystemSignal_COM_Rx_DrvLnMinTrqMd}]}
        sender-receiver-to-signal-group-mapping={data-element=CPT_MDG1_FlatView.SysSftyComORCRxSignalsSR.SftyComRX_ORC_FD_2_FD3_Pkt, signal-group=SystemSignalGroup_COM_Rx_ORC_FD_2_Pkt, type-mapping=sender-rec-record-type-mapping=record-element-mappings=[{implementation-record-element=CRC_ORC2, system-signal=SystemSignal_COM_Rx_CRC_ORC2}, {implementation-record-element=MessageCounter_ORC2, system-signal=SystemSignal_COM_Rx_MessageCounter_ORC2}, {implementation-record-element=DrvSbltUnFltr_1, system-signal=SystemSignal_COM_Rx_DrvSbltUnFltr_1}]}
        sender-receiver-to-signal-group-mapping={data-element=CPT_MDG1_FlatView.SysSftyComORCRxSignalsSR.SftyComRX_ORC_FD_3_FD3_Pkt, signal-group=SystemSignalGroup_COM_Rx_ORC_FD_3_Pkt, type-mapping=sender-rec-record-type-mapping=record-element-mappings=[{implementation-record-element=CRC_ORC3, system-signal=SystemSignal_COM_Rx_CRC_ORC3}, {implementation-record-element=LongAccelerationFailSts, system-signal=SystemSignal_COM_Rx_LongAccelerationFailSts}, {implementation-record-element=LatAccelerationFailSts, system-signal=SystemSignal_COM_Rx_LatAccelerationFailSts}, {implementation-record-element=MessageCounter_ORC3, system-signal=SystemSignal_COM_Rx_MessageCounter_ORC3}, {implementation-record-element=LatAcceleration, system-signal=SystemSignal_COM_Rx_LatAcceleration}, {implementation-record-element=LongAcceleration, system-signal=SystemSignal_COM_Rx_LongAcceleration}]}
        sender-receiver-to-signal-group-mapping={data-element=CPT_MDG1_FlatView.SysSftyComTCMRxSignalsSR.SftyComRX_TRANSM_FD_1_FD3_Pkt, signal-group=SystemSignalGroup_COM_Rx_TRANSM_FD_1_Pkt, type-mapping=sender-rec-record-type-mapping=record-element-mappings=[{implementation-record-element=TrqCtrlModeReq, system-signal=SystemSignal_COM_Rx_TRANSM_FD_1_TrqCtrlModeReq}, {implementation-record-element=Ups_Inh_Act, system-signal=SystemSignal_COM_Rx_Ups_Inh_Act}, {implementation-record-element=Garage_SIP_Inh, system-signal=SystemSignal_COM_Rx_Garage_SIP_Inh}, {implementation-record-element=TorqueConverterSts, system-signal=SystemSignal_COM_Rx_TRANSM_FD_1_TorqueConverterSts}, {implementation-record-element=DisconnectClutch_Sts, system-signal=SystemSignal_COM_Rx_DisconnectClutch_Sts}, {implementation-record-element=TransmissionSailingSts, system-signal=SystemSignal_COM_Rx_TRANSM_FD_1_TransmissionSailingSts}, {implementation-record-element=TargetGear, system-signal=SystemSignal_COM_Rx_TRANSM_FD_1_TargetGear}, {implementation-record-element=PTO_Enbl, system-signal=SystemSignal_COM_Rx_PTO_Enbl}, {implementation-record-element=MaxTrqDes, system-signal=SystemSignal_COM_Rx_TRANSM_FD_1_MaxTrqDes}, {implementation-record-element=EngTrq_Rq_TCM, system-signal=SystemSignal_COM_Rx_TRANSM_FD_1_EngTrq_Rq_TCM}, {implementation-record-element=TorqueConverterSTO, system-signal=SystemSignal_COM_Rx_TRANSM_FD_1_TorqueConverterSTO}, {implementation-record-element=TransIntakeTorq, system-signal=SystemSignal_COM_Rx_TRANSM_FD_1_TransIntakeTorq}, {implementation-record-element=TransLosses, system-signal=SystemSignal_COM_Rx_TRANSM_FD_1_TransLosses}, {implementation-record-element=CODE_CLR_TCM, system-signal=SystemSignal_COM_Rx_TRANSM_FD_1_CODE_CLR_TCM}, {implementation-record-element=TCM_HillMode, system-signal=SystemSignal_COM_Rx_TCM_HillMode}, {implementation-record-element=REPRGD_PFC_CLR_TCM, system-signal=SystemSignal_COM_Rx_TRANSM_FD_1_REPRGD_PFC_CLR_TCM}, {implementation-record-element=TrqC_Temp, system-signal=SystemSignal_COM_Rx_TrqC_Temp}, {implementation-record-element=TorqueAmpTransmission, system-signal=SystemSignal_COM_Rx_TRANSM_FD_1_TorqueAmpTransmission}, {implementation-record-element=TxIdleRq, system-signal=SystemSignal_COM_Rx_TRANSM_FD_1_TxIdleRq}, {implementation-record-element=TCM_Comm_Fail_CAN, system-signal=SystemSignal_COM_Rx_TCM_Comm_Fail_CAN}, {implementation-record-element=PaddleShiftRequest, system-signal=SystemSignal_COM_Rx_TRANSM_FD_1_PaddleShiftRequest}, {implementation-record-element=TCASERANGESTATUS_TCM, system-signal=SystemSignal_COM_Rx_TRANSM_FD_1_TCASERANGESTATUS_TCM}, {implementation-record-element=DriveLineRatio, system-signal=SystemSignal_COM_Rx_TRANSM_FD_1_DriveLineRatio}, {implementation-record-element=Trans_Adapt_Status, system-signal=SystemSignal_COM_Rx_TRANSM_FD_1_Trans_Adapt_Status}, {implementation-record-element=MessageCounter_TRANSM1, system-signal=SystemSignal_COM_Rx_TRANSM_FD_1_MessageCounter_TRANSM1}, {implementation-record-element=TCM_ParkSL_Request, system-signal=SystemSignal_COM_Rx_TCM_ParkSL_Request}, {implementation-record-element=CRC_TRANSM1, system-signal=SystemSignal_COM_Rx_TRANSM_FD_1_CRC_TRANSM1}]}
        sender-receiver-to-signal-group-mapping={data-element=CPT_MDG1_FlatView.SysSftyComTCMRxSignalsSR.SftyComRX_TRANSM_FD_2_FD16_Pkt, signal-group=SystemSignalGroup_COM_Rx_TRANSM_FD_2_FD16_Pkt, type-mapping=sender-rec-record-type-mapping=record-element-mappings=[{implementation-record-element=Trans_ESS_Inhibit, system-signal=SystemSignal_COM_Rx_TRANSM_FD_2_FD16_Trans_ESS_Inhibit}, {implementation-record-element=GearEngagedForDisplay, system-signal=SystemSignal_COM_Rx_TRANSM_FD_2_FD16_GearEngagedForDisplay}, {implementation-record-element=AirFlowRequest_TCM, system-signal=SystemSignal_COM_Rx_TRANSM_FD_2_FD16_AirFlowRequest_TCM}, {implementation-record-element=TCM_EngFSO_Allw, system-signal=SystemSignal_COM_Rx_TCM_EngFSO_Allw}, {implementation-record-element=OUTPUT_SPEED, system-signal=SystemSignal_COM_Rx_TRANSM_FD_2_FD16_OUTPUT_SPEED}, {implementation-record-element=Trns_EMCC_Achvd, system-signal=SystemSignal_COM_Rx_TRANSM_FD_2_FD16_Trns_EMCC_Achvd}, {implementation-record-element=TransmissionTemperature, system-signal=SystemSignal_COM_Rx_TRANSM_FD_2_FD16_TransmissionTemperature}, {implementation-record-element=TurbineSpeed, system-signal=SystemSignal_COM_Rx_TRANSM_FD_2_FD16_TurbineSpeed}, {implementation-record-element=TCM_EngFSO_Rq, system-signal=SystemSignal_COM_Rx_TCM_EngFSO_Rq}, {implementation-record-element=EngShutOffRq_TCM, system-signal=SystemSignal_COM_Rx_TRANSM_FD_2_FD16_EngShutOffRq_TCM}, {implementation-record-element=TransReadyForESS, system-signal=SystemSignal_COM_Rx_TRANSM_FD_2_FD16_TransReadyForESS}, {implementation-record-element=TRNS_StpSt_FLT, system-signal=SystemSignal_COM_Rx_TRANSM_FD_2_FD16_TRNS_StpSt_FLT}, {implementation-record-element=TrqCtrlModeReq_Prdtd, system-signal=SystemSignal_COM_Rx_TrqCtrlModeReq_Prdtd}, {implementation-record-element=TCM_TrqGradLim_Up, system-signal=SystemSignal_COM_Rx_TCM_TrqGradLim_Up}, {implementation-record-element=TCM_TrqGradLim_Lo, system-signal=SystemSignal_COM_Rx_TCM_TrqGradLim_Lo}, {implementation-record-element=TCM_TrqGradLimActive, system-signal=SystemSignal_COM_Rx_TCM_TrqGradLimActive}]}
        sender-receiver-to-signal-group-mapping={data-element=CPT_MDG1_FlatView.SysSftyComTCMRxSignalsSR.SftyComRX_TRANSM_FD_2_FD3_Pkt, signal-group=SystemSignalGroup_COM_Rx_TRANSM_FD_2_Pkt, type-mapping=sender-rec-record-type-mapping=record-element-mappings=[{implementation-record-element=OutputSpdPolarity, system-signal=SystemSignal_COM_Rx_OutputSpdPolarity}, {implementation-record-element=Trans_ESS_Inhibit, system-signal=SystemSignal_COM_Rx_TRANSM_FD_2_Trans_ESS_Inhibit}, {implementation-record-element=GearEngagedForDisplay, system-signal=SystemSignal_COM_Rx_TRANSM_FD_2_GearEngagedForDisplay}, {implementation-record-element=AirFlowRequest_TCM, system-signal=SystemSignal_COM_Rx_TRANSM_FD_2_AirFlowRequest_TCM}, {implementation-record-element=EngBrkCanRq, system-signal=SystemSignal_COM_Rx_EngBrkCanRq}, {implementation-record-element=OUTPUT_SPEED, system-signal=SystemSignal_COM_Rx_TRANSM_FD_2_OUTPUT_SPEED}, {implementation-record-element=Trns_EMCC_Achvd, system-signal=SystemSignal_COM_Rx_TRANSM_FD_2_Trns_EMCC_Achvd}, {implementation-record-element=TransmissionTemperature, system-signal=SystemSignal_COM_Rx_TRANSM_FD_2_TransmissionTemperature}, {implementation-record-element=TurbineSpeed, system-signal=SystemSignal_COM_Rx_TRANSM_FD_2_TurbineSpeed}, {implementation-record-element=EngShutOffRq_TCM, system-signal=SystemSignal_COM_Rx_TRANSM_FD_2_EngShutOffRq_TCM}, {implementation-record-element=TransReadyForESS, system-signal=SystemSignal_COM_Rx_TRANSM_FD_2_TransReadyForESS}, {implementation-record-element=TRNS_StpSt_FLT, system-signal=SystemSignal_COM_Rx_TRANSM_FD_2_TRNS_StpSt_FLT}, {implementation-record-element=APCM_Rq, system-signal=SystemSignal_COM_Rx_TRANSM_FD_2_APCM_Rq}, {implementation-record-element=MessageCounter_TRANSM2, system-signal=SystemSignal_COM_Rx_TRANSM_FD_2_MessageCounter_TRANSM2}, {implementation-record-element=CRC_TRANSM2, system-signal=SystemSignal_COM_Rx_TRANSM_FD_2_CRC_TRANSM2}]}
        sender-receiver-to-signal-group-mapping={data-element=CPT_MDG1_FlatView.SysSftyComTCMRxSignalsSR.SftyComRX_TRANSM_FD_4_FD16_Pkt, signal-group=SystemSignalGroup_COM_Rx_TRANSM_FD_4_FD16_Pkt, type-mapping=sender-rec-record-type-mapping=record-element-mappings=[{implementation-record-element=CRC_TRANSM4, system-signal=SystemSignal_COM_Rx_TRANSM_FD_4_FD16_CRC_TRANSM4}, {implementation-record-element=MessageCounter_TRANSM4, system-signal=SystemSignal_COM_Rx_TRANSM_FD_4_FD16_MessageCounter_TRANSM4}, {implementation-record-element=MIReq, system-signal=SystemSignal_COM_Rx_TRANSM_FD_4_FD16_MIReq}, {implementation-record-element=TxDisengaged, system-signal=SystemSignal_COM_Rx_TRANSM_FD_4_FD16_TxDisengaged}, {implementation-record-element=ShiftMapNotAchieved, system-signal=SystemSignal_COM_Rx_TRANSM_FD_4_FD16_ShiftMapNotAchieved}, {implementation-record-element=TxDisengaged_Fault, system-signal=SystemSignal_COM_Rx_TRANSM_FD_4_FD16_TxDisengaged_Fault}, {implementation-record-element=ShiftInProgress, system-signal=SystemSignal_COM_Rx_TRANSM_FD_4_FD16_ShiftInProgress}, {implementation-record-element=LimpHomeSts, system-signal=SystemSignal_COM_Rx_TRANSM_FD_4_FD16_LimpHomeSts}, {implementation-record-element=ShiftLeverPosition, system-signal=SystemSignal_COM_Rx_TRANSM_FD_4_FD16_ShiftLeverPosition}, {implementation-record-element=GearEngaged, system-signal=SystemSignal_COM_Rx_TRANSM_FD_4_FD16_GearEngaged}, {implementation-record-element=ShiftModeSts, system-signal=SystemSignal_COM_Rx_TRANSM_FD_4_FD16_ShiftModeSts}, {implementation-record-element=DriveModeSts, system-signal=SystemSignal_COM_Rx_TRANSM_FD_4_FD16_DriveModeSts}]}
        sender-receiver-to-signal-group-mapping={data-element=CPT_MDG1_FlatView.SysSftyComTCMRxSignalsSR.SftyComRX_TRANSM_FD_4_FD3_Pkt, signal-group=SystemSignalGroup_COM_Rx_TRANSM_FD_4_Pkt, type-mapping=sender-rec-record-type-mapping=record-element-mappings=[{implementation-record-element=DriveModeSts, system-signal=SystemSignal_COM_Rx_TRANSM_FD_4_DriveModeSts}, {implementation-record-element=TransmissionFailSts, system-signal=SystemSignal_COM_Rx_TransmissionFailSts}, {implementation-record-element=ShiftModeSts, system-signal=SystemSignal_COM_Rx_TRANSM_FD_4_ShiftModeSts}, {implementation-record-element=GearEngaged, system-signal=SystemSignal_COM_Rx_TRANSM_FD_4_GearEngaged}, {implementation-record-element=ShiftLeverPosition, system-signal=SystemSignal_COM_Rx_TRANSM_FD_4_ShiftLeverPosition}, {implementation-record-element=LimpHomeSts, system-signal=SystemSignal_COM_Rx_TRANSM_FD_4_LimpHomeSts}, {implementation-record-element=CrankEnable, system-signal=SystemSignal_COM_Rx_CrankEnable}, {implementation-record-element=ShiftInProgress, system-signal=SystemSignal_COM_Rx_TRANSM_FD_4_ShiftInProgress}, {implementation-record-element=TxDisengaged_Fault, system-signal=SystemSignal_COM_Rx_TRANSM_FD_4_TxDisengaged_Fault}, {implementation-record-element=ShiftMapNotAchieved, system-signal=SystemSignal_COM_Rx_TRANSM_FD_4_ShiftMapNotAchieved}, {implementation-record-element=TxDisengaged, system-signal=SystemSignal_COM_Rx_TRANSM_FD_4_TxDisengaged}, {implementation-record-element=MIReq, system-signal=SystemSignal_COM_Rx_TRANSM_FD_4_MIReq}, {implementation-record-element=MessageCounter_TRANSM4, system-signal=SystemSignal_COM_Rx_TRANSM_FD_4_MessageCounter_TRANSM4}, {implementation-record-element=CRC_TRANSM4, system-signal=SystemSignal_COM_Rx_TRANSM_FD_4_CRC_TRANSM4}]}
        sender-receiver-to-signal-group-mapping={data-element=CPT_MDG1_FlatView.SysSftyComTCMRxSignalsSR.SftyComRX_TRANSM_FD_1_FD16_Pkt, signal-group=SystemSignalGroup_COM_Rx_TRANSM_FD_1_FD16_Pkt, type-mapping=sender-rec-record-type-mapping=record-element-mappings=[{implementation-record-element=TrqCtrlModeReq, system-signal=SystemSignal_COM_Rx_TRANSM_FD_1_FD16_TrqCtrlModeReq}, {implementation-record-element=TorqueConverterSts, system-signal=SystemSignal_COM_Rx_TRANSM_FD_1_FD16_TorqueConverterSts}, {implementation-record-element=TransmissionSailingSts, system-signal=SystemSignal_COM_Rx_TRANSM_FD_1_FD16_TransmissionSailingSts}, {implementation-record-element=TargetGear, system-signal=SystemSignal_COM_Rx_TRANSM_FD_1_FD16_TargetGear}, {implementation-record-element=MaxTrqDes, system-signal=SystemSignal_COM_Rx_TRANSM_FD_1_FD16_MaxTrqDes}, {implementation-record-element=EngTrq_Rq_TCM, system-signal=SystemSignal_COM_Rx_TRANSM_FD_1_FD16_EngTrq_Rq_TCM}, {implementation-record-element=TorqueConverterSTO, system-signal=SystemSignal_COM_Rx_TRANSM_FD_1_FD16_TorqueConverterSTO}, {implementation-record-element=EngTrq_Rq_TCM_Prdtd, system-signal=SystemSignal_COM_Rx_EngTrq_Rq_TCM_Prdtd}, {implementation-record-element=CrankEnable_Fast, system-signal=SystemSignal_COM_Rx_CrankEnable_Fast}, {implementation-record-element=TransIntakeTorq, system-signal=SystemSignal_COM_Rx_TRANSM_FD_1_FD16_TransIntakeTorq}, {implementation-record-element=TransLosses, system-signal=SystemSignal_COM_Rx_TRANSM_FD_1_FD16_TransLosses}, {implementation-record-element=CODE_CLR_TCM, system-signal=SystemSignal_COM_Rx_TRANSM_FD_1_FD16_CODE_CLR_TCM}, {implementation-record-element=REPRGD_PFC_CLR_TCM, system-signal=SystemSignal_COM_Rx_TRANSM_FD_1_FD16_REPRGD_PFC_CLR_TCM}, {implementation-record-element=PumpTrqOnImpShaft, system-signal=SystemSignal_COM_Rx_PumpTrqOnImpShaft}, {implementation-record-element=TorqueAmpTransmission, system-signal=SystemSignal_COM_Rx_TRANSM_FD_1_FD16_TorqueAmpTransmission}, {implementation-record-element=TxIdleRq, system-signal=SystemSignal_COM_Rx_TRANSM_FD_1_FD16_TxIdleRq}, {implementation-record-element=PaddleShiftRequest, system-signal=SystemSignal_COM_Rx_TRANSM_FD_1_FD16_PaddleShiftRequest}, {implementation-record-element=TCASERANGESTATUS_TCM, system-signal=SystemSignal_COM_Rx_TRANSM_FD_1_FD16_TCASERANGESTATUS_TCM}, {implementation-record-element=DriveLineRatio, system-signal=SystemSignal_COM_Rx_TRANSM_FD_1_FD16_DriveLineRatio}, {implementation-record-element=Trans_Adapt_Status, system-signal=SystemSignal_COM_Rx_TRANSM_FD_1_FD16_Trans_Adapt_Status}, {implementation-record-element=SubElMessageCounter_TRANSM1ement, system-signal=SystemSignal_COM_Rx_TRANSM_FD_1_FD16_MessageCounter_TRANSM1}, {implementation-record-element=CRC_TRANSM1, system-signal=SystemSignal_COM_Rx_TRANSM_FD_1_FD16_CRC_TRANSM1}]}
        sender-receiver-to-signal-group-mapping={data-element=CPT_MDG1_FlatView.SysSftyComTRSCMRxSignalsSR.SftyComRX_TRSCM_FD_1_FD3_Pkt, signal-group=SystemSignalGroup_COM_Rx_TRSCM_FD_1_FD3_Pkt, type-mapping=sender-rec-record-type-mapping=record-element-mappings=[{implementation-record-element=TRSC_STAT, system-signal=SystemSignal_COM_Rx_TRSC_STAT_FD3}, {implementation-record-element=TRSC_SpeedLimit_Req, system-signal=SystemSignal_COM_Rx_TRSC_SpeedLimit_Req_FD3}, {implementation-record-element=THA_SpeedLimit_Req, system-signal=SystemSignal_COM_Rx_THA_SpeedLimit_Req_FD3}, {implementation-record-element=THA_STAT, system-signal=SystemSignal_COM_Rx_THA_STAT_FD3}, {implementation-record-element=THA_Speed_Limit, system-signal=SystemSignal_COM_Rx_THA_Speed_Limit_FD3}, {implementation-record-element=MessageCounter_TRSCM1, system-signal=SystemSignal_COM_Rx_MessageCounter_TRSCM1_FD3}, {implementation-record-element=CRC_TRSCM1, system-signal=SystemSignal_COM_Rx_CRC_TRSCM1_FD3}]}
        sender-receiver-to-signal-group-mapping={data-element=CPT_MDG1_FlatView.SysSftyComTRSCMRxSignalsSR.SftyComRX_TRSCM_FD_1_FD14_Pkt, signal-group=SystemSignalGroup_COM_Rx_TRSCM_FD_1_FD14_Pkt, type-mapping=sender-rec-record-type-mapping=record-element-mappings=[{implementation-record-element=TRSC_STAT, system-signal=SystemSignal_COM_Rx_TRSC_STAT_FD14}, {implementation-record-element=TRSC_SpeedLimit_Req, system-signal=SystemSignal_COM_Rx_TRSC_SpeedLimit_Req_FD14}, {implementation-record-element=THA_SpeedLimit_Req, system-signal=SystemSignal_COM_Rx_THA_SpeedLimit_Req_FD14}, {implementation-record-element=THA_STAT, system-signal=SystemSignal_COM_Rx_THA_STAT_FD14}, {implementation-record-element=THA_Speed_Limit, system-signal=SystemSignal_COM_Rx_THA_Speed_Limit_FD14}, {implementation-record-element=MessageCounter_TRSCM1, system-signal=SystemSignal_COM_Rx_MessageCounter_TRSCM1_FD14}, {implementation-record-element=CRC_TRSCM1, system-signal=SystemSignal_COM_Rx_CRC_TRSCM1_FD14}]}
        sender-receiver-to-signal-group-mapping={data-element=CPT_MDG1_FlatView.SysSftyComVDCMRxSignalsSR.SftyComRX_PT_SYSTEM_FD_1_FD16_Pkt, signal-group=SystemSignalGroup_COM_Rx_PT_SYSTEM_FD_1_FD16_Pkt, type-mapping=sender-rec-record-type-mapping=record-element-mappings=[{implementation-record-element=OptimdStrtReqdActr, system-signal=SystemSignal_COM_Rx_OptimdStrtReqdActr}, {implementation-record-element=OptimdEngStrtStpType, system-signal=SystemSignal_COM_Rx_OptimdEngStrtStpType}, {implementation-record-element=Hyb_ProducingTorque, system-signal=SystemSignal_COM_Rx_Hyb_ProducingTorque}, {implementation-record-element=HCPFuelDisable, system-signal=SystemSignal_COM_Rx_HCPFuelDisable}, {implementation-record-element=OptimdEngOnOffCmd, system-signal=SystemSignal_COM_Rx_OptimdEngOnOffCmd}, {implementation-record-element=GasPedalPosition_PT, system-signal=SystemSignal_COM_Rx_PT_SYSTEM_FD_1_FD16_GasPedalPosition_PT}, {implementation-record-element=GasPedalPositionFailSts_PT, system-signal=SystemSignal_COM_Rx_PT_SYSTEM_FD_1_FD16_GasPedalPositionFailSts_PT}, {implementation-record-element=MessageCounter_PT_SYSTEM_FD_1, system-signal=SystemSignal_COM_Rx_PT_SYSTEM_FD_1_FD16_MessageCounter_PT_SYSTEM_FD_1}, {implementation-record-element=CRC_PT_SYSTEM_FD_1, system-signal=SystemSignal_COM_Rx_PT_SYSTEM_FD_1_FD16_CRC_PT_SYSTEM_FD_1}]}
        sender-receiver-to-signal-group-mapping={data-element=CPT_MDG1_FlatView.SysSftyComVDCMRxSignalsSR.SftyComRX_HYBRID_POWERTRAIN5_FD16_Pkt, signal-group=SystemSignalGroup_COM_Rx_HYBRID_POWERTRAIN5_FD16_Pkt, type-mapping=sender-rec-record-type-mapping=record-element-mappings=[{implementation-record-element=HEV_HybPwrtrnRdcdPerfCmnd, system-signal=SystemSignal_COM_Rx_HYBRID_POWERTRAIN5_FD16_HEV_HybPwrtrnRdcdPerfCmnd}, {implementation-record-element=HCP_HoodAjar, system-signal=SystemSignal_COM_Rx_HCP_HoodAjar}, {implementation-record-element=IdleCLoopTrq, system-signal=SystemSignal_COM_Rx_HYBRID_POWERTRAIN5_FD16_IdleCLoopTrq}, {implementation-record-element=HCPMaxEngRPM, system-signal=SystemSignal_COM_Rx_HYBRID_POWERTRAIN5_FD16_HCPMaxEngRPM}, {implementation-record-element=MessageCounter_HYBRID_POWERTRAIN5, system-signal=SystemSignal_COM_Rx_HYBRID_POWERTRAIN5_FD16_MessageCounter_HYBRID_POWERTRAIN5}, {implementation-record-element=CRC_HYBRID_POWERTRAIN5, system-signal=SystemSignal_COM_Rx_HYBRID_POWERTRAIN5_FD16_CRC_HYBRID_POWERTRAIN5}]}
        sender-receiver-to-signal-group-mapping={data-element=CPT_MDG1_FlatView.SysSftyComVDCMRxSignalsSR.SftyComRX_LV_CHARGER1_FD3_Pkt, signal-group=SystemSignalGroup_COM_Rx_LV_CHARGER1_Pkt, type-mapping=sender-rec-record-type-mapping=record-element-mappings=[{implementation-record-element=CRC_LV_CHARGER1, system-signal=SystemSignal_COM_Rx_CRC_LV_CHARGER1}, {implementation-record-element=MessageCounter_LV_CHARGER1, system-signal=SystemSignal_COM_Rx_MessageCounter_LV_CHARGER1}, {implementation-record-element=HVDC_VoltageFeedback, system-signal=SystemSignal_COM_Rx_HVDC_VoltageFeedback}, {implementation-record-element=LVDC_CurrentFeedback, system-signal=SystemSignal_COM_Rx_LVDC_CurrentFeedback}, {implementation-record-element=HVDC_CurrentFeedback, system-signal=SystemSignal_COM_Rx_HVDC_CurrentFeedback}, {implementation-record-element=DCDC_OperationModeSts, system-signal=SystemSignal_COM_Rx_DCDC_OperationModeSts}]}
        sender-receiver-to-signal-group-mapping={data-element=CPT_MDG1_FlatView.SysSftyComVDCMRxSignalsSR.SftyComRX_HYBRID_POWERTRAIN5_FD3_Pkt, signal-group=SystemSignalGroup_COM_Rx_HYBRID_POWERTRAIN5_Pkt, type-mapping=sender-rec-record-type-mapping=record-element-mappings=[{implementation-record-element=Hybrid_EVT_ModeSts, system-signal=SystemSignal_COM_Rx_Hybrid_EVT_ModeSts}, {implementation-record-element=Force_Park_Neutral, system-signal=SystemSignal_COM_Rx_Force_Park_Neutral}, {implementation-record-element=Hybrid_Immobilizer_Status, system-signal=SystemSignal_COM_Rx_Hybrid_Immobilizer_Status}, {implementation-record-element=HybridEmissionsMalfunction, system-signal=SystemSignal_COM_Rx_HybridEmissionsMalfunction}, {implementation-record-element=HCP_Stop_Start_Fault, system-signal=SystemSignal_COM_Rx_HCP_Stop_Start_Fault}, {implementation-record-element=HEV_HybPwrtrnRdcdPerfCmnd, system-signal=SystemSignal_COM_Rx_HYBRID_POWERTRAIN5_HEV_HybPwrtrnRdcdPerfCmnd}, {implementation-record-element=PowerShot_EVCU, system-signal=SystemSignal_COM_Rx_PowerShot_EVCU}, {implementation-record-element=Hybrid_AGSPosition, system-signal=SystemSignal_COM_Rx_Hybrid_AGSPosition}, {implementation-record-element=Propulsion_Raceoptions_Status, system-signal=SystemSignal_COM_Rx_Propulsion_Raceoptions_Status}, {implementation-record-element=IdleCLoopTrq, system-signal=SystemSignal_COM_Rx_HYBRID_POWERTRAIN5_IdleCLoopTrq}, {implementation-record-element=ElectricTrqMult4Pedal, system-signal=SystemSignal_COM_Rx_ElectricTrqMult4Pedal}, {implementation-record-element=HCPMaxEngRPM, system-signal=SystemSignal_COM_Rx_HYBRID_POWERTRAIN5_HCPMaxEngRPM}, {implementation-record-element=Motor2PowerUse_DisplayV, system-signal=SystemSignal_COM_Rx_Motor2PowerUse_DisplayV}, {implementation-record-element=Motor1PowerUse_DisplayV, system-signal=SystemSignal_COM_Rx_Motor1PowerUse_DisplayV}, {implementation-record-element=BattPowerUse_DisplayV, system-signal=SystemSignal_COM_Rx_BattPowerUse_DisplayV}, {implementation-record-element=Smartload_Actv, system-signal=SystemSignal_COM_Rx_Smartload_Actv}, {implementation-record-element=Hybrid_AGS2Position, system-signal=SystemSignal_COM_Rx_Hybrid_AGS2Position}, {implementation-record-element=Motor1PowerUse_Display, system-signal=SystemSignal_COM_Rx_Motor1PowerUse_Display}, {implementation-record-element=Launch_Torque, system-signal=SystemSignal_COM_Rx_Launch_Torque}, {implementation-record-element=Motor2PowerUse_Display, system-signal=SystemSignal_COM_Rx_Motor2PowerUse_Display}, {implementation-record-element=BattPowerUse_Display, system-signal=SystemSignal_COM_Rx_BattPowerUse_Display}, {implementation-record-element=MotorsPowerUse_Display, system-signal=SystemSignal_COM_Rx_MotorsPowerUse_Display}, {implementation-record-element=MessageCounter_HYBRID_POWERTRAIN5, system-signal=SystemSignal_COM_Rx_HYBRID_POWERTRAIN5_MessageCounter_HYBRID_POWERTRAIN5}, {implementation-record-element=MotorsPowerUse_DisplayV, system-signal=SystemSignal_COM_Rx_MotorsPowerUse_DisplayV}, {implementation-record-element=CRC_HYBRID_POWERTRAIN5, system-signal=SystemSignal_COM_Rx_HYBRID_POWERTRAIN5_CRC_HYBRID_POWERTRAIN5}]}
        sender-receiver-to-signal-group-mapping={data-element=CPT_MDG1_FlatView.SysSftyComVDCMRxSignalsSR.SftyComRX_HYBRID_POWERTRAIN2_FD3_Pkt, signal-group=SystemSignalGroup_COM_Rx_HYBRID_POWERTRAIN2_Pkt, type-mapping=sender-rec-record-type-mapping=record-element-mappings=[{implementation-record-element=AHH_ModifyAccel_Req, system-signal=SystemSignal_COM_Rx_AHH_ModifyAccel_Req}, {implementation-record-element=PropulsionMode, system-signal=SystemSignal_COM_Rx_HYBRID_POWERTRAIN2_PropulsionMode}, {implementation-record-element=AeCoast_Ramp, system-signal=SystemSignal_COM_Rx_AeCoast_Ramp}, {implementation-record-element=BSGChrgIdleSpeedTarget, system-signal=SystemSignal_COM_Rx_BSGChrgIdleSpeedTarget}, {implementation-record-element=HybridEngineMaxTorqAllowed, system-signal=SystemSignal_COM_Rx_HYBRID_POWERTRAIN2_HybridEngineMaxTorqAllowed}, {implementation-record-element=BSGActualTorque, system-signal=SystemSignal_COM_Rx_BSGActualTorque}, {implementation-record-element=CODE_CLR_HCP, system-signal=SystemSignal_COM_Rx_CODE_CLR_HCP}, {implementation-record-element=MaxRegenStat, system-signal=SystemSignal_COM_Rx_MaxRegenStat}, {implementation-record-element=IdleSpeedActiveSts, system-signal=SystemSignal_COM_Rx_HYBRID_POWERTRAIN2_IdleSpeedActiveSts}, {implementation-record-element=REPRGD_PFC_CLR_HCP, system-signal=SystemSignal_COM_Rx_REPRGD_PFC_CLR_HCP}, {implementation-record-element=EstRegenBrkFWTorq, system-signal=SystemSignal_COM_Rx_EstRegenBrkFWTorq}, {implementation-record-element=MessageCounter_HYBRID_POWERTRAIN2, system-signal=SystemSignal_COM_Rx_HYBRID_POWERTRAIN2_MessageCounter_HYBRID_POWERTRAIN2}, {implementation-record-element=CRC_HYBRID_POWERTRAIN2, system-signal=SystemSignal_COM_Rx_HYBRID_POWERTRAIN2_CRC_HYBRID_POWERTRAIN2}]}
        sender-receiver-to-signal-group-mapping={data-element=CPT_MDG1_FlatView.SysSftyComVDCMRxSignalsSR.SftyComRX_HYBRID_POWERTRAIN2_FD16_Pkt, signal-group=SystemSignalGroup_COM_Rx_HYBRID_POWERTRAIN2_FD16_Pkt, type-mapping=sender-rec-record-type-mapping=record-element-mappings=[{implementation-record-element=PropulsionMode, system-signal=SystemSignal_COM_Rx_HYBRID_POWERTRAIN2_FD16_PropulsionMode}, {implementation-record-element=HybridEngineMaxTorqAllowed, system-signal=SystemSignal_COM_Rx_HYBRID_POWERTRAIN2_FD16_HybridEngineMaxTorqAllowed}, {implementation-record-element=IdleSpeedActiveSts, system-signal=SystemSignal_COM_Rx_HYBRID_POWERTRAIN2_FD16_IdleSpeedActiveSts}, {implementation-record-element=MessageCounter_HYBRID_POWERTRAIN2, system-signal=SystemSignal_COM_Rx_HYBRID_POWERTRAIN2_FD16_MessageCounter_HYBRID_POWERTRAIN2}, {implementation-record-element=CRC_HYBRID_POWERTRAIN2, system-signal=SystemSignal_COM_Rx_HYBRID_POWERTRAIN2_FD16_CRC_HYBRID_POWERTRAIN2}]}
        sender-receiver-to-signal-group-mapping={data-element=CPT_MDG1_FlatView.SysSftyComVDCMRxSignalsSR.SftyComRX_HYBRID_POWERTRAIN1_FD16_Pkt, signal-group=SystemSignalGroup_COM_Rx_HYBRID_POWERTRAIN1_FD16_Pkt, type-mapping=sender-rec-record-type-mapping=record-element-mappings=[{implementation-record-element=TransInpSpdPrfl, system-signal=SystemSignal_COM_Rx_HYBRID_POWERTRAIN1_FD16_TransInpSpdPrfl}, {implementation-record-element=HybCmndEngTorqImmed, system-signal=SystemSignal_COM_Rx_HYBRID_POWERTRAIN1_FD16_HybCmndEngTorqImmed}, {implementation-record-element=HybCmndEngTorqPrdtd, system-signal=SystemSignal_COM_Rx_HYBRID_POWERTRAIN1_FD16_HybCmndEngTorqPrdtd}, {implementation-record-element=HybEstEngTorq, system-signal=SystemSignal_COM_Rx_HYBRID_POWERTRAIN1_FD16_HybEstEngTorq}, {implementation-record-element=InputSpdRaw, system-signal=SystemSignal_COM_Rx_HYBRID_POWERTRAIN1_FD16_InputSpdRaw}, {implementation-record-element=EngTrqReserveCmd, system-signal=SystemSignal_COM_Rx_HYBRID_POWERTRAIN1_FD16_EngTrqReserveCmd}, {implementation-record-element=HybCmndEngTorqRespTyp, system-signal=SystemSignal_COM_Rx_HYBRID_POWERTRAIN1_FD16_HybCmndEngTorqRespTyp}, {implementation-record-element=HybEstEngTorqV, system-signal=SystemSignal_COM_Rx_HYBRID_POWERTRAIN1_FD16_HybEstEngTorqV}, {implementation-record-element=HybCrnkAbrted, system-signal=SystemSignal_COM_Rx_HYBRID_POWERTRAIN1_FD16_HybCrnkAbrted}, {implementation-record-element=EngCntrlMode, system-signal=SystemSignal_COM_Rx_HYBRID_POWERTRAIN1_FD16_EngCntrlMode}, {implementation-record-element=Hybrid_Remedial_Stop, system-signal=SystemSignal_COM_Rx_HYBRID_POWERTRAIN1_FD16_Hybrid_Remedial_Stop}, {implementation-record-element=HybFeedback_Engine, system-signal=SystemSignal_COM_Rx_HYBRID_POWERTRAIN1_FD16_HybFeedback_Engine}, {implementation-record-element=ECMPrepIdleRes, system-signal=SystemSignal_COM_Rx_HYBRID_POWERTRAIN1_FD16_ECMPrepIdleRes}, {implementation-record-element=PropulsionSystemActive, system-signal=SystemSignal_COM_Rx_HYBRID_POWERTRAIN1_FD16_PropulsionSystemActive}, {implementation-record-element=MessageCounter_HYBRID_POWERTRAIN1, system-signal=SystemSignal_COM_Rx_HYBRID_POWERTRAIN1_FD16_MessageCounter_HYBRID_POWERTRAIN1}, {implementation-record-element=CRC_HYBRID_POWERTRAIN1, system-signal=SystemSignal_COM_Rx_HYBRID_POWERTRAIN1_FD16_CRC_HYBRID_POWERTRAIN1}]}
        sender-receiver-to-signal-group-mapping={data-element=CPT_MDG1_FlatView.SysSftyComVDCMRxSignalsSR.SftyComRX_HYBRID_POWERTRAIN1_FD3_Pkt, signal-group=SystemSignalGroup_COM_Rx_HYBRID_POWERTRAIN1_FD3_Pkt, type-mapping=sender-rec-record-type-mapping=record-element-mappings=[{implementation-record-element=HCP_VTD_Freeze, system-signal=SystemSignal_COM_Rx_HCP_VTD_Freeze}, {implementation-record-element=NiTi_Disable, system-signal=SystemSignal_COM_Rx_NiTi_Disable}, {implementation-record-element=MinCreepWheelTrq, system-signal=SystemSignal_COM_Rx_MinCreepWheelTrq}, {implementation-record-element=Belt_Slip_Detected, system-signal=SystemSignal_COM_Rx_Belt_Slip_Detected}, {implementation-record-element=TransInpSpdPrfl, system-signal=SystemSignal_COM_Rx_HYBRID_POWERTRAIN1_FD3_TransInpSpdPrfl}, {implementation-record-element=HCP_Comm_Fail_CAN, system-signal=SystemSignal_COM_Rx_HCP_Comm_Fail_CAN}, {implementation-record-element=RollingIdleSpeedTarget, system-signal=SystemSignal_COM_Rx_RollingIdleSpeedTarget}, {implementation-record-element=HybCmndEngTorqImmed, system-signal=SystemSignal_COM_Rx_HYBRID_POWERTRAIN1_FD3_HybCmndEngTorqImmed}, {implementation-record-element=HybCmndEngTorqPrdtd, system-signal=SystemSignal_COM_Rx_HYBRID_POWERTRAIN1_FD3_HybCmndEngTorqPrdtd}, {implementation-record-element=HybEstEngTorq, system-signal=SystemSignal_COM_Rx_HYBRID_POWERTRAIN1_FD3_HybEstEngTorq}, {implementation-record-element=InputSpdRaw, system-signal=SystemSignal_COM_Rx_HYBRID_POWERTRAIN1_FD3_InputSpdRaw}, {implementation-record-element=RegenTarget, system-signal=SystemSignal_COM_Rx_RegenTarget}, {implementation-record-element=BSGMaxTrqDyn, system-signal=SystemSignal_COM_Rx_BSGMaxTrqDyn}, {implementation-record-element=BSGMinTrqDyn, system-signal=SystemSignal_COM_Rx_BSGMinTrqDyn}, {implementation-record-element=HybTransSt, system-signal=SystemSignal_COM_Rx_HybTransSt}, {implementation-record-element=EngTrqReserveCmd, system-signal=SystemSignal_COM_Rx_HYBRID_POWERTRAIN1_FD3_EngTrqReserveCmd}, {implementation-record-element=Hyb_EngStrtStopType, system-signal=SystemSignal_COM_Rx_Hyb_EngStrtStopType}, {implementation-record-element=HEV_ESS_Mode, system-signal=SystemSignal_COM_Rx_HEV_ESS_Mode}, {implementation-record-element=HybCmndEngTorqRespTyp, system-signal=SystemSignal_COM_Rx_HYBRID_POWERTRAIN1_FD3_HybCmndEngTorqRespTyp}, {implementation-record-element=HybEstEngTorqV, system-signal=SystemSignal_COM_Rx_HYBRID_POWERTRAIN1_FD3_HybEstEngTorqV}, {implementation-record-element=HybDFCO_Req, system-signal=SystemSignal_COM_Rx_HybDFCO_Req}, {implementation-record-element=HybCrnkAbrted, system-signal=SystemSignal_COM_Rx_HYBRID_POWERTRAIN1_FD3_HybCrnkAbrted}, {implementation-record-element=EngCntrlMode, system-signal=SystemSignal_COM_Rx_HYBRID_POWERTRAIN1_FD3_EngCntrlMode}, {implementation-record-element=MinCreepWheelTrq_Enable, system-signal=SystemSignal_COM_Rx_MinCreepWheelTrq_Enable}, {implementation-record-element=NiTi_Achieved, system-signal=SystemSignal_COM_Rx_NiTi_Achieved}, {implementation-record-element=HybEngCylDeactReq, system-signal=SystemSignal_COM_Rx_HybEngCylDeactReq}, {implementation-record-element=Hybrid_Remedial_Stop, system-signal=SystemSignal_COM_Rx_HYBRID_POWERTRAIN1_FD3_Hybrid_Remedial_Stop}, {implementation-record-element=EngActDmpgDsblReq, system-signal=SystemSignal_COM_Rx_EngActDmpgDsblReq}, {implementation-record-element=Eng_Off_Allowed, system-signal=SystemSignal_COM_Rx_Eng_Off_Allowed}, {implementation-record-element=HybFstTrqRq_Trans, system-signal=SystemSignal_COM_Rx_HybFstTrqRq_Trans}, {implementation-record-element=HybFeedback_Engine, system-signal=SystemSignal_COM_Rx_HYBRID_POWERTRAIN1_FD3_HybFeedback_Engine}, {implementation-record-element=ECMPrepIdleRes, system-signal=SystemSignal_COM_Rx_HYBRID_POWERTRAIN1_FD3_ECMPrepIdleRes}, {implementation-record-element=Hyb_MotorB_Speed, system-signal=SystemSignal_COM_Rx_Hyb_MotorB_Speed}, {implementation-record-element=Hyb_SumTorqueMin, system-signal=SystemSignal_COM_Rx_Hyb_SumTorqueMin}, {implementation-record-element=Hyb_SumTorqueMax, system-signal=SystemSignal_COM_Rx_Hyb_SumTorqueMax}, {implementation-record-element=Hyb_SumTorqueStatic, system-signal=SystemSignal_COM_Rx_Hyb_SumTorqueStatic}, {implementation-record-element=PropulsionSystemActive, system-signal=SystemSignal_COM_Rx_HYBRID_POWERTRAIN1_FD3_PropulsionSystemActive}, {implementation-record-element=LV_SystemFailure, system-signal=SystemSignal_COM_Rx_LV_SystemFailure}, {implementation-record-element=GeneratorSetpointOverride, system-signal=SystemSignal_COM_Rx_GeneratorSetpointOverride}, {implementation-record-element=DriveModeSts_EPT, system-signal=SystemSignal_COM_Rx_DriveModeSts_EPT}, {implementation-record-element=MessageCounter_HYBRID_POWERTRAIN1, system-signal=SystemSignal_COM_Rx_HYBRID_POWERTRAIN1_FD3_MessageCounter_HYBRID_POWERTRAIN1}, {implementation-record-element=ShiftRangeState, system-signal=SystemSignal_COM_Rx_ShiftRangeState}, {implementation-record-element=CRC_HYBRID_POWERTRAIN1, system-signal=SystemSignal_COM_Rx_HYBRID_POWERTRAIN1_FD3_CRC_HYBRID_POWERTRAIN1}]}
        sender-receiver-to-signal-group-mapping={data-element=CPT_MDG1_FlatView.RP_COM_Rx_IMMO_CODE_RESPONSE.VD_COM_Rx_IMMO_CODE_RESPONSE_Pkt, signal-group=SystemSignalGroup_COM_Rx_IMMO_CODE_RESPONSE_Pkt, type-mapping=sender-rec-record-type-mapping=record-element-mappings=[{application-record-element=ControlEncodingRsp, system-signal=SystemSignal_COM_Rx_ControlEncodingRsp}, {application-record-element=MKKey1org21, system-signal=SystemSignal_COM_Rx_MKKey1org21}, {application-record-element=MKKey2org22, system-signal=SystemSignal_COM_Rx_MKKey2org22}, {application-record-element=MKKey_3, system-signal=SystemSignal_COM_Rx_MKKey_3}, {application-record-element=MKKey_4, system-signal=SystemSignal_COM_Rx_MKKey_4}, {application-record-element=MKKey_5, system-signal=SystemSignal_COM_Rx_MKKey_5}, {application-record-element=MKKey_6, system-signal=SystemSignal_COM_Rx_MKKey_6}]}
        sender-receiver-to-signal-group-mapping={data-element=CPT_MDG1_FlatView.PP_COM_Tx_ENGINE_FD_3_FD3.VD_COM_Tx_ENGINE_FD_3_FD, signal-group=SystemSignalGroup_COM_Tx_ENGINE_FD_3_FD, type-mapping=sender-rec-record-type-mapping=record-element-mappings=[{application-record-element=AfterRunCoolantPumpFailSts_FD3, system-signal=SystemSignal_COM_Tx_AfterRunCoolantPumpFailSts_FD3}, {application-record-element=AxleInAir_Stat_FD3, system-signal=SystemSignal_COM_Tx_AxleInAir_Stat_FD3}, {application-record-element=CC_SetSpdDspl_KPH_FD3, system-signal=SystemSignal_COM_Tx_CC_SetSpdDspl_KPH_FD3}, {application-record-element=CC_SetSpdDspl_MPH_FD3, system-signal=SystemSignal_COM_Tx_CC_SetSpdDspl_MPH_FD3}, {application-record-element=CoolVlvPos_FD3, system-signal=SystemSignal_COM_Tx_CoolVlvPos_FD3}, {application-record-element=CruiseControlLampSts_FD3, system-signal=SystemSignal_COM_Tx_CruiseControlLampSts_FD3}, {application-record-element=CruiseControlSts_FD3, system-signal=SystemSignal_COM_Tx_CruiseControlSts_FD3}, {application-record-element=DefFuelEcon_FD3, system-signal=SystemSignal_COM_Tx_DefFuelEcon_FD3}, {application-record-element=DistOilLifeRst_FD3, system-signal=SystemSignal_COM_Tx_DistOilLifeRst_FD3}, {application-record-element=ECM_Thermal_AAD_Request_FD3, system-signal=SystemSignal_COM_Tx_ECM_Thermal_AAD_Request_FD3}, {application-record-element=EngineOilCritical_FD3, system-signal=SystemSignal_COM_Tx_EngineOilCritical_FD3}, {application-record-element=EngineOilLevel_FD3, system-signal=SystemSignal_COM_Tx_EngineOilLevel_FD3}, {application-record-element=EngineOilMin_FD3, system-signal=SystemSignal_COM_Tx_EngineOilMin_FD3}, {application-record-element=EngineOilOverfill_FD3, system-signal=SystemSignal_COM_Tx_EngineOilOverfill_FD3}, {application-record-element=EngineOilTemperature_FD3, system-signal=SystemSignal_COM_Tx_EngineOilTemperature_FD3}, {application-record-element=FANStatus_FD3, system-signal=SystemSignal_COM_Tx_FANStatus_FD3}, {application-record-element=ISASts_FD3, system-signal=SystemSignal_COM_Tx_ISASts_FD3}, {application-record-element=OIL_IND_LMP_FLSH_FD3, system-signal=SystemSignal_COM_Tx_OIL_IND_LMP_FLSH_FD3}, {application-record-element=OIL_TEMP_CHM_RQ_FD3, system-signal=SystemSignal_COM_Tx_OIL_TEMP_CHM_RQ_FD3}, {application-record-element=OIL_TEMP_IND_RQ_FD3, system-signal=SystemSignal_COM_Tx_OIL_TEMP_IND_RQ_FD3}, {application-record-element=OilLifeLeftRst_FD3, system-signal=SystemSignal_COM_Tx_OilLifeLeftRst_FD3}, {application-record-element=OilLifeLeft_FD3, system-signal=SystemSignal_COM_Tx_OilLifeLeft_FD3}, {application-record-element=Override_FD3, system-signal=SystemSignal_COM_Tx_Override_FD3}, {application-record-element=PT_WorkSite_Invtr_Capacity_ECM, system-signal=SystemSignal_COM_Tx_PT_WorkSite_Invtr_Capacity_ECM}, {application-record-element=PT_WorkSite_Invtr_Sts_ECM_FD3, system-signal=SystemSignal_COM_Tx_PT_WorkSite_Invtr_Sts_ECM_FD3}, {application-record-element=SpeedLimitSts_FD3, system-signal=SystemSignal_COM_Tx_SpeedLimitSts_FD3}]}
        sender-receiver-to-signal-group-mapping={data-element=CPT_MDG1_FlatView.PP_COM_Tx_ENGINE_FD_7_FD3.VD_COM_Tx_ENGINE_FD_7_FD, signal-group=SystemSignalGroup_COM_Tx_ENGINE_FD_7_FD, type-mapping=sender-rec-record-type-mapping=record-element-mappings=[{application-record-element=CompressorSts_FD3, system-signal=SystemSignal_COM_Tx_CompressorSts_FD3}, {application-record-element=ECM_THA_Resp_FD3, system-signal=SystemSignal_COM_Tx_ECM_THA_Resp_FD3}, {application-record-element=ECM_TRSC_Resp_FD3, system-signal=SystemSignal_COM_Tx_ECM_TRSC_Resp_FD3}, {application-record-element=ECM_WARN_BTO_1_FD3, system-signal=SystemSignal_COM_Tx_ECM_WARN_BTO_1_FD3}, {application-record-element=ECM_WARN_BTO_FD3, system-signal=SystemSignal_COM_Tx_ECM_WARN_BTO_FD3}, {application-record-element=ECM_WARN_FD3, system-signal=SystemSignal_COM_Tx_ECM_WARN_FD3}, {application-record-element=EMSFailSts_FD3, system-signal=SystemSignal_COM_Tx_EMSFailSts_FD3}, {application-record-element=ETCFailSts_FD3, system-signal=SystemSignal_COM_Tx_ETCFailSts_FD3}, {application-record-element=EngineOperatingMode_FD3, system-signal=SystemSignal_COM_Tx_EngineOperatingMode_FD3}, {application-record-element=ExhaustTemperature_FD3, system-signal=SystemSignal_COM_Tx_ExhaustTemperature_FD3}, {application-record-element=FuelMM_Sts_FD3, system-signal=SystemSignal_COM_Tx_FuelMM_Sts_FD3}, {application-record-element=GPFServiceSts_FD3, system-signal=SystemSignal_COM_Tx_GPFServiceSts_FD3}, {application-record-element=HoursOilLifeRst_FD3, system-signal=SystemSignal_COM_Tx_HoursOilLifeRst_FD3}, {application-record-element=KNK_MG_TRIGGER_FD3, system-signal=SystemSignal_COM_Tx_KNK_MG_TRIGGER_FD3}, {application-record-element=MntncSts_FD3, system-signal=SystemSignal_COM_Tx_MntncSts_FD3}, {application-record-element=OilLifeSts_FD3, system-signal=SystemSignal_COM_Tx_OilLifeSts_FD3}, {application-record-element=OilPressureSts_FD3, system-signal=SystemSignal_COM_Tx_OilPressureSts_FD3}, {application-record-element=SpStDispstat_FD3, system-signal=SystemSignal_COM_Tx_SpStDispstat_FD3}, {application-record-element=SpStIndRq_FD3, system-signal=SystemSignal_COM_Tx_SpStIndRq_FD3}, {application-record-element=SpStSwStat_FD3, system-signal=SystemSignal_COM_Tx_SpStSwStat_FD3}]}
        sender-receiver-to-signal-group-mapping={data-element=CPT_MDG1_FlatView.PP_COM_Tx_ENGINE_FD_DIESEL.VD_COM_Tx_ENGINE_FD_DIESEL, signal-group=SystemSignalGroup_COM_Tx_ENGINE_FD_DIESEL, type-mapping=sender-rec-record-type-mapping=record-element-mappings=[{application-record-element=AdblueRemainDist, system-signal=SystemSignal_COM_Tx_AdblueRemainDist}, {application-record-element=Adblue_FL_LVL, system-signal=SystemSignal_COM_Tx_Adblue_FL_LVL}, {application-record-element=Adblue_Stat, system-signal=SystemSignal_COM_Tx_Adblue_Stat}, {application-record-element=CoolLo, system-signal=SystemSignal_COM_Tx_CoolLo}, {application-record-element=CountDown, system-signal=SystemSignal_COM_Tx_CountDown}, {application-record-element=DEF_LOW, system-signal=SystemSignal_COM_Tx_DEF_LOW}, {application-record-element=DPF_Man_Stat, system-signal=SystemSignal_COM_Tx_DPF_Man_Stat}, {application-record-element=EB_ACC_AVLBL, system-signal=SystemSignal_COM_Tx_EB_ACC_AVLBL}, {application-record-element=EB_Pwr, system-signal=SystemSignal_COM_Tx_EB_Pwr}, {application-record-element=EB_Stat3, system-signal=SystemSignal_COM_Tx_EB_Stat3}, {application-record-element=ECM_HMI_Timer_RQ, system-signal=SystemSignal_COM_Tx_ECM_HMI_Timer_RQ}, {application-record-element=EngBrkStat, system-signal=SystemSignal_COM_Tx_EngBrkStat}, {application-record-element=EngChmRq, system-signal=SystemSignal_COM_Tx_EngChmRq}, {application-record-element=FuelFltrAck, system-signal=SystemSignal_COM_Tx_FuelFltrAck}, {application-record-element=FuelFltrLeft, system-signal=SystemSignal_COM_Tx_FuelFltrLeft}, {application-record-element=FuelFltrRq, system-signal=SystemSignal_COM_Tx_FuelFltrRq}, {application-record-element=IdleShutDwnAppl, system-signal=SystemSignal_COM_Tx_IdleShutDwnAppl}, {application-record-element=Man_PFW_Stat, system-signal=SystemSignal_COM_Tx_Man_PFW_Stat}, {application-record-element=Man_PFW_Timer, system-signal=SystemSignal_COM_Tx_Man_PFW_Timer}, {application-record-element=PFW_Stat, system-signal=SystemSignal_COM_Tx_PFW_Stat}, {application-record-element=PF_RgnActv, system-signal=SystemSignal_COM_Tx_PF_RgnActv}, {application-record-element=PrcntCplt, system-signal=SystemSignal_COM_Tx_PrcntCplt}, {application-record-element=PreHtIndLmp_On_Rq, system-signal=SystemSignal_COM_Tx_PreHtIndLmp_On_Rq}, {application-record-element=PreHtlmpwithEVIC_On_Rq, system-signal=SystemSignal_COM_Tx_PreHtlmpwithEVIC_On_Rq}, {application-record-element=Rapid_Cabin_Warmup_Stat, system-signal=SystemSignal_COM_Tx_Rapid_Cabin_Warmup_Stat}, {application-record-element=RemainDistUnt, system-signal=SystemSignal_COM_Tx_RemainDistUnt}, {application-record-element=SRV_AIR_FLTR, system-signal=SystemSignal_COM_Tx_SRV_AIR_FLTR}, {application-record-element=SRV_CCV_FLTR, system-signal=SystemSignal_COM_Tx_SRV_CCV_FLTR}, {application-record-element=WtrFuelIndLmp_On_Rq, system-signal=SystemSignal_COM_Tx_WtrFuelIndLmp_On_Rq}]}
        sender-receiver-to-signal-group-mapping={data-element=CPT_MDG1_FlatView.PP_COM_Tx_ENGINE_FD_3_FD14.VD_COM_Tx_ENGINE_FD_3_FD14, signal-group=SystemSignalGroup_COM_Tx_ENGINE_FD_3_FD14, type-mapping=sender-rec-record-type-mapping=record-element-mappings=[{application-record-element=ISASts_FD14, system-signal=SystemSignal_COM_Tx_ISASts_FD14}, {application-record-element=Override_FD14, system-signal=SystemSignal_COM_Tx_Override_FD14}, {application-record-element=SpeedLimitSts_FD14, system-signal=SystemSignal_COM_Tx_SpeedLimitSts_FD14}]}
        sender-receiver-to-signal-group-mapping={data-element=CPT_MDG1_FlatView.PP_COM_Tx_ENGINE_FD_7_FD14.VD_COM_Tx_ENGINE_FD_7_FD14, signal-group=SystemSignalGroup_COM_Tx_ENGINE_FD_7_FD14, type-mapping=sender-rec-record-type-mapping=record-element-mappings=[{application-record-element=ECM_THA_Resp_FD14, system-signal=SystemSignal_COM_Tx_ECM_THA_Resp_FD14}, {application-record-element=ECM_TRSC_Resp_FD14, system-signal=SystemSignal_COM_Tx_ECM_TRSC_Resp_FD14}]}
        sender-receiver-to-signal-group-mapping={data-element=CPT_MDG1_FlatView.PP_COM_Tx_ENGINE_FD_3_FD16.VD_COM_Tx_ENGINE_FD_3_FD16, signal-group=SystemSignalGroup_COM_Tx_ENGINE_FD_3_FD16, type-mapping=sender-rec-record-type-mapping=record-element-mappings=[{application-record-element=CruiseControlLampSts_FD16, system-signal=SystemSignal_COM_Tx_CruiseControlLampSts_FD16}, {application-record-element=CruiseControlSts_FD16, system-signal=SystemSignal_COM_Tx_CruiseControlSts_FD16}, {application-record-element=EngineOilTemperature_FD16, system-signal=SystemSignal_COM_Tx_EngineOilTemperature_FD16}]}
        sender-receiver-to-signal-group-mapping={data-element=CPT_MDG1_FlatView.PP_COM_Tx_ENGINE_FD_7_FD16.VD_COM_Tx_ENGINE_FD_7_FD16, signal-group=SystemSignalGroup_COM_Tx_ENGINE_FD_7_FD16, type-mapping=sender-rec-record-type-mapping=record-element-mappings=[{application-record-element=CompressorSts_FD16, system-signal=SystemSignal_COM_Tx_CompressorSts_FD16}, {application-record-element=SpStDispstat_FD16, system-signal=SystemSignal_COM_Tx_SpStDispstat_FD16}, {application-record-element=SpStSwStat_FD16, system-signal=SystemSignal_COM_Tx_SpStSwStat_FD16}]}
        sender-receiver-to-signal-mapping={data-element=CPT_MDG1_FlatView.RP_COM_Rx_AGS2_ECM_STATUS.VD_COM_Rx_AGS2_BoostStat, system-signal=SystemSignal_COM_Rx_AGS2_BoostStat}
        sender-receiver-to-signal-mapping={data-element=CPT_MDG1_FlatView.RP_COM_Rx_AGS2_ECM_STATUS.VD_COM_Rx_AGS2_CalActv, system-signal=SystemSignal_COM_Rx_AGS2_CalActv}
        sender-receiver-to-signal-mapping={data-element=CPT_MDG1_FlatView.RP_COM_Rx_AGS2_ECM_STATUS.VD_COM_Rx_AGS2_CalStat, system-signal=SystemSignal_COM_Rx_AGS2_CalStat}
        sender-receiver-to-signal-mapping={data-element=CPT_MDG1_FlatView.RP_COM_Rx_AGS2_ECM_STATUS.VD_COM_Rx_AGS2_CurrPos, system-signal=SystemSignal_COM_Rx_AGS2_CurrPos}
        sender-receiver-to-signal-mapping={data-element=CPT_MDG1_FlatView.RP_COM_Rx_AGS2_ECM_STATUS.VD_COM_Rx_AGS2_ErrLIN, system-signal=SystemSignal_COM_Rx_AGS2_ErrLIN}
        sender-receiver-to-signal-mapping={data-element=CPT_MDG1_FlatView.RP_COM_Rx_AGS2_ECM_STATUS.VD_COM_Rx_AGS2_ErrMechBreak, system-signal=SystemSignal_COM_Rx_AGS2_ErrMechBreak}
        sender-receiver-to-signal-mapping={data-element=CPT_MDG1_FlatView.RP_COM_Rx_AGS2_ECM_STATUS.VD_COM_Rx_AGS2_ErrMechStuck, system-signal=SystemSignal_COM_Rx_AGS2_ErrMechStuck}
        sender-receiver-to-signal-mapping={data-element=CPT_MDG1_FlatView.RP_COM_Rx_AGS2_ECM_STATUS.VD_COM_Rx_AGS2_ErrOvrTemp, system-signal=SystemSignal_COM_Rx_AGS2_ErrOvrTemp}
        sender-receiver-to-signal-mapping={data-element=CPT_MDG1_FlatView.RP_COM_Rx_AGS2_ECM_STATUS.VD_COM_Rx_AGS2_ErrOvrVolt, system-signal=SystemSignal_COM_Rx_AGS2_ErrOvrVolt}
        sender-receiver-to-signal-mapping={data-element=CPT_MDG1_FlatView.RP_COM_Rx_AGS2_ECM_STATUS.VD_COM_Rx_AGS2_ErrUnVolt, system-signal=SystemSignal_COM_Rx_AGS2_ErrUnVolt}
        sender-receiver-to-signal-mapping={data-element=CPT_MDG1_FlatView.RP_COM_Rx_AGS2_ECM_STATUS.VD_COM_Rx_RsErr_AGS2, system-signal=SystemSignal_COM_Rx_RsErr_AGS2}
        sender-receiver-to-signal-mapping={data-element=CPT_MDG1_FlatView.RP_COM_Rx_AGS2_ECM_STATUS.VD_COM_Rx_S2MResBit1_AGS2, system-signal=SystemSignal_COM_Rx_S2MResBit1_AGS2}
        sender-receiver-to-signal-mapping={data-element=CPT_MDG1_FlatView.RP_COM_Rx_AGS2_ECM_STATUS.VD_COM_Rx_S2MResByte1_AGS2, system-signal=SystemSignal_COM_Rx_S2MResByte1_AGS2}
        sender-receiver-to-signal-mapping={data-element=CPT_MDG1_FlatView.RP_COM_Rx_AGS2_ECM_STATUS.VD_COM_Rx_S2MResByte2_AGS2, system-signal=SystemSignal_COM_Rx_S2MResByte2_AGS2}
        sender-receiver-to-signal-mapping={data-element=CPT_MDG1_FlatView.RP_COM_Rx_AGS_ECM_STATUS.VD_COM_Rx_AGS_BoostStat, system-signal=SystemSignal_COM_Rx_AGS_BoostStat}
        sender-receiver-to-signal-mapping={data-element=CPT_MDG1_FlatView.RP_COM_Rx_AGS_ECM_STATUS.VD_COM_Rx_AGS_CalActv, system-signal=SystemSignal_COM_Rx_AGS_CalActv}
        sender-receiver-to-signal-mapping={data-element=CPT_MDG1_FlatView.RP_COM_Rx_AGS_ECM_STATUS.VD_COM_Rx_AGS_CalStat, system-signal=SystemSignal_COM_Rx_AGS_CalStat}
        sender-receiver-to-signal-mapping={data-element=CPT_MDG1_FlatView.RP_COM_Rx_AGS_ECM_STATUS.VD_COM_Rx_AGS_CurrPos, system-signal=SystemSignal_COM_Rx_AGS_CurrPos}
        sender-receiver-to-signal-mapping={data-element=CPT_MDG1_FlatView.RP_COM_Rx_AGS_ECM_STATUS.VD_COM_Rx_AGS_ErrLIN, system-signal=SystemSignal_COM_Rx_AGS_ErrLIN}
        sender-receiver-to-signal-mapping={data-element=CPT_MDG1_FlatView.RP_COM_Rx_AGS_ECM_STATUS.VD_COM_Rx_AGS_ErrMechBreak, system-signal=SystemSignal_COM_Rx_AGS_ErrMechBreak}
        sender-receiver-to-signal-mapping={data-element=CPT_MDG1_FlatView.RP_COM_Rx_AGS_ECM_STATUS.VD_COM_Rx_AGS_ErrMechStuck, system-signal=SystemSignal_COM_Rx_AGS_ErrMechStuck}
        sender-receiver-to-signal-mapping={data-element=CPT_MDG1_FlatView.RP_COM_Rx_AGS_ECM_STATUS.VD_COM_Rx_AGS_ErrOvrTemp, system-signal=SystemSignal_COM_Rx_AGS_ErrOvrTemp}
        sender-receiver-to-signal-mapping={data-element=CPT_MDG1_FlatView.RP_COM_Rx_AGS_ECM_STATUS.VD_COM_Rx_AGS_ErrOvrVolt, system-signal=SystemSignal_COM_Rx_AGS_ErrOvrVolt}
        sender-receiver-to-signal-mapping={data-element=CPT_MDG1_FlatView.RP_COM_Rx_AGS_ECM_STATUS.VD_COM_Rx_AGS_ErrUnVolt, system-signal=SystemSignal_COM_Rx_AGS_ErrUnVolt}
        sender-receiver-to-signal-mapping={data-element=CPT_MDG1_FlatView.RP_COM_Rx_AGS_ECM_STATUS.VD_COM_Rx_RsErr_AGS, system-signal=SystemSignal_COM_Rx_RsErr_AGS}
        sender-receiver-to-signal-mapping={data-element=CPT_MDG1_FlatView.RP_COM_Rx_HAPM_STAT.VD_COM_Rx_HAPM_AIR_PRE_ERR, system-signal=SystemSignal_COM_Rx_HAPM_AIR_PRE_ERR}
        sender-receiver-to-signal-mapping={data-element=CPT_MDG1_FlatView.RP_COM_Rx_HAPM_STAT.VD_COM_Rx_HAPM_CURR, system-signal=SystemSignal_COM_Rx_HAPM_CURR}
        sender-receiver-to-signal-mapping={data-element=CPT_MDG1_FlatView.RP_COM_Rx_HAPM_STAT.VD_COM_Rx_HAPM_DBLK_ACTV, system-signal=SystemSignal_COM_Rx_HAPM_DBLK_ACTV}
        sender-receiver-to-signal-mapping={data-element=CPT_MDG1_FlatView.RP_COM_Rx_HAPM_STAT.VD_COM_Rx_HAPM_DR_RN_ERR, system-signal=SystemSignal_COM_Rx_HAPM_DR_RN_ERR}
        sender-receiver-to-signal-mapping={data-element=CPT_MDG1_FlatView.RP_COM_Rx_HAPM_STAT.VD_COM_Rx_HAPM_NODE_ERR, system-signal=SystemSignal_COM_Rx_HAPM_NODE_ERR}
        sender-receiver-to-signal-mapping={data-element=CPT_MDG1_FlatView.RP_COM_Rx_HAPM_STAT.VD_COM_Rx_HAPM_OVR_CUR_ERR, system-signal=SystemSignal_COM_Rx_HAPM_OVR_CUR_ERR}
        sender-receiver-to-signal-mapping={data-element=CPT_MDG1_FlatView.RP_COM_Rx_HAPM_STAT.VD_COM_Rx_HAPM_OVR_TMP_ERR, system-signal=SystemSignal_COM_Rx_HAPM_OVR_TMP_ERR}
        sender-receiver-to-signal-mapping={data-element=CPT_MDG1_FlatView.RP_COM_Rx_HAPM_STAT.VD_COM_Rx_HAPM_POST_RUN_STAT, system-signal=SystemSignal_COM_Rx_HAPM_POST_RUN_STAT}
        sender-receiver-to-signal-mapping={data-element=CPT_MDG1_FlatView.RP_COM_Rx_HAPM_STAT.VD_COM_Rx_HAPM_RPM_ACTL, system-signal=SystemSignal_COM_Rx_HAPM_RPM_ACTL}
        sender-receiver-to-signal-mapping={data-element=CPT_MDG1_FlatView.RP_COM_Rx_HAPM_STAT.VD_COM_Rx_HAPM_RPM_TGT, system-signal=SystemSignal_COM_Rx_HAPM_RPM_TGT}
        sender-receiver-to-signal-mapping={data-element=CPT_MDG1_FlatView.RP_COM_Rx_HAPM_STAT.VD_COM_Rx_HAPM_TEMP, system-signal=SystemSignal_COM_Rx_HAPM_TEMP}
        sender-receiver-to-signal-mapping={data-element=CPT_MDG1_FlatView.RP_COM_Rx_HAPM_STAT.VD_COM_Rx_HAPM_VLTG, system-signal=SystemSignal_COM_Rx_HAPM_VLTG}
        sender-receiver-to-signal-mapping={data-element=CPT_MDG1_FlatView.RP_COM_Rx_HAPM_STAT.VD_COM_Rx_HAPM_VLTG_ERR, system-signal=SystemSignal_COM_Rx_HAPM_VLTG_ERR}
        sender-receiver-to-signal-mapping={data-element=CPT_MDG1_FlatView.RP_COM_Rx_HAPM_STAT.VD_COM_Rx_RsErr_HAPM_PUMP, system-signal=SystemSignal_COM_Rx_RsErr_HAPM_PUMP}
        sender-receiver-to-signal-mapping={data-element=CPT_MDG1_FlatView.RP_COM_Rx_HAPM_VER.VD_COM_Rx_HAPM_SUPPLIER, system-signal=SystemSignal_COM_Rx_HAPM_SUPPLIER}
        sender-receiver-to-signal-mapping={data-element=CPT_MDG1_FlatView.RP_COM_Rx_HAPM_VER.VD_COM_Rx_HAPM_VERSION, system-signal=SystemSignal_COM_Rx_HAPM_VERSION}
        sender-receiver-to-signal-mapping={data-element=CPT_MDG1_FlatView.RP_COM_Rx_LCVM_ECM.VD_COM_Rx_LCVM_CalStat, system-signal=SystemSignal_COM_Rx_LCVM_CalStat}
        sender-receiver-to-signal-mapping={data-element=CPT_MDG1_FlatView.RP_COM_Rx_LCVM_ECM.VD_COM_Rx_LCVM_ERR, system-signal=SystemSignal_COM_Rx_LCVM_ERR}
        sender-receiver-to-signal-mapping={data-element=CPT_MDG1_FlatView.RP_COM_Rx_LCVM_ECM.VD_COM_Rx_LCVM_MotorVolt, system-signal=SystemSignal_COM_Rx_LCVM_MotorVolt}
        sender-receiver-to-signal-mapping={data-element=CPT_MDG1_FlatView.RP_COM_Rx_LCVM_ECM.VD_COM_Rx_LCVM_PosAct, system-signal=SystemSignal_COM_Rx_LCVM_PosAct}
        sender-receiver-to-signal-mapping={data-element=CPT_MDG1_FlatView.RP_COM_Rx_LCVM_ECM.VD_COM_Rx_LCVM_Sts, system-signal=SystemSignal_COM_Rx_LCVM_Sts}
        sender-receiver-to-signal-mapping={data-element=CPT_MDG1_FlatView.RP_COM_Rx_LCVM_ECM.VD_COM_Rx_RsErr_LCVM, system-signal=SystemSignal_COM_Rx_RsErr_LCVM}
        sender-receiver-to-signal-mapping={data-element=CPT_MDG1_FlatView.RP_COM_Rx_LTRP_STAT.VD_COM_Rx_LTRP_AIR_PRE_ERR, system-signal=SystemSignal_COM_Rx_LTRP_AIR_PRE_ERR}
        sender-receiver-to-signal-mapping={data-element=CPT_MDG1_FlatView.RP_COM_Rx_LTRP_STAT.VD_COM_Rx_LTRP_CURR, system-signal=SystemSignal_COM_Rx_LTRP_CURR}
        sender-receiver-to-signal-mapping={data-element=CPT_MDG1_FlatView.RP_COM_Rx_LTRP_STAT.VD_COM_Rx_LTRP_DBLK_ACTV, system-signal=SystemSignal_COM_Rx_LTRP_DBLK_ACTV}
        sender-receiver-to-signal-mapping={data-element=CPT_MDG1_FlatView.RP_COM_Rx_LTRP_STAT.VD_COM_Rx_LTRP_DR_RN_ERR, system-signal=SystemSignal_COM_Rx_LTRP_DR_RN_ERR}
        sender-receiver-to-signal-mapping={data-element=CPT_MDG1_FlatView.RP_COM_Rx_LTRP_STAT.VD_COM_Rx_LTRP_NODE_ERR, system-signal=SystemSignal_COM_Rx_LTRP_NODE_ERR}
        sender-receiver-to-signal-mapping={data-element=CPT_MDG1_FlatView.RP_COM_Rx_LTRP_STAT.VD_COM_Rx_LTRP_OVR_CUR_ERR, system-signal=SystemSignal_COM_Rx_LTRP_OVR_CUR_ERR}
        sender-receiver-to-signal-mapping={data-element=CPT_MDG1_FlatView.RP_COM_Rx_LTRP_STAT.VD_COM_Rx_LTRP_OVR_TMP_ERR, system-signal=SystemSignal_COM_Rx_LTRP_OVR_TMP_ERR}
        sender-receiver-to-signal-mapping={data-element=CPT_MDG1_FlatView.RP_COM_Rx_LTRP_STAT.VD_COM_Rx_LTRP_POST_RUN_STAT, system-signal=SystemSignal_COM_Rx_LTRP_POST_RUN_STAT}
        sender-receiver-to-signal-mapping={data-element=CPT_MDG1_FlatView.RP_COM_Rx_LTRP_STAT.VD_COM_Rx_LTRP_RPM_ACTL, system-signal=SystemSignal_COM_Rx_LTRP_RPM_ACTL}
        sender-receiver-to-signal-mapping={data-element=CPT_MDG1_FlatView.RP_COM_Rx_LTRP_STAT.VD_COM_Rx_LTRP_RPM_TGT, system-signal=SystemSignal_COM_Rx_LTRP_RPM_TGT}
        sender-receiver-to-signal-mapping={data-element=CPT_MDG1_FlatView.RP_COM_Rx_LTRP_STAT.VD_COM_Rx_LTRP_TEMP, system-signal=SystemSignal_COM_Rx_LTRP_TEMP}
        sender-receiver-to-signal-mapping={data-element=CPT_MDG1_FlatView.RP_COM_Rx_LTRP_STAT.VD_COM_Rx_LTRP_VLTG, system-signal=SystemSignal_COM_Rx_LTRP_VLTG}
        sender-receiver-to-signal-mapping={data-element=CPT_MDG1_FlatView.RP_COM_Rx_LTRP_STAT.VD_COM_Rx_LTRP_VLTG_ERR, system-signal=SystemSignal_COM_Rx_LTRP_VLTG_ERR}
        sender-receiver-to-signal-mapping={data-element=CPT_MDG1_FlatView.RP_COM_Rx_LTRP_STAT.VD_COM_Rx_RsErr_LTRP_PUMP, system-signal=SystemSignal_COM_Rx_RsErr_LTRP_PUMP}
        sender-receiver-to-signal-mapping={data-element=CPT_MDG1_FlatView.RP_COM_Rx_LTRP_VER.VD_COM_Rx_LTRP_SUPPLIER, system-signal=SystemSignal_COM_Rx_LTRP_SUPPLIER}
        sender-receiver-to-signal-mapping={data-element=CPT_MDG1_FlatView.RP_COM_Rx_LTRP_VER.VD_COM_Rx_LTRP_VERSION, system-signal=SystemSignal_COM_Rx_LTRP_VERSION}
        sender-receiver-to-signal-mapping={data-element=CPT_MDG1_FlatView.RP_COM_Rx_PCPM_Stat.VD_COM_Rx_PCPM_AIR_PRE_ERR, system-signal=SystemSignal_COM_Rx_PCPM_AIR_PRE_ERR}
        sender-receiver-to-signal-mapping={data-element=CPT_MDG1_FlatView.RP_COM_Rx_PCPM_Stat.VD_COM_Rx_PCPM_CURR, system-signal=SystemSignal_COM_Rx_PCPM_CURR}
        sender-receiver-to-signal-mapping={data-element=CPT_MDG1_FlatView.RP_COM_Rx_PCPM_Stat.VD_COM_Rx_PCPM_DBLK_ACTV, system-signal=SystemSignal_COM_Rx_PCPM_DBLK_ACTV}
        sender-receiver-to-signal-mapping={data-element=CPT_MDG1_FlatView.RP_COM_Rx_PCPM_Stat.VD_COM_Rx_PCPM_DR_RN_ERR, system-signal=SystemSignal_COM_Rx_PCPM_DR_RN_ERR}
        sender-receiver-to-signal-mapping={data-element=CPT_MDG1_FlatView.RP_COM_Rx_PCPM_Stat.VD_COM_Rx_PCPM_NODE_ERR, system-signal=SystemSignal_COM_Rx_PCPM_NODE_ERR}
        sender-receiver-to-signal-mapping={data-element=CPT_MDG1_FlatView.RP_COM_Rx_PCPM_Stat.VD_COM_Rx_PCPM_OVR_CUR_ERR, system-signal=SystemSignal_COM_Rx_PCPM_OVR_CUR_ERR}
        sender-receiver-to-signal-mapping={data-element=CPT_MDG1_FlatView.RP_COM_Rx_PCPM_Stat.VD_COM_Rx_PCPM_OVR_TMP_ERR, system-signal=SystemSignal_COM_Rx_PCPM_OVR_TMP_ERR}
        sender-receiver-to-signal-mapping={data-element=CPT_MDG1_FlatView.RP_COM_Rx_PCPM_Stat.VD_COM_Rx_PCPM_POST_RUN_STAT, system-signal=SystemSignal_COM_Rx_PCPM_POST_RUN_STAT}
        sender-receiver-to-signal-mapping={data-element=CPT_MDG1_FlatView.RP_COM_Rx_PCPM_Stat.VD_COM_Rx_PCPM_RPM_ACTL, system-signal=SystemSignal_COM_Rx_PCPM_RPM_ACTL}
        sender-receiver-to-signal-mapping={data-element=CPT_MDG1_FlatView.RP_COM_Rx_PCPM_Stat.VD_COM_Rx_PCPM_RPM_TGT, system-signal=SystemSignal_COM_Rx_PCPM_RPM_TGT}
        sender-receiver-to-signal-mapping={data-element=CPT_MDG1_FlatView.RP_COM_Rx_PCPM_Stat.VD_COM_Rx_PCPM_TEMP, system-signal=SystemSignal_COM_Rx_PCPM_TEMP}
        sender-receiver-to-signal-mapping={data-element=CPT_MDG1_FlatView.RP_COM_Rx_PCPM_Stat.VD_COM_Rx_PCPM_VLTG, system-signal=SystemSignal_COM_Rx_PCPM_VLTG}
        sender-receiver-to-signal-mapping={data-element=CPT_MDG1_FlatView.RP_COM_Rx_PCPM_Stat.VD_COM_Rx_PCPM_VLTG_ERR, system-signal=SystemSignal_COM_Rx_PCPM_VLTG_ERR}
        sender-receiver-to-signal-mapping={data-element=CPT_MDG1_FlatView.RP_COM_Rx_PCPM_Stat.VD_COM_Rx_RsErr_PCPM_PUMP, system-signal=SystemSignal_COM_Rx_RsErr_PCPM_PUMP}
        sender-receiver-to-signal-mapping={data-element=CPT_MDG1_FlatView.RP_COM_Rx_PCPM_VER.VD_COM_Rx_PCPM_SUPPLIER, system-signal=SystemSignal_COM_Rx_PCPM_SUPPLIER}
        sender-receiver-to-signal-mapping={data-element=CPT_MDG1_FlatView.RP_COM_Rx_PCPM_VER.VD_COM_Rx_PCPM_VERSION, system-signal=SystemSignal_COM_Rx_PCPM_VERSION}
        sender-receiver-to-signal-mapping={data-element=CPT_MDG1_FlatView.RP_COM_Rx_PLA_INFO.VD_COM_Rx_PLA_ExicCurrent, system-signal=SystemSignal_COM_Rx_PLA_ExicCurrent}
        sender-receiver-to-signal-mapping={data-element=CPT_MDG1_FlatView.RP_COM_Rx_PLA_INFO.VD_COM_Rx_PLA_ExicDutyCycle, system-signal=SystemSignal_COM_Rx_PLA_ExicDutyCycle}
        sender-receiver-to-signal-mapping={data-element=CPT_MDG1_FlatView.RP_COM_Rx_PLA_INFO.VD_COM_Rx_PLA_Fault_El, system-signal=SystemSignal_COM_Rx_PLA_Fault_El}
        sender-receiver-to-signal-mapping={data-element=CPT_MDG1_FlatView.RP_COM_Rx_PLA_INFO.VD_COM_Rx_PLA_Fault_HT, system-signal=SystemSignal_COM_Rx_PLA_Fault_HT}
        sender-receiver-to-signal-mapping={data-element=CPT_MDG1_FlatView.RP_COM_Rx_PLA_INFO.VD_COM_Rx_PLA_Fault_Mec, system-signal=SystemSignal_COM_Rx_PLA_Fault_Mec}
        sender-receiver-to-signal-mapping={data-element=CPT_MDG1_FlatView.RP_COM_Rx_PLA_INFO.VD_COM_Rx_PLA_Fault_TO, system-signal=SystemSignal_COM_Rx_PLA_Fault_TO}
        sender-receiver-to-signal-mapping={data-element=CPT_MDG1_FlatView.RP_COM_Rx_PLA_INFO.VD_COM_Rx_PLA_Request_data_Response, system-signal=SystemSignal_COM_Rx_PLA_Request_data_Response}
        sender-receiver-to-signal-mapping={data-element=CPT_MDG1_FlatView.RP_COM_Rx_PLA_INFO.VD_COM_Rx_PLA_Requested_response_data, system-signal=SystemSignal_COM_Rx_PLA_Requested_response_data}
        sender-receiver-to-signal-mapping={data-element=CPT_MDG1_FlatView.RP_COM_Rx_PLA_INFO.VD_COM_Rx_RsErr_PLA, system-signal=SystemSignal_COM_Rx_RsErr_PLA}
        sender-receiver-to-signal-mapping={data-element=CPT_MDG1_FlatView.PP_COM_Tx_ECM_AGS2_DEMAND.VD_COM_Tx_AGS2_BoostRq, system-signal=SystemSignal_COM_Tx_AGS2_BoostRq}
        sender-receiver-to-signal-mapping={data-element=CPT_MDG1_FlatView.PP_COM_Tx_ECM_AGS2_DEMAND.VD_COM_Tx_AGS2_CalRq, system-signal=SystemSignal_COM_Tx_AGS2_CalRq}
        sender-receiver-to-signal-mapping={data-element=CPT_MDG1_FlatView.PP_COM_Tx_ECM_AGS2_DEMAND.VD_COM_Tx_AGS2_PosRq, system-signal=SystemSignal_COM_Tx_AGS2_PosRq}
        sender-receiver-to-signal-mapping={data-element=CPT_MDG1_FlatView.PP_COM_Tx_ECM_AGS2_DEMAND.VD_COM_Tx_M2SRes2Bit_AGS2, system-signal=SystemSignal_COM_Tx_M2SRes2Bit_AGS2}
        sender-receiver-to-signal-mapping={data-element=CPT_MDG1_FlatView.PP_COM_Tx_ECM_AGS2_DEMAND.VD_COM_Tx_M2SResByte1_AGS2, system-signal=SystemSignal_COM_Tx_M2SResByte1_AGS2}
        sender-receiver-to-signal-mapping={data-element=CPT_MDG1_FlatView.PP_COM_Tx_ECM_AGS2_DEMAND.VD_COM_Tx_M2SResByte2_AGS2, system-signal=SystemSignal_COM_Tx_M2SResByte2_AGS2}
        sender-receiver-to-signal-mapping={data-element=CPT_MDG1_FlatView.PP_COM_Tx_ECM_AGS_DEMAND.VD_COM_Tx_AGS_BoostRq, system-signal=SystemSignal_COM_Tx_AGS_BoostRq}
        sender-receiver-to-signal-mapping={data-element=CPT_MDG1_FlatView.PP_COM_Tx_ECM_AGS_DEMAND.VD_COM_Tx_AGS_CalRq, system-signal=SystemSignal_COM_Tx_AGS_CalRq}
        sender-receiver-to-signal-mapping={data-element=CPT_MDG1_FlatView.PP_COM_Tx_ECM_AGS_DEMAND.VD_COM_Tx_AGS_PosRq, system-signal=SystemSignal_COM_Tx_AGS_PosRq}
        sender-receiver-to-signal-mapping={data-element=CPT_MDG1_FlatView.PP_COM_Tx_ECM_LCVM.VD_COM_Tx_LCVM_CalRq, system-signal=SystemSignal_COM_Tx_LCVM_CalRq}
        sender-receiver-to-signal-mapping={data-element=CPT_MDG1_FlatView.PP_COM_Tx_ECM_LCVM.VD_COM_Tx_LCVM_PosRq, system-signal=SystemSignal_COM_Tx_LCVM_PosRq}
        sender-receiver-to-signal-mapping={data-element=CPT_MDG1_FlatView.PP_COM_Tx_ECM_LCVM.VD_COM_Tx_LCVM_PosSv, system-signal=SystemSignal_COM_Tx_LCVM_PosSv}
        sender-receiver-to-signal-mapping={data-element=CPT_MDG1_FlatView.PP_COM_Tx_HAPM_REQ.VD_COM_Tx_HAPM_POST_RUN_REQ, system-signal=SystemSignal_COM_Tx_HAPM_POST_RUN_REQ}
        sender-receiver-to-signal-mapping={data-element=CPT_MDG1_FlatView.PP_COM_Tx_HAPM_REQ.VD_COM_Tx_HAPM_RPM_REQ, system-signal=SystemSignal_COM_Tx_HAPM_RPM_REQ}
        sender-receiver-to-signal-mapping={data-element=CPT_MDG1_FlatView.PP_COM_Tx_LTRP_REQ.VD_COM_Tx_LTRP_POST_RUN_REQ, system-signal=SystemSignal_COM_Tx_LTRP_POST_RUN_REQ}
        sender-receiver-to-signal-mapping={data-element=CPT_MDG1_FlatView.PP_COM_Tx_LTRP_REQ.VD_COM_Tx_LTRP_RPM_REQ, system-signal=SystemSignal_COM_Tx_LTRP_RPM_REQ}
        sender-receiver-to-signal-mapping={data-element=CPT_MDG1_FlatView.PP_COM_Tx_MASTER_PLA.VD_COM_Tx_PLA_ExicLimit, system-signal=SystemSignal_COM_Tx_PLA_ExicLimit}
        sender-receiver-to-signal-mapping={data-element=CPT_MDG1_FlatView.PP_COM_Tx_MASTER_PLA.VD_COM_Tx_PLA_RampCOSpeed, system-signal=SystemSignal_COM_Tx_PLA_RampCOSpeed}
        sender-receiver-to-signal-mapping={data-element=CPT_MDG1_FlatView.PP_COM_Tx_MASTER_PLA.VD_COM_Tx_PLA_RampTime, system-signal=SystemSignal_COM_Tx_PLA_RampTime}
        sender-receiver-to-signal-mapping={data-element=CPT_MDG1_FlatView.PP_COM_Tx_MASTER_PLA.VD_COM_Tx_PLA_Reg_parameter, system-signal=SystemSignal_COM_Tx_PLA_Reg_parameter}
        sender-receiver-to-signal-mapping={data-element=CPT_MDG1_FlatView.PP_COM_Tx_MASTER_PLA.VD_COM_Tx_PLA_Request_data, system-signal=SystemSignal_COM_Tx_PLA_Request_data}
        sender-receiver-to-signal-mapping={data-element=CPT_MDG1_FlatView.PP_COM_Tx_MASTER_PLA.VD_COM_Tx_PLA_SetVoltage, system-signal=SystemSignal_COM_Tx_PLA_SetVoltage}
        sender-receiver-to-signal-mapping={data-element=CPT_MDG1_FlatView.PP_COM_Tx_MASTER_PLA.VD_COM_Tx_PLA_Thermal_protection, system-signal=SystemSignal_COM_Tx_PLA_Thermal_protection}
        sender-receiver-to-signal-mapping={data-element=CPT_MDG1_FlatView.PP_COM_Tx_PCPM_REQ.VD_COM_Tx_PCPM_POST_RUN_REQ, system-signal=SystemSignal_COM_Tx_PCPM_POST_RUN_REQ}
        sender-receiver-to-signal-mapping={data-element=CPT_MDG1_FlatView.PP_COM_Tx_PCPM_REQ.VD_COM_Tx_PCPM_RPM_REQ, system-signal=SystemSignal_COM_Tx_PCPM_RPM_REQ}
        sender-receiver-to-signal-mapping={data-element=CPT_MDG1_FlatView.RP_COM_Rx_ADAS_FD_HMI_FD3.VD_COM_Rx_CRC_ADAS_FD_HMI_FD3, system-signal=SystemSignal_COM_Rx_CRC_ADAS_FD_HMI_FD3}
        sender-receiver-to-signal-mapping={data-element=CPT_MDG1_FlatView.RP_COM_Rx_ADAS_FD_HMI_FD3.VD_COM_Rx_MessageCounter_ADAS_FD_HMI_FD3, system-signal=SystemSignal_COM_Rx_MessageCounter_ADAS_FD_HMI_FD3}
        sender-receiver-to-signal-mapping={data-element=CPT_MDG1_FlatView.RP_COM_Rx_ADAS_FD_HMI_FD3.VD_COM_Rx_Set_Speed_KPH_FD3, system-signal=SystemSignal_COM_Rx_Set_Speed_KPH_FD3}
        sender-receiver-to-signal-mapping={data-element=CPT_MDG1_FlatView.RP_COM_Rx_ADAS_FD_INFO2.VD_COM_Rx_TSRSts, system-signal=SystemSignal_COM_Rx_TSRSts}
        sender-receiver-to-signal-mapping={data-element=CPT_MDG1_FlatView.RP_COM_Rx_ADCM_FD_A4.VD_COM_Rx_FL_Lvl_RawAD_Src, system-signal=SystemSignal_COM_Rx_FL_Lvl_RawAD_Src}
        sender-receiver-to-signal-mapping={data-element=CPT_MDG1_FlatView.RP_COM_Rx_ADCM_FD_A4.VD_COM_Rx_FL_Lvl_Stat_Src, system-signal=SystemSignal_COM_Rx_FL_Lvl_Stat_Src}
        sender-receiver-to-signal-mapping={data-element=CPT_MDG1_FlatView.RP_COM_Rx_ADCM_FD_A4.VD_COM_Rx_FL_Z_Accel_Stat_Src, system-signal=SystemSignal_COM_Rx_FL_Z_Accel_Stat_Src}
        sender-receiver-to-signal-mapping={data-element=CPT_MDG1_FlatView.RP_COM_Rx_ADCM_FD_A4.VD_COM_Rx_FR_Lvl_RawAD_Src, system-signal=SystemSignal_COM_Rx_FR_Lvl_RawAD_Src}
        sender-receiver-to-signal-mapping={data-element=CPT_MDG1_FlatView.RP_COM_Rx_ADCM_FD_A4.VD_COM_Rx_FR_Lvl_Stat_Src, system-signal=SystemSignal_COM_Rx_FR_Lvl_Stat_Src}
        sender-receiver-to-signal-mapping={data-element=CPT_MDG1_FlatView.RP_COM_Rx_ADCM_FD_A4.VD_COM_Rx_FR_Z_Accel_Stat_Src, system-signal=SystemSignal_COM_Rx_FR_Z_Accel_Stat_Src}
        sender-receiver-to-signal-mapping={data-element=CPT_MDG1_FlatView.RP_COM_Rx_ADCM_FD_A4.VD_COM_Rx_RC_Z_Accel_Stat_Src, system-signal=SystemSignal_COM_Rx_RC_Z_Accel_Stat_Src}
        sender-receiver-to-signal-mapping={data-element=CPT_MDG1_FlatView.RP_COM_Rx_ADCM_FD_A4.VD_COM_Rx_RL_Lvl_RawAD_Src, system-signal=SystemSignal_COM_Rx_RL_Lvl_RawAD_Src}
        sender-receiver-to-signal-mapping={data-element=CPT_MDG1_FlatView.RP_COM_Rx_ADCM_FD_A4.VD_COM_Rx_RL_Lvl_Stat_Src, system-signal=SystemSignal_COM_Rx_RL_Lvl_Stat_Src}
        sender-receiver-to-signal-mapping={data-element=CPT_MDG1_FlatView.RP_COM_Rx_ADCM_FD_A4.VD_COM_Rx_RR_Lvl_RawAD_Src, system-signal=SystemSignal_COM_Rx_RR_Lvl_RawAD_Src}
        sender-receiver-to-signal-mapping={data-element=CPT_MDG1_FlatView.RP_COM_Rx_ADCM_FD_A4.VD_COM_Rx_RR_Lvl_Stat_Src, system-signal=SystemSignal_COM_Rx_RR_Lvl_Stat_Src}
        sender-receiver-to-signal-mapping={data-element=CPT_MDG1_FlatView.RP_COM_Rx_ADCM_FD_A4.VD_COM_Rx_Z_Acceleration_FL_Src, system-signal=SystemSignal_COM_Rx_Z_Acceleration_FL_Src}
        sender-receiver-to-signal-mapping={data-element=CPT_MDG1_FlatView.RP_COM_Rx_ADCM_FD_A4.VD_COM_Rx_Z_Acceleration_FR_Src, system-signal=SystemSignal_COM_Rx_Z_Acceleration_FR_Src}
        sender-receiver-to-signal-mapping={data-element=CPT_MDG1_FlatView.RP_COM_Rx_ADCM_FD_A4.VD_COM_Rx_Z_Acceleration_RC_Src, system-signal=SystemSignal_COM_Rx_Z_Acceleration_RC_Src}
        sender-receiver-to-signal-mapping={data-element=CPT_MDG1_FlatView.RP_COM_Rx_ASCM_FD_2.VD_COM_Rx_ASCM_Stat, system-signal=SystemSignal_COM_Rx_ASCM_Stat}
        sender-receiver-to-signal-mapping={data-element=CPT_MDG1_FlatView.RP_COM_Rx_BCM_FD_10.VD_COM_Rx_CmdIgnSts, system-signal=SystemSignal_COM_Rx_CmdIgnSts}
        sender-receiver-to-signal-mapping={data-element=CPT_MDG1_FlatView.RP_COM_Rx_BCM_FD_10.VD_COM_Rx_CompressorACReqSts, system-signal=SystemSignal_COM_Rx_CompressorACReqSts}
        sender-receiver-to-signal-mapping={data-element=CPT_MDG1_FlatView.RP_COM_Rx_BCM_FD_10.VD_COM_Rx_ExternalTemperatureC, system-signal=SystemSignal_COM_Rx_ExternalTemperatureC}
        sender-receiver-to-signal-mapping={data-element=CPT_MDG1_FlatView.RP_COM_Rx_BCM_FD_10.VD_COM_Rx_SpSt_Pad1, system-signal=SystemSignal_COM_Rx_SpSt_Pad1}
