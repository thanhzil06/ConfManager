[part 2 of 2: package /RB/PT/PCFG_ECU]
AUTOSAR XML (schema 4-3-0)
package /RB/PT/PCFG_ECU  (continued)
  system MDG1_EXTR: category=ECU_EXTRACT, ecu-extract-version=1.0.0, system-version=1.0.0  (continued)
    system mapping SYSMPG_MDG1  (continued)
      data-mappings:  (continued)
        sender-receiver-to-signal-mapping={data-element=CPT_MDG1_FlatView.RP_COM_Rx_BCM_FD_11.VD_COM_Rx_A2D_DRV_TEMP_DR_POS, system-signal=SystemSignal_COM_Rx_A2D_DRV_TEMP_DR_POS}
        sender-receiver-to-signal-mapping={data-element=CPT_MDG1_FlatView.RP_COM_Rx_BCM_FD_11.VD_COM_Rx_AcOutputCurrentSts, system-signal=SystemSignal_COM_Rx_AcOutputCurrentSts}
        sender-receiver-to-signal-mapping={data-element=CPT_MDG1_FlatView.RP_COM_Rx_BCM_FD_11.VD_COM_Rx_PARK_BRK_EGD, system-signal=SystemSignal_COM_Rx_PARK_BRK_EGD}
        sender-receiver-to-signal-mapping={data-element=CPT_MDG1_FlatView.RP_COM_Rx_BCM_FD_11.VD_COM_Rx_Parallel_Prk_Ast_Pad1, system-signal=SystemSignal_COM_Rx_Parallel_Prk_Ast_Pad1}
        sender-receiver-to-signal-mapping={data-element=CPT_MDG1_FlatView.RP_COM_Rx_BCM_FD_11.VD_COM_Rx_StopStartClimateInfo, system-signal=SystemSignal_COM_Rx_StopStartClimateInfo}
        sender-receiver-to-signal-mapping={data-element=CPT_MDG1_FlatView.RP_COM_Rx_BCM_FD_12.VD_COM_Rx_GlobDrvMdRq_BCM, system-signal=SystemSignal_COM_Rx_GlobDrvMdRq_BCM}
        sender-receiver-to-signal-mapping={data-element=CPT_MDG1_FlatView.RP_COM_Rx_BCM_FD_12.VD_COM_Rx_Left_Button_BCM, system-signal=SystemSignal_COM_Rx_Left_Button_BCM}
        sender-receiver-to-signal-mapping={data-element=CPT_MDG1_FlatView.RP_COM_Rx_BCM_FD_12.VD_COM_Rx_PowerShot_BCM, system-signal=SystemSignal_COM_Rx_PowerShot_BCM}
        sender-receiver-to-signal-mapping={data-element=CPT_MDG1_FlatView.RP_COM_Rx_BCM_FD_12.VD_COM_Rx_Right_Button_BCM, system-signal=SystemSignal_COM_Rx_Right_Button_BCM}
        sender-receiver-to-signal-mapping={data-element=CPT_MDG1_FlatView.RP_COM_Rx_BCM_FD_12.VD_COM_Rx_Sport_Request, system-signal=SystemSignal_COM_Rx_Sport_Request}
        sender-receiver-to-signal-mapping={data-element=CPT_MDG1_FlatView.RP_COM_Rx_BCM_FD_12.VD_COM_Rx_TerrainModeInterfaceButton_BCM, system-signal=SystemSignal_COM_Rx_TerrainModeInterfaceButton_BCM}
        sender-receiver-to-signal-mapping={data-element=CPT_MDG1_FlatView.RP_COM_Rx_BCM_FD_12.VD_COM_Rx_TerrainSwStat, system-signal=SystemSignal_COM_Rx_TerrainSwStat}
        sender-receiver-to-signal-mapping={data-element=CPT_MDG1_FlatView.RP_COM_Rx_BCM_FD_12.VD_COM_Rx_Tow_Request, system-signal=SystemSignal_COM_Rx_Tow_Request}
        sender-receiver-to-signal-mapping={data-element=CPT_MDG1_FlatView.RP_COM_Rx_BCM_FD_12.VD_COM_Rx_Trns_DrvMdReq_BCM, system-signal=SystemSignal_COM_Rx_Trns_DrvMdReq_BCM}
        sender-receiver-to-signal-mapping={data-element=CPT_MDG1_FlatView.RP_COM_Rx_BCM_FD_14.VD_COM_Rx_Command_15Sts, system-signal=SystemSignal_COM_Rx_Command_15Sts}
        sender-receiver-to-signal-mapping={data-element=CPT_MDG1_FlatView.RP_COM_Rx_BCM_FD_23.VD_COM_Rx_PowerDraw, system-signal=SystemSignal_COM_Rx_PowerDraw}
        sender-receiver-to-signal-mapping={data-element=CPT_MDG1_FlatView.RP_COM_Rx_BCM_FD_23.VD_COM_Rx_Worksite_Inverter_Active, system-signal=SystemSignal_COM_Rx_Worksite_Inverter_Active}
        sender-receiver-to-signal-mapping={data-element=CPT_MDG1_FlatView.RP_COM_Rx_BCM_FD_26.VD_COM_Rx_DRV_TEMP_DR_POS_PCT, system-signal=SystemSignal_COM_Rx_DRV_TEMP_DR_POS_PCT}
        sender-receiver-to-signal-mapping={data-element=CPT_MDG1_FlatView.RP_COM_Rx_BCM_FD_26.VD_COM_Rx_HAS_OnOffSts, system-signal=SystemSignal_COM_Rx_HAS_OnOffSts}
        sender-receiver-to-signal-mapping={data-element=CPT_MDG1_FlatView.RP_COM_Rx_BCM_FD_26.VD_COM_Rx_HVAC_CLNT_FLW_MIN, system-signal=SystemSignal_COM_Rx_HVAC_CLNT_FLW_MIN}
        sender-receiver-to-signal-mapping={data-element=CPT_MDG1_FlatView.RP_COM_Rx_BCM_FD_27.VD_COM_Rx_Blower_Diagnostics, system-signal=SystemSignal_COM_Rx_Blower_Diagnostics}
        sender-receiver-to-signal-mapping={data-element=CPT_MDG1_FlatView.RP_COM_Rx_BCM_FD_27.VD_COM_Rx_Blower_Speed, system-signal=SystemSignal_COM_Rx_Blower_Speed}
        sender-receiver-to-signal-mapping={data-element=CPT_MDG1_FlatView.RP_COM_Rx_BCM_FD_29.VD_COM_Rx_ITBM_DSP_RQ, system-signal=SystemSignal_COM_Rx_ITBM_DSP_RQ}
        sender-receiver-to-signal-mapping={data-element=CPT_MDG1_FlatView.RP_COM_Rx_BCM_FD_29.VD_COM_Rx_ITBM_TrlrStat, system-signal=SystemSignal_COM_Rx_ITBM_TrlrStat}
        sender-receiver-to-signal-mapping={data-element=CPT_MDG1_FlatView.RP_COM_Rx_BCM_FD_3.VD_COM_Rx_Battery_Volt_1, system-signal=SystemSignal_COM_Rx_Battery_Volt_1}
        sender-receiver-to-signal-mapping={data-element=CPT_MDG1_FlatView.RP_COM_Rx_BCM_FD_3.VD_COM_Rx_Battery_Volt_2, system-signal=SystemSignal_COM_Rx_Battery_Volt_2}
        sender-receiver-to-signal-mapping={data-element=CPT_MDG1_FlatView.RP_COM_Rx_BCM_FD_4.VD_COM_Rx_AM_ECM_Trace, system-signal=SystemSignal_COM_Rx_AM_ECM_Trace}
        sender-receiver-to-signal-mapping={data-element=CPT_MDG1_FlatView.RP_COM_Rx_BCM_FD_4.VD_COM_Rx_BCMSAMFailSts, system-signal=SystemSignal_COM_Rx_BCMSAMFailSts}
        sender-receiver-to-signal-mapping={data-element=CPT_MDG1_FlatView.RP_COM_Rx_BCM_FD_4.VD_COM_Rx_CRC_BCM4, system-signal=SystemSignal_COM_Rx_CRC_BCM4}
        sender-receiver-to-signal-mapping={data-element=CPT_MDG1_FlatView.RP_COM_Rx_BCM_FD_4.VD_COM_Rx_ExternalTemperatureAD_Voltage, system-signal=SystemSignal_COM_Rx_ExternalTemperatureAD_Voltage}
        sender-receiver-to-signal-mapping={data-element=CPT_MDG1_FlatView.RP_COM_Rx_BCM_FD_4.VD_COM_Rx_FUEL_VOLT, system-signal=SystemSignal_COM_Rx_FUEL_VOLT}
        sender-receiver-to-signal-mapping={data-element=CPT_MDG1_FlatView.RP_COM_Rx_BCM_FD_4.VD_COM_Rx_FUEL_VOLT2, system-signal=SystemSignal_COM_Rx_FUEL_VOLT2}
        sender-receiver-to-signal-mapping={data-element=CPT_MDG1_FlatView.RP_COM_Rx_BCM_FD_4.VD_COM_Rx_MessageCounter_BCM4, system-signal=SystemSignal_COM_Rx_MessageCounter_BCM4}
        sender-receiver-to-signal-mapping={data-element=CPT_MDG1_FlatView.RP_COM_Rx_BCM_FD_4.VD_COM_Rx_VoltageMax, system-signal=SystemSignal_COM_Rx_VoltageMax}
        sender-receiver-to-signal-mapping={data-element=CPT_MDG1_FlatView.RP_COM_Rx_BCM_FD_4.VD_COM_Rx_VoltageMin, system-signal=SystemSignal_COM_Rx_VoltageMin}
        sender-receiver-to-signal-mapping={data-element=CPT_MDG1_FlatView.RP_COM_Rx_BCM_FD_6.VD_COM_Rx_ChkFuelLevelSts, system-signal=SystemSignal_COM_Rx_ChkFuelLevelSts}
        sender-receiver-to-signal-mapping={data-element=CPT_MDG1_FlatView.RP_COM_Rx_BCM_FD_6.VD_COM_Rx_ChkFuelLevelSts2, system-signal=SystemSignal_COM_Rx_ChkFuelLevelSts2}
        sender-receiver-to-signal-mapping={data-element=CPT_MDG1_FlatView.RP_COM_Rx_BCM_FD_7.VD_COM_Rx_IgnitionOnCounter, system-signal=SystemSignal_COM_Rx_IgnitionOnCounter}
        sender-receiver-to-signal-mapping={data-element=CPT_MDG1_FlatView.RP_COM_Rx_BRAKE_FD_6_FD3.VD_COM_Rx_CRC_BRAKE_FD_6_FD3, system-signal=SystemSignal_COM_Rx_CRC_BRAKE_FD_6_FD3}
        sender-receiver-to-signal-mapping={data-element=CPT_MDG1_FlatView.RP_COM_Rx_BRAKE_FD_6_FD3.VD_COM_Rx_DriverReq_AxleTrq_Enabled_BSMFD3, system-signal=SystemSignal_COM_Rx_DriverReq_AxleTrq_Enabled_BSMFD3}
        sender-receiver-to-signal-mapping={data-element=CPT_MDG1_FlatView.RP_COM_Rx_BRAKE_FD_6_FD3.VD_COM_Rx_DriverRequested_AxleTrq_BSM_FD3, system-signal=SystemSignal_COM_Rx_DriverRequested_AxleTrq_BSM_FD3}
        sender-receiver-to-signal-mapping={data-element=CPT_MDG1_FlatView.RP_COM_Rx_BRAKE_FD_6_FD3.VD_COM_Rx_MessageCounter_BRAKE_FD_6_FD3, system-signal=SystemSignal_COM_Rx_MessageCounter_BRAKE_FD_6_FD3}
        sender-receiver-to-signal-mapping={data-element=CPT_MDG1_FlatView.RP_COM_Rx_BRAKE_FD_6_FD3.VD_COM_Rx_Not_OK_To_Race_FD3, system-signal=SystemSignal_COM_Rx_Not_OK_To_Race_FD3}
        sender-receiver-to-signal-mapping={data-element=CPT_MDG1_FlatView.RP_COM_Rx_BRAKE_FD_6_FD3.VD_COM_Rx_TotalAxle_Max_Rq_BSM_FD3, system-signal=SystemSignal_COM_Rx_TotalAxle_Max_Rq_BSM_FD3}
        sender-receiver-to-signal-mapping={data-element=CPT_MDG1_FlatView.RP_COM_Rx_BRAKE_FD_6_FD3.VD_COM_Rx_TotalAxle_Min_Rq_BSM_FD3, system-signal=SystemSignal_COM_Rx_TotalAxle_Min_Rq_BSM_FD3}
        sender-receiver-to-signal-mapping={data-element=CPT_MDG1_FlatView.RP_COM_Rx_BRAKE_FD_6_FD3.VD_COM_Rx_TotalAxle_Rq_BSM_FD3, system-signal=SystemSignal_COM_Rx_TotalAxle_Rq_BSM_FD3}
        sender-receiver-to-signal-mapping={data-element=CPT_MDG1_FlatView.RP_COM_Rx_CVPAM_FD_Info.VD_COM_Rx_SPMControlSts, system-signal=SystemSignal_COM_Rx_SPMControlSts}
        sender-receiver-to-signal-mapping={data-element=CPT_MDG1_FlatView.RP_COM_Rx_DRIVETRAIN_FD_3.VD_COM_Rx_CRC_DRIVETRAIN3, system-signal=SystemSignal_COM_Rx_CRC_DRIVETRAIN3}
        sender-receiver-to-signal-mapping={data-element=CPT_MDG1_FlatView.RP_COM_Rx_DRIVETRAIN_FD_3.VD_COM_Rx_MessageCounter_DRIVETRAIN3, system-signal=SystemSignal_COM_Rx_MessageCounter_DRIVETRAIN3}
        sender-receiver-to-signal-mapping={data-element=CPT_MDG1_FlatView.RP_COM_Rx_DRIVETRAIN_FD_3.VD_COM_Rx_TCASERANGESTATUS, system-signal=SystemSignal_COM_Rx_TCASERANGESTATUS}
        sender-receiver-to-signal-mapping={data-element=CPT_MDG1_FlatView.RP_COM_Rx_EPS_FD_2.VD_COM_Rx_EPS_Warn_Disp_Rq, system-signal=SystemSignal_COM_Rx_EPS_Warn_Disp_Rq}
        sender-receiver-to-signal-mapping={data-element=CPT_MDG1_FlatView.RP_COM_Rx_FOTA_MASTER.VD_COM_Rx_FOTA_Install_Type, system-signal=SystemSignal_COM_Rx_FOTA_Install_Type}
        sender-receiver-to-signal-mapping={data-element=CPT_MDG1_FlatView.RP_COM_Rx_FOTA_MASTER.VD_COM_Rx_FOTA_Status, system-signal=SystemSignal_COM_Rx_FOTA_Status}
        sender-receiver-to-signal-mapping={data-element=CPT_MDG1_FlatView.RP_COM_Rx_GPF_DATA_FD_1.VD_COM_Rx_GPF_T1_Status, system-signal=SystemSignal_COM_Rx_GPF_T1_Status}
        sender-receiver-to-signal-mapping={data-element=CPT_MDG1_FlatView.RP_COM_Rx_GPF_DATA_FD_1.VD_COM_Rx_GPF_T1_TEMP, system-signal=SystemSignal_COM_Rx_GPF_T1_TEMP}
        sender-receiver-to-signal-mapping={data-element=CPT_MDG1_FlatView.RP_COM_Rx_GPF_DATA_FD_1.VD_COM_Rx_GPF_T2_Status, system-signal=SystemSignal_COM_Rx_GPF_T2_Status}
        sender-receiver-to-signal-mapping={data-element=CPT_MDG1_FlatView.RP_COM_Rx_GPF_DATA_FD_1.VD_COM_Rx_GPF_T2_TEMP, system-signal=SystemSignal_COM_Rx_GPF_T2_TEMP}
        sender-receiver-to-signal-mapping={data-element=CPT_MDG1_FlatView.RP_COM_Rx_HVBATTERY1.VD_COM_Rx_CODE_CLR_BPCM, system-signal=SystemSignal_COM_Rx_CODE_CLR_BPCM}
        sender-receiver-to-signal-mapping={data-element=CPT_MDG1_FlatView.RP_COM_Rx_HVBATTERY1.VD_COM_Rx_HVBatteryCurrent, system-signal=SystemSignal_COM_Rx_HVBatteryCurrent}
        sender-receiver-to-signal-mapping={data-element=CPT_MDG1_FlatView.RP_COM_Rx_HVBATTERY1.VD_COM_Rx_REPRGD_PFC_CLR_BPCM, system-signal=SystemSignal_COM_Rx_REPRGD_PFC_CLR_BPCM}
        sender-receiver-to-signal-mapping={data-element=CPT_MDG1_FlatView.RP_COM_Rx_HVBATTERY2.VD_COM_Rx_HVBatteryMILRequest, system-signal=SystemSignal_COM_Rx_HVBatteryMILRequest}
        sender-receiver-to-signal-mapping={data-element=CPT_MDG1_FlatView.RP_COM_Rx_HVBATTERY2.VD_COM_Rx_HVBatterySOC, system-signal=SystemSignal_COM_Rx_HVBatterySOC}
        sender-receiver-to-signal-mapping={data-element=CPT_MDG1_FlatView.RP_COM_Rx_HVBATTERY2.VD_COM_Rx_HVBatterySOCV, system-signal=SystemSignal_COM_Rx_HVBatterySOCV}
        sender-receiver-to-signal-mapping={data-element=CPT_MDG1_FlatView.RP_COM_Rx_HVBATTERY3.VD_COM_Rx_HVBatChargePower_Instant, system-signal=SystemSignal_COM_Rx_HVBatChargePower_Instant}
        sender-receiver-to-signal-mapping={data-element=CPT_MDG1_FlatView.RP_COM_Rx_HVBATTERY3.VD_COM_Rx_HVBatChargePower_InstantV, system-signal=SystemSignal_COM_Rx_HVBatChargePower_InstantV}
        sender-receiver-to-signal-mapping={data-element=CPT_MDG1_FlatView.RP_COM_Rx_HVBATTERY3.VD_COM_Rx_HVBatChargePower_Long, system-signal=SystemSignal_COM_Rx_HVBatChargePower_Long}
        sender-receiver-to-signal-mapping={data-element=CPT_MDG1_FlatView.RP_COM_Rx_HVBATTERY3.VD_COM_Rx_HVBatChargePower_LongV, system-signal=SystemSignal_COM_Rx_HVBatChargePower_LongV}
        sender-receiver-to-signal-mapping={data-element=CPT_MDG1_FlatView.RP_COM_Rx_HVBATTERY3.VD_COM_Rx_HVBatChargePower_Short, system-signal=SystemSignal_COM_Rx_HVBatChargePower_Short}
        sender-receiver-to-signal-mapping={data-element=CPT_MDG1_FlatView.RP_COM_Rx_HVBATTERY3.VD_COM_Rx_HVBatChargePower_ShortV, system-signal=SystemSignal_COM_Rx_HVBatChargePower_ShortV}
        sender-receiver-to-signal-mapping={data-element=CPT_MDG1_FlatView.RP_COM_Rx_HVBATTERY3.VD_COM_Rx_HVBatDischargePower_LongV, system-signal=SystemSignal_COM_Rx_HVBatDischargePower_LongV}
        sender-receiver-to-signal-mapping={data-element=CPT_MDG1_FlatView.RP_COM_Rx_HVBATTERY5.VD_COM_Rx_HVBattery_RealTimeClock, system-signal=SystemSignal_COM_Rx_HVBattery_RealTimeClock}
        sender-receiver-to-signal-mapping={data-element=CPT_MDG1_FlatView.RP_COM_Rx_HVBATTERY5.VD_COM_Rx_HVBattery_RealTimeClockV, system-signal=SystemSignal_COM_Rx_HVBattery_RealTimeClockV}
        sender-receiver-to-signal-mapping={data-element=CPT_MDG1_FlatView.RP_COM_Rx_HV_CHARGER1.VD_COM_Rx_CODE_CLR_IDCM, system-signal=SystemSignal_COM_Rx_CODE_CLR_IDCM}
        sender-receiver-to-signal-mapping={data-element=CPT_MDG1_FlatView.RP_COM_Rx_HV_CHARGER1.VD_COM_Rx_REPRGD_PFC_CLR_IDCM, system-signal=SystemSignal_COM_Rx_REPRGD_PFC_CLR_IDCM}
        sender-receiver-to-signal-mapping={data-element=CPT_MDG1_FlatView.RP_COM_Rx_HYBRID_DISPLAY.VD_COM_Rx_HybridMILRequest, system-signal=SystemSignal_COM_Rx_HybridMILRequest}
        sender-receiver-to-signal-mapping={data-element=CPT_MDG1_FlatView.RP_COM_Rx_HYBRID_HVAC.VD_COM_Rx_ElecClntHtrInletTemp, system-signal=SystemSignal_COM_Rx_ElecClntHtrInletTemp}
        sender-receiver-to-signal-mapping={data-element=CPT_MDG1_FlatView.RP_COM_Rx_HYBRID_HVAC.VD_COM_Rx_ElecCoolantHtrPwr, system-signal=SystemSignal_COM_Rx_ElecCoolantHtrPwr}
        sender-receiver-to-signal-mapping={data-element=CPT_MDG1_FlatView.RP_COM_Rx_HYBRID_HVAC.VD_COM_Rx_HTAuxPmpMontrngRPM, system-signal=SystemSignal_COM_Rx_HTAuxPmpMontrngRPM}
        sender-receiver-to-signal-mapping={data-element=CPT_MDG1_FlatView.RP_COM_Rx_HYBRID_HVAC.VD_COM_Rx_HTAuxPmpRPMAct, system-signal=SystemSignal_COM_Rx_HTAuxPmpRPMAct}
        sender-receiver-to-signal-mapping={data-element=CPT_MDG1_FlatView.RP_COM_Rx_HYBRID_HVAC.VD_COM_Rx_HTShtOffVlvReq, system-signal=SystemSignal_COM_Rx_HTShtOffVlvReq}
        sender-receiver-to-signal-mapping={data-element=CPT_MDG1_FlatView.RP_COM_Rx_HYBRID_HVAC.VD_COM_Rx_HeaterCoreInletTemp, system-signal=SystemSignal_COM_Rx_HeaterCoreInletTemp}
        sender-receiver-to-signal-mapping={data-element=CPT_MDG1_FlatView.RP_COM_Rx_HYBRID_THERMAL_COMMAND.VD_COM_Rx_AirflowRequest, system-signal=SystemSignal_COM_Rx_AirflowRequest}
        sender-receiver-to-signal-mapping={data-element=CPT_MDG1_FlatView.RP_COM_Rx_HYBRID_THERMAL_COMMAND.VD_COM_Rx_LTR_PumpFlowRequest, system-signal=SystemSignal_COM_Rx_LTR_PumpFlowRequest}
        sender-receiver-to-signal-mapping={data-element=CPT_MDG1_FlatView.RP_COM_Rx_HYBRID_THERMAL_COMMAND.VD_COM_Rx_PECP2_PumpSpeedActual, system-signal=SystemSignal_COM_Rx_PECP2_PumpSpeedActual}
        sender-receiver-to-signal-mapping={data-element=CPT_MDG1_FlatView.RP_COM_Rx_HYBRID_THERMAL_COMMAND.VD_COM_Rx_PECP_PumpSpeedActual, system-signal=SystemSignal_COM_Rx_PECP_PumpSpeedActual}
        sender-receiver-to-signal-mapping={data-element=CPT_MDG1_FlatView.RP_COM_Rx_HYBRID_THERMAL_COMMAND.VD_COM_Rx_PE_CoolTempIn, system-signal=SystemSignal_COM_Rx_PE_CoolTempIn}
        sender-receiver-to-signal-mapping={data-element=CPT_MDG1_FlatView.RP_COM_Rx_HYBRID_THERMAL_COMMAND.VD_COM_Rx_PE_CoolTempOut, system-signal=SystemSignal_COM_Rx_PE_CoolTempOut}
        sender-receiver-to-signal-mapping={data-element=CPT_MDG1_FlatView.RP_COM_Rx_HYBRID_THERMAL_COMMAND.VD_COM_Rx_RadiatorFanSts, system-signal=SystemSignal_COM_Rx_RadiatorFanSts}
        sender-receiver-to-signal-mapping={data-element=CPT_MDG1_FlatView.RP_COM_Rx_IBS3_DATA_1.VD_COM_Rx_CRC_IBS3DATA1, system-signal=SystemSignal_COM_Rx_CRC_IBS3DATA1}
        sender-receiver-to-signal-mapping={data-element=CPT_MDG1_FlatView.RP_COM_Rx_IBS3_DATA_1.VD_COM_Rx_CurrBattFailStatus, system-signal=SystemSignal_COM_Rx_CurrBattFailStatus}
        sender-receiver-to-signal-mapping={data-element=CPT_MDG1_FlatView.RP_COM_Rx_IBS3_DATA_1.VD_COM_Rx_IBS3_Error_Internal, system-signal=SystemSignal_COM_Rx_IBS3_Error_Internal}
        sender-receiver-to-signal-mapping={data-element=CPT_MDG1_FlatView.RP_COM_Rx_IBS3_DATA_1.VD_COM_Rx_IBS3_Ibatt, system-signal=SystemSignal_COM_Rx_IBS3_Ibatt}
        sender-receiver-to-signal-mapping={data-element=CPT_MDG1_FlatView.RP_COM_Rx_IBS3_DATA_1.VD_COM_Rx_IBS3_SOF_VC, system-signal=SystemSignal_COM_Rx_IBS3_SOF_VC}
        sender-receiver-to-signal-mapping={data-element=CPT_MDG1_FlatView.RP_COM_Rx_IBS3_DATA_1.VD_COM_Rx_IBS3_SOF_V_Accuracy, system-signal=SystemSignal_COM_Rx_IBS3_SOF_V_Accuracy}
        sender-receiver-to-signal-mapping={data-element=CPT_MDG1_FlatView.RP_COM_Rx_IBS3_DATA_1.VD_COM_Rx_IBS3_Vbatt, system-signal=SystemSignal_COM_Rx_IBS3_Vbatt}
        sender-receiver-to-signal-mapping={data-element=CPT_MDG1_FlatView.RP_COM_Rx_IBS3_DATA_1.VD_COM_Rx_MessageCounter_IBS3DATA1, system-signal=SystemSignal_COM_Rx_MessageCounter_IBS3DATA1}
        sender-receiver-to-signal-mapping={data-element=CPT_MDG1_FlatView.RP_COM_Rx_IBS3_DATA_1.VD_COM_Rx_RsErrIBS3, system-signal=SystemSignal_COM_Rx_RsErrIBS3}
        sender-receiver-to-signal-mapping={data-element=CPT_MDG1_FlatView.RP_COM_Rx_IBS3_DATA_1.VD_COM_Rx_VoltBattFailStatus, system-signal=SystemSignal_COM_Rx_VoltBattFailStatus}
        sender-receiver-to-signal-mapping={data-element=CPT_MDG1_FlatView.RP_COM_Rx_IBS3_DATA_2.VD_COM_Rx_IBS3_FLAG_DISCONNECT, system-signal=SystemSignal_COM_Rx_IBS3_FLAG_DISCONNECT}
        sender-receiver-to-signal-mapping={data-element=CPT_MDG1_FlatView.RP_COM_Rx_IBS3_DATA_2.VD_COM_Rx_IBS3_SOC, system-signal=SystemSignal_COM_Rx_IBS3_SOC}
        sender-receiver-to-signal-mapping={data-element=CPT_MDG1_FlatView.RP_COM_Rx_IBS3_DATA_2.VD_COM_Rx_IBS3_SOC_Accuracy, system-signal=SystemSignal_COM_Rx_IBS3_SOC_Accuracy}
        sender-receiver-to-signal-mapping={data-element=CPT_MDG1_FlatView.RP_COM_Rx_IBS3_DATA_2.VD_COM_Rx_IBS3_SOH_Q, system-signal=SystemSignal_COM_Rx_IBS3_SOH_Q}
        sender-receiver-to-signal-mapping={data-element=CPT_MDG1_FlatView.RP_COM_Rx_IBS3_DATA_2.VD_COM_Rx_IBS3_SOH_Q_Accuracy, system-signal=SystemSignal_COM_Rx_IBS3_SOH_Q_Accuracy}
        sender-receiver-to-signal-mapping={data-element=CPT_MDG1_FlatView.RP_COM_Rx_IBS3_DATA_2.VD_COM_Rx_IBS3_T_BATT, system-signal=SystemSignal_COM_Rx_IBS3_T_BATT}
        sender-receiver-to-signal-mapping={data-element=CPT_MDG1_FlatView.RP_COM_Rx_IBS3_DATA_2.VD_COM_Rx_IBS3_TempFailStatus, system-signal=SystemSignal_COM_Rx_IBS3_TempFailStatus}
        sender-receiver-to-signal-mapping={data-element=CPT_MDG1_FlatView.RP_COM_Rx_IMMO_SOP_REQUEST.VD_COM_Rx_IMMO_SOP_REQUEST, system-signal=SystemSignal_COM_Rx_IMMO_SOP_REQUEST}
        sender-receiver-to-signal-mapping={data-element=CPT_MDG1_FlatView.RP_COM_Rx_IMPACT_INFO.VD_COM_Rx_IMPACTCommand, system-signal=SystemSignal_COM_Rx_IMPACTCommand}
        sender-receiver-to-signal-mapping={data-element=CPT_MDG1_FlatView.RP_COM_Rx_IMPACT_INFO.VD_COM_Rx_IMPACTConfirm, system-signal=SystemSignal_COM_Rx_IMPACTConfirm}
        sender-receiver-to-signal-mapping={data-element=CPT_MDG1_FlatView.RP_COM_Rx_IMPACT_INFO.VD_COM_Rx_IMPACTThreshold, system-signal=SystemSignal_COM_Rx_IMPACTThreshold}
        sender-receiver-to-signal-mapping={data-element=CPT_MDG1_FlatView.RP_COM_Rx_IPC_FD_1.VD_COM_Rx_CRC_IPC1, system-signal=SystemSignal_COM_Rx_CRC_IPC1}
        sender-receiver-to-signal-mapping={data-element=CPT_MDG1_FlatView.RP_COM_Rx_IPC_FD_1.VD_COM_Rx_MessageCounter_IPC1, system-signal=SystemSignal_COM_Rx_MessageCounter_IPC1}
        sender-receiver-to-signal-mapping={data-element=CPT_MDG1_FlatView.RP_COM_Rx_IPC_FD_1.VD_COM_Rx_TotalOdometer, system-signal=SystemSignal_COM_Rx_TotalOdometer}
        sender-receiver-to-signal-mapping={data-element=CPT_MDG1_FlatView.RP_COM_Rx_IPC_FD_1.VD_COM_Rx_WTS_LmpRqOn, system-signal=SystemSignal_COM_Rx_WTS_LmpRqOn}
        sender-receiver-to-signal-mapping={data-element=CPT_MDG1_FlatView.RP_COM_Rx_IPC_FD_4.VD_COM_Rx_CFG_Manual_DPF, system-signal=SystemSignal_COM_Rx_CFG_Manual_DPF}
        sender-receiver-to-signal-mapping={data-element=CPT_MDG1_FlatView.RP_COM_Rx_IPC_FD_4.VD_COM_Rx_DisplayedSpeedLimSts, system-signal=SystemSignal_COM_Rx_DisplayedSpeedLimSts}
        sender-receiver-to-signal-mapping={data-element=CPT_MDG1_FlatView.RP_COM_Rx_IPC_FD_4.VD_COM_Rx_FuelFltrRst, system-signal=SystemSignal_COM_Rx_FuelFltrRst}
        sender-receiver-to-signal-mapping={data-element=CPT_MDG1_FlatView.RP_COM_Rx_IPC_FD_4.VD_COM_Rx_OilChgRst, system-signal=SystemSignal_COM_Rx_OilChgRst}
        sender-receiver-to-signal-mapping={data-element=CPT_MDG1_FlatView.RP_COM_Rx_IPC_VEHICLE_SETUP.VD_COM_Rx_Dist_Unit, system-signal=SystemSignal_COM_Rx_Dist_Unit}
        sender-receiver-to-signal-mapping={data-element=CPT_MDG1_FlatView.RP_COM_Rx_IPC_VEHICLE_SETUP.VD_COM_Rx_New_Spd_Zone_Ind, system-signal=SystemSignal_COM_Rx_New_Spd_Zone_Ind}
        sender-receiver-to-signal-mapping={data-element=CPT_MDG1_FlatView.RP_COM_Rx_IPC_VEHICLE_SETUP.VD_COM_Rx_Speed_Unit, system-signal=SystemSignal_COM_Rx_Speed_Unit}
        sender-receiver-to-signal-mapping={data-element=CPT_MDG1_FlatView.RP_COM_Rx_IPC_VEHICLE_SETUP.VD_COM_Rx_Traffic_Sign_Info, system-signal=SystemSignal_COM_Rx_Traffic_Sign_Info}
        sender-receiver-to-signal-mapping={data-element=CPT_MDG1_FlatView.RP_COM_Rx_PT_SYSTEM_FD_1_FD3.VD_COM_Rx_APCM_Rq_PT_FD3, system-signal=SystemSignal_COM_Rx_APCM_Rq_PT_FD3}
        sender-receiver-to-signal-mapping={data-element=CPT_MDG1_FlatView.RP_COM_Rx_PT_SYSTEM_FD_1_FD3.VD_COM_Rx_AWD_Status_PT_FD3, system-signal=SystemSignal_COM_Rx_AWD_Status_PT_FD3}
        sender-receiver-to-signal-mapping={data-element=CPT_MDG1_FlatView.RP_COM_Rx_PT_SYSTEM_FD_1_FD3.VD_COM_Rx_AlternatorFail_PT_FD3, system-signal=SystemSignal_COM_Rx_AlternatorFail_PT_FD3}
        sender-receiver-to-signal-mapping={data-element=CPT_MDG1_FlatView.RP_COM_Rx_PT_SYSTEM_FD_1_FD3.VD_COM_Rx_AtmosphericPressure_PT_FD3, system-signal=SystemSignal_COM_Rx_AtmosphericPressure_PT_FD3}
        sender-receiver-to-signal-mapping={data-element=CPT_MDG1_FlatView.RP_COM_Rx_PT_SYSTEM_FD_1_FD3.VD_COM_Rx_CRC_PT_SYSTEM_FD_1_FD3, system-signal=SystemSignal_COM_Rx_CRC_PT_SYSTEM_FD_1_FD3}
        sender-receiver-to-signal-mapping={data-element=CPT_MDG1_FlatView.RP_COM_Rx_PT_SYSTEM_FD_1_FD3.VD_COM_Rx_CrankEnable_PT_FD3, system-signal=SystemSignal_COM_Rx_CrankEnable_PT_FD3}
        sender-receiver-to-signal-mapping={data-element=CPT_MDG1_FlatView.RP_COM_Rx_PT_SYSTEM_FD_1_FD3.VD_COM_Rx_DriveReady_PT_FD3, system-signal=SystemSignal_COM_Rx_DriveReady_PT_FD3}
        sender-receiver-to-signal-mapping={data-element=CPT_MDG1_FlatView.RP_COM_Rx_PT_SYSTEM_FD_1_FD3.VD_COM_Rx_DriverPowerReq_PT_FD3, system-signal=SystemSignal_COM_Rx_DriverPowerReq_PT_FD3}
        sender-receiver-to-signal-mapping={data-element=CPT_MDG1_FlatView.RP_COM_Rx_PT_SYSTEM_FD_1_FD3.VD_COM_Rx_DrvAway_Alert_PT_FD3, system-signal=SystemSignal_COM_Rx_DrvAway_Alert_PT_FD3}
        sender-receiver-to-signal-mapping={data-element=CPT_MDG1_FlatView.RP_COM_Rx_PT_SYSTEM_FD_1_FD3.VD_COM_Rx_DrvAway_Inhibit_PT_FD3, system-signal=SystemSignal_COM_Rx_DrvAway_Inhibit_PT_FD3}
        sender-receiver-to-signal-mapping={data-element=CPT_MDG1_FlatView.RP_COM_Rx_PT_SYSTEM_FD_1_FD3.VD_COM_Rx_ESS_RqShftPark_PT_FD3, system-signal=SystemSignal_COM_Rx_ESS_RqShftPark_PT_FD3}
        sender-receiver-to-signal-mapping={data-element=CPT_MDG1_FlatView.RP_COM_Rx_PT_SYSTEM_FD_1_FD3.VD_COM_Rx_EVCU2_THA_Resp_FD3, system-signal=SystemSignal_COM_Rx_EVCU2_THA_Resp_FD3}
        sender-receiver-to-signal-mapping={data-element=CPT_MDG1_FlatView.RP_COM_Rx_PT_SYSTEM_FD_1_FD3.VD_COM_Rx_GasPedalPositionFailSts_PT_FD3, system-signal=SystemSignal_COM_Rx_GasPedalPositionFailSts_PT_FD3}
        sender-receiver-to-signal-mapping={data-element=CPT_MDG1_FlatView.RP_COM_Rx_PT_SYSTEM_FD_1_FD3.VD_COM_Rx_GasPedalPosition_PT_FD3, system-signal=SystemSignal_COM_Rx_GasPedalPosition_PT_FD3}
        sender-receiver-to-signal-mapping={data-element=CPT_MDG1_FlatView.RP_COM_Rx_PT_SYSTEM_FD_1_FD3.VD_COM_Rx_GearEngagedForDisplay_PT_FD3, system-signal=SystemSignal_COM_Rx_GearEngagedForDisplay_PT_FD3}
        sender-receiver-to-signal-mapping={data-element=CPT_MDG1_FlatView.RP_COM_Rx_PT_SYSTEM_FD_1_FD3.VD_COM_Rx_GearEngaged_PT_FD3, system-signal=SystemSignal_COM_Rx_GearEngaged_PT_FD3}
        sender-receiver-to-signal-mapping={data-element=CPT_MDG1_FlatView.RP_COM_Rx_PT_SYSTEM_FD_1_FD3.VD_COM_Rx_GearIndicationSts_PT_FD3, system-signal=SystemSignal_COM_Rx_GearIndicationSts_PT_FD3}
        sender-receiver-to-signal-mapping={data-element=CPT_MDG1_FlatView.RP_COM_Rx_PT_SYSTEM_FD_1_FD3.VD_COM_Rx_HAS_SoH_PT_FD3, system-signal=SystemSignal_COM_Rx_HAS_SoH_PT_FD3}
        sender-receiver-to-signal-mapping={data-element=CPT_MDG1_FlatView.RP_COM_Rx_PT_SYSTEM_FD_1_FD3.VD_COM_Rx_MessageCounter_PT_SYSTEM_FD_1FD3, system-signal=SystemSignal_COM_Rx_MessageCounter_PT_SYSTEM_FD_1FD3}
        sender-receiver-to-signal-mapping={data-element=CPT_MDG1_FlatView.RP_COM_Rx_PT_SYSTEM_FD_1_FD3.VD_COM_Rx_ParkingFailSts_PT_FD3, system-signal=SystemSignal_COM_Rx_ParkingFailSts_PT_FD3}
        sender-receiver-to-signal-mapping={data-element=CPT_MDG1_FlatView.RP_COM_Rx_PT_SYSTEM_FD_1_FD3.VD_COM_Rx_ParkingSts_PT_FD3, system-signal=SystemSignal_COM_Rx_ParkingSts_PT_FD3}
        sender-receiver-to-signal-mapping={data-element=CPT_MDG1_FlatView.RP_COM_Rx_PT_SYSTEM_FD_1_FD3.VD_COM_Rx_PdlPosActual_PT_FD3, system-signal=SystemSignal_COM_Rx_PdlPosActual_PT_FD3}
        sender-receiver-to-signal-mapping={data-element=CPT_MDG1_FlatView.RP_COM_Rx_PT_SYSTEM_FD_1_FD3.VD_COM_Rx_PowertrainPrplsnActv_PT_FD3, system-signal=SystemSignal_COM_Rx_PowertrainPrplsnActv_PT_FD3}
        sender-receiver-to-signal-mapping={data-element=CPT_MDG1_FlatView.RP_COM_Rx_PT_SYSTEM_FD_1_FD3.VD_COM_Rx_R_SHFT_LOCK_PT_FD3, system-signal=SystemSignal_COM_Rx_R_SHFT_LOCK_PT_FD3}
        sender-receiver-to-signal-mapping={data-element=CPT_MDG1_FlatView.RP_COM_Rx_PT_SYSTEM_FD_1_FD3.VD_COM_Rx_RawPVS1_PT_FD3, system-signal=SystemSignal_COM_Rx_RawPVS1_PT_FD3}
        sender-receiver-to-signal-mapping={data-element=CPT_MDG1_FlatView.RP_COM_Rx_PT_SYSTEM_FD_1_FD3.VD_COM_Rx_RawPVS2_PT_FD3, system-signal=SystemSignal_COM_Rx_RawPVS2_PT_FD3}
        sender-receiver-to-signal-mapping={data-element=CPT_MDG1_FlatView.RP_COM_Rx_PT_SYSTEM_FD_1_FD3.VD_COM_Rx_ShiftLeverLockReq_PT_FD3, system-signal=SystemSignal_COM_Rx_ShiftLeverLockReq_PT_FD3}
        sender-receiver-to-signal-mapping={data-element=CPT_MDG1_FlatView.RP_COM_Rx_PT_SYSTEM_FD_1_FD3.VD_COM_Rx_ShiftLeverPosition_PT_FD3, system-signal=SystemSignal_COM_Rx_ShiftLeverPosition_PT_FD3}
        sender-receiver-to-signal-mapping={data-element=CPT_MDG1_FlatView.RP_COM_Rx_PT_SYSTEM_FD_1_FD3.VD_COM_Rx_TargetGear_PT_FD3, system-signal=SystemSignal_COM_Rx_TargetGear_PT_FD3}
        sender-receiver-to-signal-mapping={data-element=CPT_MDG1_FlatView.RP_COM_Rx_PT_SYSTEM_FD_1_FD3.VD_COM_Rx_TerrainModeStat_PT_FD3, system-signal=SystemSignal_COM_Rx_TerrainModeStat_PT_FD3}
        sender-receiver-to-signal-mapping={data-element=CPT_MDG1_FlatView.RP_COM_Rx_PT_SYSTEM_FD_1_FD3.VD_COM_Rx_TransmissionFailSts_PT_FD3, system-signal=SystemSignal_COM_Rx_TransmissionFailSts_PT_FD3}
        sender-receiver-to-signal-mapping={data-element=CPT_MDG1_FlatView.RP_COM_Rx_PT_SYSTEM_FD_1_FD3.VD_COM_Rx_TransmissionWarnings_PT_FD3, system-signal=SystemSignal_COM_Rx_TransmissionWarnings_PT_FD3}
        sender-receiver-to-signal-mapping={data-element=CPT_MDG1_FlatView.RP_COM_Rx_PT_SYSTEM_FD_1_FD3.VD_COM_Rx_TurtleModeSts_PT_FD3, system-signal=SystemSignal_COM_Rx_TurtleModeSts_PT_FD3}
        sender-receiver-to-signal-mapping={data-element=CPT_MDG1_FlatView.RP_COM_Rx_PT_SYSTEM_FD_1_FD3.VD_COM_Rx_VehSpd_Overridden_PT_FD3, system-signal=SystemSignal_COM_Rx_VehSpd_Overridden_PT_FD3}
        sender-receiver-to-signal-mapping={data-element=CPT_MDG1_FlatView.RP_COM_Rx_PT_SYSTEM_FD_1_FD3.VD_COM_Rx_Warn_BTO_PT_FD3, system-signal=SystemSignal_COM_Rx_Warn_BTO_PT_FD3}
        sender-receiver-to-signal-mapping={data-element=CPT_MDG1_FlatView.RP_COM_Rx_RFHUB_FD_1.VD_COM_Rx_IgnPosSts, system-signal=SystemSignal_COM_Rx_IgnPosSts}
        sender-receiver-to-signal-mapping={data-element=CPT_MDG1_FlatView.RP_COM_Rx_STEERING1.VD_COM_Rx_LwsAngle_SCCM, system-signal=SystemSignal_COM_Rx_LwsAngle_SCCM}
        sender-receiver-to-signal-mapping={data-element=CPT_MDG1_FlatView.RP_COM_Rx_STEERING1.VD_COM_Rx_LwsSpeed_SCCM, system-signal=SystemSignal_COM_Rx_LwsSpeed_SCCM}
        sender-receiver-to-signal-mapping={data-element=CPT_MDG1_FlatView.RP_COM_Rx_TELEMATIC_FD_1.VD_COM_Rx_Day1_TLM, system-signal=SystemSignal_COM_Rx_Day1_TLM}
        sender-receiver-to-signal-mapping={data-element=CPT_MDG1_FlatView.RP_COM_Rx_TELEMATIC_FD_1.VD_COM_Rx_Day2_TLM, system-signal=SystemSignal_COM_Rx_Day2_TLM}
        sender-receiver-to-signal-mapping={data-element=CPT_MDG1_FlatView.RP_COM_Rx_TELEMATIC_FD_1.VD_COM_Rx_Hour1_TLM, system-signal=SystemSignal_COM_Rx_Hour1_TLM}
        sender-receiver-to-signal-mapping={data-element=CPT_MDG1_FlatView.RP_COM_Rx_TELEMATIC_FD_1.VD_COM_Rx_Hour2_TLM, system-signal=SystemSignal_COM_Rx_Hour2_TLM}
        sender-receiver-to-signal-mapping={data-element=CPT_MDG1_FlatView.RP_COM_Rx_TELEMATIC_FD_1.VD_COM_Rx_Minute1_TLM, system-signal=SystemSignal_COM_Rx_Minute1_TLM}
        sender-receiver-to-signal-mapping={data-element=CPT_MDG1_FlatView.RP_COM_Rx_TELEMATIC_FD_1.VD_COM_Rx_Minute2_TLM, system-signal=SystemSignal_COM_Rx_Minute2_TLM}
        sender-receiver-to-signal-mapping={data-element=CPT_MDG1_FlatView.RP_COM_Rx_TELEMATIC_FD_1.VD_COM_Rx_Month1_TLM, system-signal=SystemSignal_COM_Rx_Month1_TLM}
        sender-receiver-to-signal-mapping={data-element=CPT_MDG1_FlatView.RP_COM_Rx_TELEMATIC_FD_1.VD_COM_Rx_Month2_TLM, system-signal=SystemSignal_COM_Rx_Month2_TLM}
        sender-receiver-to-signal-mapping={data-element=CPT_MDG1_FlatView.RP_COM_Rx_TELEMATIC_FD_1.VD_COM_Rx_Year{1..4}_TLM, system-signal=SystemSignal_COM_Rx_Year{1..4}_TLM}
        sender-receiver-to-signal-mapping={data-element=CPT_MDG1_FlatView.RP_COM_Rx_TELEMATIC_FD_11.VD_COM_Rx_Launch_RPM_Selected_Setting2, system-signal=SystemSignal_COM_Rx_Launch_RPM_Selected_Setting2}
        sender-receiver-to-signal-mapping={data-element=CPT_MDG1_FlatView.RP_COM_Rx_TELEMATIC_FD_11.VD_COM_Rx_Launch_Sft_Btn_status, system-signal=SystemSignal_COM_Rx_Launch_Sft_Btn_status}
        sender-receiver-to-signal-mapping={data-element=CPT_MDG1_FlatView.RP_COM_Rx_TELEMATIC_FD_14.VD_COM_Rx_PSI_Gr{1..5}_RPM_SET, system-signal=SystemSignal_COM_Rx_PSI_Gr{1..5}_RPM_SET}
        sender-receiver-to-signal-mapping={data-element=CPT_MDG1_FlatView.RP_COM_Rx_TELEMATIC_FD_14.VD_COM_Rx_PSI_RPM_Reset, system-signal=SystemSignal_COM_Rx_PSI_RPM_Reset}
        sender-receiver-to-signal-mapping={data-element=CPT_MDG1_FlatView.RP_COM_Rx_TELEMATIC_FD_14.VD_COM_Rx_PSI_Rq, system-signal=SystemSignal_COM_Rx_PSI_Rq}
        sender-receiver-to-signal-mapping={data-element=CPT_MDG1_FlatView.RP_COM_Rx_TELEMATIC_FD_14.VD_COM_Rx_RACE_CLDWN_ON_OFF_REQ, system-signal=SystemSignal_COM_Rx_RACE_CLDWN_ON_OFF_REQ}
        sender-receiver-to-signal-mapping={data-element=CPT_MDG1_FlatView.RP_COM_Rx_TELEMATIC_FD_5.VD_COM_Rx_GlobDrvMdRq, system-signal=SystemSignal_COM_Rx_GlobDrvMdRq}
        sender-receiver-to-signal-mapping={data-element=CPT_MDG1_FlatView.RP_COM_Rx_VSIM_FD_1.VD_COM_Rx_IdleShutDown_Disable, system-signal=SystemSignal_COM_Rx_IdleShutDown_Disable}
        sender-receiver-to-signal-mapping={data-element=CPT_MDG1_FlatView.RP_COM_Rx_VSIM_FD_1.VD_COM_Rx_J1939_RPM_RQ, system-signal=SystemSignal_COM_Rx_J1939_RPM_RQ}
        sender-receiver-to-signal-mapping={data-element=CPT_MDG1_FlatView.RP_COM_Rx_VSIM_FD_1.VD_COM_Rx_PTO_IdleSpd{1..3}, system-signal=SystemSignal_COM_Rx_PTO_IdleSpd{1..3}}
        sender-receiver-to-signal-mapping={data-element=CPT_MDG1_FlatView.RP_COM_Rx_VSIM_FD_1.VD_COM_Rx_PosEngdSwStat, system-signal=SystemSignal_COM_Rx_PosEngdSwStat}
        sender-receiver-to-signal-mapping={data-element=CPT_MDG1_FlatView.PP_COM_Tx_ENGINE_FD_1_FD3.VD_COM_Tx_ACPressureFailSts_FD3, system-signal=SystemSignal_COM_Tx_ACPressureFailSts_FD3}
        sender-receiver-to-signal-mapping={data-element=CPT_MDG1_FlatView.PP_COM_Tx_ENGINE_FD_1_FD3.VD_COM_Tx_ACPressure_FD3, system-signal=SystemSignal_COM_Tx_ACPressure_FD3}
        sender-receiver-to-signal-mapping={data-element=CPT_MDG1_FlatView.PP_COM_Tx_ENGINE_FD_1_FD3.VD_COM_Tx_AGS2Posn_FD3, system-signal=SystemSignal_COM_Tx_AGS2Posn_FD3}
        sender-receiver-to-signal-mapping={data-element=CPT_MDG1_FlatView.PP_COM_Tx_ENGINE_FD_1_FD3.VD_COM_Tx_AtmosphericPressureFailSts_W_FD3, system-signal=SystemSignal_COM_Tx_AtmosphericPressureFailSts_W_FD3}
        sender-receiver-to-signal-mapping={data-element=CPT_MDG1_FlatView.PP_COM_Tx_ENGINE_FD_1_FD3.VD_COM_Tx_AtmosphericPressure_W_FD3, system-signal=SystemSignal_COM_Tx_AtmosphericPressure_W_FD3}
        sender-receiver-to-signal-mapping={data-element=CPT_MDG1_FlatView.PP_COM_Tx_ENGINE_FD_1_FD3.VD_COM_Tx_BoostVacGauge_FD3, system-signal=SystemSignal_COM_Tx_BoostVacGauge_FD3}
        sender-receiver-to-signal-mapping={data-element=CPT_MDG1_FlatView.PP_COM_Tx_ENGINE_FD_1_FD3.VD_COM_Tx_BrkSw1Stat_FD3, system-signal=SystemSignal_COM_Tx_BrkSw1Stat_FD3}
        sender-receiver-to-signal-mapping={data-element=CPT_MDG1_FlatView.PP_COM_Tx_ENGINE_FD_1_FD3.VD_COM_Tx_BrkSw2Stat_FD3, system-signal=SystemSignal_COM_Tx_BrkSw2Stat_FD3}
        sender-receiver-to-signal-mapping={data-element=CPT_MDG1_FlatView.PP_COM_Tx_ENGINE_FD_1_FD3.VD_COM_Tx_CRC_ENGINE1_FD3, system-signal=SystemSignal_COM_Tx_CRC_ENGINE1_FD3}
        sender-receiver-to-signal-mapping={data-element=CPT_MDG1_FlatView.PP_COM_Tx_ENGINE_FD_1_FD3.VD_COM_Tx_ESP_TrqRqEnabl_FD3, system-signal=SystemSignal_COM_Tx_ESP_TrqRqEnabl_FD3}
        sender-receiver-to-signal-mapping={data-element=CPT_MDG1_FlatView.PP_COM_Tx_ENGINE_FD_1_FD3.VD_COM_Tx_EngMaxRPM_W_FD3, system-signal=SystemSignal_COM_Tx_EngMaxRPM_W_FD3}
        sender-receiver-to-signal-mapping={data-element=CPT_MDG1_FlatView.PP_COM_Tx_ENGINE_FD_1_FD3.VD_COM_Tx_HighPressureFuelSystemFailureFD3, system-signal=SystemSignal_COM_Tx_HighPressureFuelSystemFailureFD3}
        sender-receiver-to-signal-mapping={data-element=CPT_MDG1_FlatView.PP_COM_Tx_ENGINE_FD_1_FD3.VD_COM_Tx_Lv1CrsCtrlOff_FD3, system-signal=SystemSignal_COM_Tx_Lv1CrsCtrlOff_FD3}
        sender-receiver-to-signal-mapping={data-element=CPT_MDG1_FlatView.PP_COM_Tx_ENGINE_FD_1_FD3.VD_COM_Tx_MessageCounter_ENGINE1_FD3, system-signal=SystemSignal_COM_Tx_MessageCounter_ENGINE1_FD3}
        sender-receiver-to-signal-mapping={data-element=CPT_MDG1_FlatView.PP_COM_Tx_ENGINE_FD_1_FD3.VD_COM_Tx_RawPVS1_FD3, system-signal=SystemSignal_COM_Tx_RawPVS1_FD3}
        sender-receiver-to-signal-mapping={data-element=CPT_MDG1_FlatView.PP_COM_Tx_ENGINE_FD_1_FD3.VD_COM_Tx_RawPVS2_FD3, system-signal=SystemSignal_COM_Tx_RawPVS2_FD3}
        sender-receiver-to-signal-mapping={data-element=CPT_MDG1_FlatView.PP_COM_Tx_ENGINE_FD_1_FD3.VD_COM_Tx_RawTPS1_FD3, system-signal=SystemSignal_COM_Tx_RawTPS1_FD3}
        sender-receiver-to-signal-mapping={data-element=CPT_MDG1_FlatView.PP_COM_Tx_ENGINE_FD_1_FD3.VD_COM_Tx_RawTPS2_FD3, system-signal=SystemSignal_COM_Tx_RawTPS2_FD3}
        sender-receiver-to-signal-mapping={data-element=CPT_MDG1_FlatView.PP_COM_Tx_ENGINE_FD_1_FD3.VD_COM_Tx_ThermalManagementActive_W_FD3, system-signal=SystemSignal_COM_Tx_ThermalManagementActive_W_FD3}
        sender-receiver-to-signal-mapping={data-element=CPT_MDG1_FlatView.PP_COM_Tx_ENGINE_FD_1_FD3.VD_COM_Tx_ThrottlePosition_FD3, system-signal=SystemSignal_COM_Tx_ThrottlePosition_FD3}
        sender-receiver-to-signal-mapping={data-element=CPT_MDG1_FlatView.PP_COM_Tx_ENGINE_FD_1_FD3.VD_COM_Tx_TransWarmUpMin_RPM_FD3, system-signal=SystemSignal_COM_Tx_TransWarmUpMin_RPM_FD3}
        sender-receiver-to-signal-mapping={data-element=CPT_MDG1_FlatView.PP_COM_Tx_ENGINE_FD_1_FD3.VD_COM_Tx_TransWarmUpReq_FD3, system-signal=SystemSignal_COM_Tx_TransWarmUpReq_FD3}
        sender-receiver-to-signal-mapping={data-element=CPT_MDG1_FlatView.PP_COM_Tx_ENGINE_FD_1_FD3.VD_COM_Tx_VehicleSetSpeed_W_FD3, system-signal=SystemSignal_COM_Tx_VehicleSetSpeed_W_FD3}
        sender-receiver-to-signal-mapping={data-element=CPT_MDG1_FlatView.PP_COM_Tx_ENGINE_FD_3_FD3.VD_COM_Tx_CRC_ENGINE3_FD3, system-signal=SystemSignal_COM_Tx_CRC_ENGINE3_FD3}
        sender-receiver-to-signal-mapping={data-element=CPT_MDG1_FlatView.PP_COM_Tx_ENGINE_FD_3_FD3.VD_COM_Tx_MessageCounter_ENGINE3_FD3, system-signal=SystemSignal_COM_Tx_MessageCounter_ENGINE3_FD3}
        sender-receiver-to-signal-mapping={data-element=CPT_MDG1_FlatView.PP_COM_Tx_ENGINE_FD_6.VD_COM_Tx_CRC_ENGINE6, system-signal=SystemSignal_COM_Tx_CRC_ENGINE6}
        sender-receiver-to-signal-mapping={data-element=CPT_MDG1_FlatView.PP_COM_Tx_ENGINE_FD_6.VD_COM_Tx_DrvAway_Alert, system-signal=SystemSignal_COM_Tx_DrvAway_Alert}
        sender-receiver-to-signal-mapping={data-element=CPT_MDG1_FlatView.PP_COM_Tx_ENGINE_FD_6.VD_COM_Tx_DrvAway_Indications, system-signal=SystemSignal_COM_Tx_DrvAway_Indications}
        sender-receiver-to-signal-mapping={data-element=CPT_MDG1_FlatView.PP_COM_Tx_ENGINE_FD_6.VD_COM_Tx_DrvAway_Inhibit, system-signal=SystemSignal_COM_Tx_DrvAway_Inhibit}
        sender-receiver-to-signal-mapping={data-element=CPT_MDG1_FlatView.PP_COM_Tx_ENGINE_FD_6.VD_COM_Tx_ECM_FOTA_Conflict, system-signal=SystemSignal_COM_Tx_ECM_FOTA_Conflict}
        sender-receiver-to-signal-mapping={data-element=CPT_MDG1_FlatView.PP_COM_Tx_ENGINE_FD_6.VD_COM_Tx_ECM_MSG_RQ, system-signal=SystemSignal_COM_Tx_ECM_MSG_RQ}
        sender-receiver-to-signal-mapping={data-element=CPT_MDG1_FlatView.PP_COM_Tx_ENGINE_FD_6.VD_COM_Tx_EngineWaterTemp, system-signal=SystemSignal_COM_Tx_EngineWaterTemp}
        sender-receiver-to-signal-mapping={data-element=CPT_MDG1_FlatView.PP_COM_Tx_ENGINE_FD_6.VD_COM_Tx_FuelConsumption_GAG, system-signal=SystemSignal_COM_Tx_FuelConsumption_GAG}
        sender-receiver-to-signal-mapping={data-element=CPT_MDG1_FlatView.PP_COM_Tx_ENGINE_FD_6.VD_COM_Tx_GearShiftIndication, system-signal=SystemSignal_COM_Tx_GearShiftIndication}
        sender-receiver-to-signal-mapping={data-element=CPT_MDG1_FlatView.PP_COM_Tx_ENGINE_FD_6.VD_COM_Tx_HP_MODE_STS, system-signal=SystemSignal_COM_Tx_HP_MODE_STS}
        sender-receiver-to-signal-mapping={data-element=CPT_MDG1_FlatView.PP_COM_Tx_ENGINE_FD_6.VD_COM_Tx_LeakCheckTimerValue, system-signal=SystemSignal_COM_Tx_LeakCheckTimerValue}
        sender-receiver-to-signal-mapping={data-element=CPT_MDG1_FlatView.PP_COM_Tx_ENGINE_FD_6.VD_COM_Tx_LeakTestRequest, system-signal=SystemSignal_COM_Tx_LeakTestRequest}
        sender-receiver-to-signal-mapping={data-element=CPT_MDG1_FlatView.PP_COM_Tx_ENGINE_FD_6.VD_COM_Tx_LeakTestSts, system-signal=SystemSignal_COM_Tx_LeakTestSts}
        sender-receiver-to-signal-mapping={data-element=CPT_MDG1_FlatView.PP_COM_Tx_ENGINE_FD_6.VD_COM_Tx_MessageCounter_ENGINE6, system-signal=SystemSignal_COM_Tx_MessageCounter_ENGINE6}
        sender-receiver-to-signal-mapping={data-element=CPT_MDG1_FlatView.PP_COM_Tx_ENGINE_FD_6.VD_COM_Tx_SAMInfo, system-signal=SystemSignal_COM_Tx_SAMInfo}
        sender-receiver-to-signal-mapping={data-element=CPT_MDG1_FlatView.PP_COM_Tx_ENGINE_FD_6.VD_COM_Tx_Selector_SystemFailSts, system-signal=SystemSignal_COM_Tx_Selector_SystemFailSts}
        sender-receiver-to-signal-mapping={data-element=CPT_MDG1_FlatView.PP_COM_Tx_ENGINE_FD_6.VD_COM_Tx_StartProtectionInhibit, system-signal=SystemSignal_COM_Tx_StartProtectionInhibit}
        sender-receiver-to-signal-mapping={data-element=CPT_MDG1_FlatView.PP_COM_Tx_ENGINE_FD_6.VD_COM_Tx_StartRelayBCMFeedbackFault, system-signal=SystemSignal_COM_Tx_StartRelayBCMFeedbackFault}
        sender-receiver-to-signal-mapping={data-element=CPT_MDG1_FlatView.PP_COM_Tx_ENGINE_FD_6.VD_COM_Tx_StartRelayECMFeedbackFault, system-signal=SystemSignal_COM_Tx_StartRelayECMFeedbackFault}
        sender-receiver-to-signal-mapping={data-element=CPT_MDG1_FlatView.PP_COM_Tx_ENGINE_FD_6.VD_COM_Tx_StarterProtectionTime, system-signal=SystemSignal_COM_Tx_StarterProtectionTime}
        sender-receiver-to-signal-mapping={data-element=CPT_MDG1_FlatView.PP_COM_Tx_ENGINE_FD_6.VD_COM_Tx_TerrainModeDesiredStat, system-signal=SystemSignal_COM_Tx_TerrainModeDesiredStat}
        sender-receiver-to-signal-mapping={data-element=CPT_MDG1_FlatView.PP_COM_Tx_ENGINE_FD_6.VD_COM_Tx_TerrainModeInterfaceButton_ECM, system-signal=SystemSignal_COM_Tx_TerrainModeInterfaceButton_ECM}
        sender-receiver-to-signal-mapping={data-element=CPT_MDG1_FlatView.PP_COM_Tx_ENGINE_FD_6.VD_COM_Tx_TerrainModeStat_ECM, system-signal=SystemSignal_COM_Tx_TerrainModeStat_ECM}
        sender-receiver-to-signal-mapping={data-element=CPT_MDG1_FlatView.PP_COM_Tx_ENGINE_FD_6.VD_COM_Tx_Terrain_HMI_Rq_ECM, system-signal=SystemSignal_COM_Tx_Terrain_HMI_Rq_ECM}
        sender-receiver-to-signal-mapping={data-element=CPT_MDG1_FlatView.PP_COM_Tx_ENGINE_FD_6.VD_COM_Tx_Trns_DrvMdReq_ECM, system-signal=SystemSignal_COM_Tx_Trns_DrvMdReq_ECM}
        sender-receiver-to-signal-mapping={data-element=CPT_MDG1_FlatView.PP_COM_Tx_ENGINE_FD_6.VD_COM_Tx_Trns_DrvMd_CfgSts_ECM, system-signal=SystemSignal_COM_Tx_Trns_DrvMd_CfgSts_ECM}
        sender-receiver-to-signal-mapping={data-element=CPT_MDG1_FlatView.PP_COM_Tx_ENGINE_FD_7_FD3.VD_COM_Tx_CRC_ENGINE7_FD3, system-signal=SystemSignal_COM_Tx_CRC_ENGINE7_FD3}
        sender-receiver-to-signal-mapping={data-element=CPT_MDG1_FlatView.PP_COM_Tx_ENGINE_FD_7_FD3.VD_COM_Tx_MessageCounter_ENGINE7_FD3, system-signal=SystemSignal_COM_Tx_MessageCounter_ENGINE7_FD3}
        sender-receiver-to-signal-mapping={data-element=CPT_MDG1_FlatView.PP_COM_Tx_ENGINE_FD_7_FD3.VD_COM_Tx_PerfShftRq_HUD_FD3, system-signal=SystemSignal_COM_Tx_PerfShftRq_HUD_FD3}
        sender-receiver-to-signal-mapping={data-element=CPT_MDG1_FlatView.PP_COM_Tx_ENGINE_FD_8.VD_COM_Tx_AFTER_RUN_STATUS, system-signal=SystemSignal_COM_Tx_AFTER_RUN_STATUS}
        sender-receiver-to-signal-mapping={data-element=CPT_MDG1_FlatView.PP_COM_Tx_ENGINE_FD_8.VD_COM_Tx_AM_ECM_Prsnt, system-signal=SystemSignal_COM_Tx_AM_ECM_Prsnt}
        sender-receiver-to-signal-mapping={data-element=CPT_MDG1_FlatView.PP_COM_Tx_ENGINE_FD_8.VD_COM_Tx_COOLING_REQUIRED_STATUS, system-signal=SystemSignal_COM_Tx_COOLING_REQUIRED_STATUS}
        sender-receiver-to-signal-mapping={data-element=CPT_MDG1_FlatView.PP_COM_Tx_ENGINE_FD_8.VD_COM_Tx_CRC_ENGINE8, system-signal=SystemSignal_COM_Tx_CRC_ENGINE8}
        sender-receiver-to-signal-mapping={data-element=CPT_MDG1_FlatView.PP_COM_Tx_ENGINE_FD_8.VD_COM_Tx_ENGINE_RESET, system-signal=SystemSignal_COM_Tx_ENGINE_RESET}
        sender-receiver-to-signal-mapping={data-element=CPT_MDG1_FlatView.PP_COM_Tx_ENGINE_FD_8.VD_COM_Tx_GF_Charge, system-signal=SystemSignal_COM_Tx_GF_Charge}
        sender-receiver-to-signal-mapping={data-element=CPT_MDG1_FlatView.PP_COM_Tx_ENGINE_FD_8.VD_COM_Tx_HOOD_AJAR_STATUS, system-signal=SystemSignal_COM_Tx_HOOD_AJAR_STATUS}
        sender-receiver-to-signal-mapping={data-element=CPT_MDG1_FlatView.PP_COM_Tx_ENGINE_FD_8.VD_COM_Tx_LTR_TARGET_TEMP, system-signal=SystemSignal_COM_Tx_LTR_TARGET_TEMP}
        sender-receiver-to-signal-mapping={data-element=CPT_MDG1_FlatView.PP_COM_Tx_ENGINE_FD_8.VD_COM_Tx_MAP_4_BAR, system-signal=SystemSignal_COM_Tx_MAP_4_BAR}
        sender-receiver-to-signal-mapping={data-element=CPT_MDG1_FlatView.PP_COM_Tx_ENGINE_FD_8.VD_COM_Tx_MdsAct, system-signal=SystemSignal_COM_Tx_MdsAct}
        sender-receiver-to-signal-mapping={data-element=CPT_MDG1_FlatView.PP_COM_Tx_ENGINE_FD_8.VD_COM_Tx_MdsActforANC, system-signal=SystemSignal_COM_Tx_MdsActforANC}
        sender-receiver-to-signal-mapping={data-element=CPT_MDG1_FlatView.PP_COM_Tx_ENGINE_FD_8.VD_COM_Tx_MessageCounter_ENGINE8, system-signal=SystemSignal_COM_Tx_MessageCounter_ENGINE8}
        sender-receiver-to-signal-mapping={data-element=CPT_MDG1_FlatView.PP_COM_Tx_ENGINE_FD_8.VD_COM_Tx_OIL_PRESS, system-signal=SystemSignal_COM_Tx_OIL_PRESS}
        sender-receiver-to-signal-mapping={data-element=CPT_MDG1_FlatView.PP_COM_Tx_ENGINE_FD_8.VD_COM_Tx_PCPM_PumpSpeedAct, system-signal=SystemSignal_COM_Tx_PCPM_PumpSpeedAct}
        sender-receiver-to-signal-mapping={data-element=CPT_MDG1_FlatView.PP_COM_Tx_ENGINE_FD_8.VD_COM_Tx_PSI_EnableSts, system-signal=SystemSignal_COM_Tx_PSI_EnableSts}
        sender-receiver-to-signal-mapping={data-element=CPT_MDG1_FlatView.PP_COM_Tx_ENGINE_FD_8.VD_COM_Tx_PSI_Gr{1..5}_RPM, system-signal=SystemSignal_COM_Tx_PSI_Gr{1..5}_RPM}
        sender-receiver-to-signal-mapping={data-element=CPT_MDG1_FlatView.PP_COM_Tx_ENGINE_FD_8.VD_COM_Tx_PSI_Max_RPM, system-signal=SystemSignal_COM_Tx_PSI_Max_RPM}
        sender-receiver-to-signal-mapping={data-element=CPT_MDG1_FlatView.PP_COM_Tx_ENGINE_FD_8.VD_COM_Tx_RACE_CLDWN_BATT_STAT, system-signal=SystemSignal_COM_Tx_RACE_CLDWN_BATT_STAT}
        sender-receiver-to-signal-mapping={data-element=CPT_MDG1_FlatView.PP_COM_Tx_ENGINE_FD_8.VD_COM_Tx_RACE_CLDWN_DEAC_TIME, system-signal=SystemSignal_COM_Tx_RACE_CLDWN_DEAC_TIME}
        sender-receiver-to-signal-mapping={data-element=CPT_MDG1_FlatView.PP_COM_Tx_ENGINE_FD_8.VD_COM_Tx_RACE_CLDWN_SEL, system-signal=SystemSignal_COM_Tx_RACE_CLDWN_SEL}
        sender-receiver-to-signal-mapping={data-element=CPT_MDG1_FlatView.PP_COM_Tx_ENGINE_FD_8.VD_COM_Tx_RefuelEvent, system-signal=SystemSignal_COM_Tx_RefuelEvent}
        sender-receiver-to-signal-mapping={data-element=CPT_MDG1_FlatView.PP_COM_Tx_ENGINE_FD_8.VD_COM_Tx_RefuelIndication, system-signal=SystemSignal_COM_Tx_RefuelIndication}
        sender-receiver-to-signal-mapping={data-element=CPT_MDG1_FlatView.PP_COM_Tx_ENGINE_FD_8.VD_COM_Tx_RevOilLifeRst, system-signal=SystemSignal_COM_Tx_RevOilLifeRst}
        sender-receiver-to-signal-mapping={data-element=CPT_MDG1_FlatView.PP_COM_Tx_ENGINE_FD_8.VD_COM_Tx_SYSTEM_STATUS, system-signal=SystemSignal_COM_Tx_SYSTEM_STATUS}
        sender-receiver-to-signal-mapping={data-element=CPT_MDG1_FlatView.PP_COM_Tx_ENGINE_FD_9.VD_COM_Tx_IdleShutDwnApply, system-signal=SystemSignal_COM_Tx_IdleShutDwnApply}
        sender-receiver-to-signal-mapping={data-element=CPT_MDG1_FlatView.PP_COM_Tx_ENGINE_FD_9.VD_COM_Tx_PTO_Acc_Intlk, system-signal=SystemSignal_COM_Tx_PTO_Acc_Intlk}
        sender-receiver-to-signal-mapping={data-element=CPT_MDG1_FlatView.PP_COM_Tx_ENGINE_FD_9.VD_COM_Tx_PTO_Active, system-signal=SystemSignal_COM_Tx_PTO_Active}
        sender-receiver-to-signal-mapping={data-element=CPT_MDG1_FlatView.PP_COM_Tx_ENGINE_FD_9.VD_COM_Tx_PTO_AutoRsm, system-signal=SystemSignal_COM_Tx_PTO_AutoRsm}
        sender-receiver-to-signal-mapping={data-element=CPT_MDG1_FlatView.PP_COM_Tx_ENGINE_FD_9.VD_COM_Tx_PTO_ENGD_RQ, system-signal=SystemSignal_COM_Tx_PTO_ENGD_RQ}
        sender-receiver-to-signal-mapping={data-element=CPT_MDG1_FlatView.PP_COM_Tx_ENGINE_FD_9.VD_COM_Tx_PTO_High_Idle_Enable, system-signal=SystemSignal_COM_Tx_PTO_High_Idle_Enable}
        sender-receiver-to-signal-mapping={data-element=CPT_MDG1_FlatView.PP_COM_Tx_ENGINE_FD_9.VD_COM_Tx_PTO_High_Idle_RPM, system-signal=SystemSignal_COM_Tx_PTO_High_Idle_RPM}
        sender-receiver-to-signal-mapping={data-element=CPT_MDG1_FlatView.PP_COM_Tx_ENGINE_FD_9.VD_COM_Tx_PTO_HornRq, system-signal=SystemSignal_COM_Tx_PTO_HornRq}
        sender-receiver-to-signal-mapping={data-element=CPT_MDG1_FlatView.PP_COM_Tx_ENGINE_FD_9.VD_COM_Tx_PTO_Incab, system-signal=SystemSignal_COM_Tx_PTO_Incab}
        sender-receiver-to-signal-mapping={data-element=CPT_MDG1_FlatView.PP_COM_Tx_ENGINE_FD_9.VD_COM_Tx_PTO_MaxVehSpd, system-signal=SystemSignal_COM_Tx_PTO_MaxVehSpd}
        sender-receiver-to-signal-mapping={data-element=CPT_MDG1_FlatView.PP_COM_Tx_ENGINE_FD_9.VD_COM_Tx_PTO_Md, system-signal=SystemSignal_COM_Tx_PTO_Md}
        sender-receiver-to-signal-mapping={data-element=CPT_MDG1_FlatView.PP_COM_Tx_ENGINE_FD_9.VD_COM_Tx_PTO_Park_Brk_Required, system-signal=SystemSignal_COM_Tx_PTO_Park_Brk_Required}
        sender-receiver-to-signal-mapping={data-element=CPT_MDG1_FlatView.PP_COM_Tx_ENGINE_FD_9.VD_COM_Tx_PTO_RPM{1..3}, system-signal=SystemSignal_COM_Tx_PTO_RPM{1..3}}
        sender-receiver-to-signal-mapping={data-element=CPT_MDG1_FlatView.PP_COM_Tx_ENGINE_FD_9.VD_COM_Tx_PTO_Ramp_Rate, system-signal=SystemSignal_COM_Tx_PTO_Ramp_Rate}
        sender-receiver-to-signal-mapping={data-element=CPT_MDG1_FlatView.PP_COM_Tx_ENGINE_FD_9.VD_COM_Tx_PTO_Remote_RPM_Method, system-signal=SystemSignal_COM_Tx_PTO_Remote_RPM_Method}
        sender-receiver-to-signal-mapping={data-element=CPT_MDG1_FlatView.PP_COM_Tx_ENGINE_FD_9.VD_COM_Tx_PTO_SingleRPM, system-signal=SystemSignal_COM_Tx_PTO_SingleRPM}
        sender-receiver-to-signal-mapping={data-element=CPT_MDG1_FlatView.PP_COM_Tx_ENGINE_FD_9.VD_COM_Tx_PTO_Sts, system-signal=SystemSignal_COM_Tx_PTO_Sts}
        sender-receiver-to-signal-mapping={data-element=CPT_MDG1_FlatView.PP_COM_Tx_ENGINE_FD_9.VD_COM_Tx_PTO_TYPES, system-signal=SystemSignal_COM_Tx_PTO_TYPES}
        sender-receiver-to-signal-mapping={data-element=CPT_MDG1_FlatView.PP_COM_Tx_ENGINE_FD_9.VD_COM_Tx_PTO_Target_Gear, system-signal=SystemSignal_COM_Tx_PTO_Target_Gear}
        sender-receiver-to-signal-mapping={data-element=CPT_MDG1_FlatView.PP_COM_Tx_ENGINE_FD_9.VD_COM_Tx_SEIU_Enbl, system-signal=SystemSignal_COM_Tx_SEIU_Enbl}
        sender-receiver-to-signal-mapping={data-element=CPT_MDG1_FlatView.PP_COM_Tx_ENGINE_FD_9.VD_COM_Tx_SEIU_RPM, system-signal=SystemSignal_COM_Tx_SEIU_RPM}
        sender-receiver-to-signal-mapping={data-element=CPT_MDG1_FlatView.PP_COM_Tx_ENGINE_FD_9.VD_COM_Tx_SEIU_Sts, system-signal=SystemSignal_COM_Tx_SEIU_Sts}
        sender-receiver-to-signal-mapping={data-element=CPT_MDG1_FlatView.PP_COM_Tx_ENGINE_HYBD_FD_3.VD_COM_Tx_AGSposn, system-signal=SystemSignal_COM_Tx_AGSposn}
        sender-receiver-to-signal-mapping={data-element=CPT_MDG1_FlatView.PP_COM_Tx_ENGINE_HYBD_FD_3.VD_COM_Tx_AfterRunReq, system-signal=SystemSignal_COM_Tx_AfterRunReq}
        sender-receiver-to-signal-mapping={data-element=CPT_MDG1_FlatView.PP_COM_Tx_ENGINE_HYBD_FD_3.VD_COM_Tx_CRC_ENGINE_HYBD_FD_3, system-signal=SystemSignal_COM_Tx_CRC_ENGINE_HYBD_FD_3}
        sender-receiver-to-signal-mapping={data-element=CPT_MDG1_FlatView.PP_COM_Tx_ENGINE_HYBD_FD_3.VD_COM_Tx_ECM_AirflowRequest, system-signal=SystemSignal_COM_Tx_ECM_AirflowRequest}
        sender-receiver-to-signal-mapping={data-element=CPT_MDG1_FlatView.PP_COM_Tx_ENGINE_HYBD_FD_3.VD_COM_Tx_ECM_WorkSite_Invtr_Sts, system-signal=SystemSignal_COM_Tx_ECM_WorkSite_Invtr_Sts}
        sender-receiver-to-signal-mapping={data-element=CPT_MDG1_FlatView.PP_COM_Tx_ENGINE_HYBD_FD_3.VD_COM_Tx_EngCltTmp, system-signal=SystemSignal_COM_Tx_EngCltTmp}
        sender-receiver-to-signal-mapping={data-element=CPT_MDG1_FlatView.PP_COM_Tx_ENGINE_HYBD_FD_3.VD_COM_Tx_EngCltTmpV, system-signal=SystemSignal_COM_Tx_EngCltTmpV}
        sender-receiver-to-signal-mapping={data-element=CPT_MDG1_FlatView.PP_COM_Tx_ENGINE_HYBD_FD_3.VD_COM_Tx_EngHalfCylSpdMaxLim, system-signal=SystemSignal_COM_Tx_EngHalfCylSpdMaxLim}
        sender-receiver-to-signal-mapping={data-element=CPT_MDG1_FlatView.PP_COM_Tx_ENGINE_HYBD_FD_3.VD_COM_Tx_EngHalfCylSpdMinLim, system-signal=SystemSignal_COM_Tx_EngHalfCylSpdMinLim}
        sender-receiver-to-signal-mapping={data-element=CPT_MDG1_FlatView.PP_COM_Tx_ENGINE_HYBD_FD_3.VD_COM_Tx_EngOutofFuel, system-signal=SystemSignal_COM_Tx_EngOutofFuel}
        sender-receiver-to-signal-mapping={data-element=CPT_MDG1_FlatView.PP_COM_Tx_ENGINE_HYBD_FD_3.VD_COM_Tx_EngSpd, system-signal=SystemSignal_COM_Tx_EngSpd}
        sender-receiver-to-signal-mapping={data-element=CPT_MDG1_FlatView.PP_COM_Tx_ENGINE_HYBD_FD_3.VD_COM_Tx_EngSpdStat, system-signal=SystemSignal_COM_Tx_EngSpdStat}
        sender-receiver-to-signal-mapping={data-element=CPT_MDG1_FlatView.PP_COM_Tx_ENGINE_HYBD_FD_3.VD_COM_Tx_Engine_Maintenance_Sts, system-signal=SystemSignal_COM_Tx_Engine_Maintenance_Sts}
        sender-receiver-to-signal-mapping={data-element=CPT_MDG1_FlatView.PP_COM_Tx_ENGINE_HYBD_FD_3.VD_COM_Tx_LTR_PumpSpeedAct, system-signal=SystemSignal_COM_Tx_LTR_PumpSpeedAct}
        sender-receiver-to-signal-mapping={data-element=CPT_MDG1_FlatView.PP_COM_Tx_ENGINE_HYBD_FD_3.VD_COM_Tx_MaxEngSpdCap, system-signal=SystemSignal_COM_Tx_MaxEngSpdCap}
        sender-receiver-to-signal-mapping={data-element=CPT_MDG1_FlatView.PP_COM_Tx_ENGINE_HYBD_FD_3.VD_COM_Tx_MessageCounter_ENGINE_HYBD_FD_3, system-signal=SystemSignal_COM_Tx_MessageCounter_ENGINE_HYBD_FD_3}
        sender-receiver-to-signal-mapping={data-element=CPT_MDG1_FlatView.PP_COM_Tx_ENGINE_HYBD_FD_3.VD_COM_Tx_MinEngSpdCap, system-signal=SystemSignal_COM_Tx_MinEngSpdCap}
        sender-receiver-to-signal-mapping={data-element=CPT_MDG1_FlatView.PP_COM_Tx_ENGINE_HYBD_FD_3.VD_COM_Tx_PECP_PumpFlowReq, system-signal=SystemSignal_COM_Tx_PECP_PumpFlowReq}
        sender-receiver-to-signal-mapping={data-element=CPT_MDG1_FlatView.PP_COM_Tx_ENGINE_HYBD_FD_3.VD_COM_Tx_RadFanReq, system-signal=SystemSignal_COM_Tx_RadFanReq}
        sender-receiver-to-signal-mapping={data-element=CPT_MDG1_FlatView.PP_COM_Tx_ENGINE_HYBD_FD_3.VD_COM_Tx_ServiceHybSys, system-signal=SystemSignal_COM_Tx_ServiceHybSys}
        sender-receiver-to-signal-mapping={data-element=CPT_MDG1_FlatView.PP_COM_Tx_ENGINE_HYBD_FD_4.VD_COM_Tx_CRC_ENGINE_HYBD_FD_4, system-signal=SystemSignal_COM_Tx_CRC_ENGINE_HYBD_FD_4}
        sender-receiver-to-signal-mapping={data-element=CPT_MDG1_FlatView.PP_COM_Tx_ENGINE_HYBD_FD_4.VD_COM_Tx_CatHtgStateActive, system-signal=SystemSignal_COM_Tx_CatHtgStateActive}
        sender-receiver-to-signal-mapping={data-element=CPT_MDG1_FlatView.PP_COM_Tx_ENGINE_HYBD_FD_4.VD_COM_Tx_CatTempMaint, system-signal=SystemSignal_COM_Tx_CatTempMaint}
        sender-receiver-to-signal-mapping={data-element=CPT_MDG1_FlatView.PP_COM_Tx_ENGINE_HYBD_FD_4.VD_COM_Tx_EngTorqACCCapability, system-signal=SystemSignal_COM_Tx_EngTorqACCCapability}
        sender-receiver-to-signal-mapping={data-element=CPT_MDG1_FlatView.PP_COM_Tx_ENGINE_HYBD_FD_4.VD_COM_Tx_EngTorqCapbltyEngOpMd, system-signal=SystemSignal_COM_Tx_EngTorqCapbltyEngOpMd}
        sender-receiver-to-signal-mapping={data-element=CPT_MDG1_FlatView.PP_COM_Tx_ENGINE_HYBD_FD_4.VD_COM_Tx_EngTorqCapbltyFrmCntr, system-signal=SystemSignal_COM_Tx_EngTorqCapbltyFrmCntr}
        sender-receiver-to-signal-mapping={data-element=CPT_MDG1_FlatView.PP_COM_Tx_ENGINE_HYBD_FD_4.VD_COM_Tx_EngTorqCapbltyMaxOffTorq, system-signal=SystemSignal_COM_Tx_EngTorqCapbltyMaxOffTorq}
        sender-receiver-to-signal-mapping={data-element=CPT_MDG1_FlatView.PP_COM_Tx_ENGINE_HYBD_FD_4.VD_COM_Tx_EngTorqCapbltyMaxTorq, system-signal=SystemSignal_COM_Tx_EngTorqCapbltyMaxTorq}
        sender-receiver-to-signal-mapping={data-element=CPT_MDG1_FlatView.PP_COM_Tx_ENGINE_HYBD_FD_4.VD_COM_Tx_EngTorqCapbltyMinRunTorq, system-signal=SystemSignal_COM_Tx_EngTorqCapbltyMinRunTorq}
        sender-receiver-to-signal-mapping={data-element=CPT_MDG1_FlatView.PP_COM_Tx_ENGINE_HYBD_FD_4.VD_COM_Tx_EngTorqCapbltyMinTorq, system-signal=SystemSignal_COM_Tx_EngTorqCapbltyMinTorq}
        sender-receiver-to-signal-mapping={data-element=CPT_MDG1_FlatView.PP_COM_Tx_ENGINE_HYBD_FD_4.VD_COM_Tx_EngTorqCapbltyRefEngSpd, system-signal=SystemSignal_COM_Tx_EngTorqCapbltyRefEngSpd}
        sender-receiver-to-signal-mapping={data-element=CPT_MDG1_FlatView.PP_COM_Tx_ENGINE_HYBD_FD_4.VD_COM_Tx_MessageCounter_ENGINE_HYBD_FD_4, system-signal=SystemSignal_COM_Tx_MessageCounter_ENGINE_HYBD_FD_4}
        sender-receiver-to-signal-mapping={data-element=CPT_MDG1_FlatView.PP_COM_Tx_OBD_CONTENT_FRAME.VD_COM_Tx_AccelPdlPosn_OBD, system-signal=SystemSignal_COM_Tx_AccelPdlPosn_OBD}
        sender-receiver-to-signal-mapping={data-element=CPT_MDG1_FlatView.PP_COM_Tx_OBD_CONTENT_FRAME.VD_COM_Tx_BarPrsAbs, system-signal=SystemSignal_COM_Tx_BarPrsAbs}
        sender-receiver-to-signal-mapping={data-element=CPT_MDG1_FlatView.PP_COM_Tx_OBD_CONTENT_FRAME.VD_COM_Tx_BarPrsAbsV, system-signal=SystemSignal_COM_Tx_BarPrsAbsV}
        sender-receiver-to-signal-mapping={data-element=CPT_MDG1_FlatView.PP_COM_Tx_OBD_CONTENT_FRAME.VD_COM_Tx_CARB_PERM, system-signal=SystemSignal_COM_Tx_CARB_PERM}
        sender-receiver-to-signal-mapping={data-element=CPT_MDG1_FlatView.PP_COM_Tx_OBD_CONTENT_FRAME.VD_COM_Tx_CRC_OBDCONTENTFRAME, system-signal=SystemSignal_COM_Tx_CRC_OBDCONTENTFRAME}
        sender-receiver-to-signal-mapping={data-element=CPT_MDG1_FlatView.PP_COM_Tx_OBD_CONTENT_FRAME.VD_COM_Tx_CarbWarmUp, system-signal=SystemSignal_COM_Tx_CarbWarmUp}
        sender-receiver-to-signal-mapping={data-element=CPT_MDG1_FlatView.PP_COM_Tx_OBD_CONTENT_FRAME.VD_COM_Tx_CldStrtDenominator, system-signal=SystemSignal_COM_Tx_CldStrtDenominator}
        sender-receiver-to-signal-mapping={data-element=CPT_MDG1_FlatView.PP_COM_Tx_OBD_CONTENT_FRAME.VD_COM_Tx_ECM_HoodAjar, system-signal=SystemSignal_COM_Tx_ECM_HoodAjar}
        sender-receiver-to-signal-mapping={data-element=CPT_MDG1_FlatView.PP_COM_Tx_OBD_CONTENT_FRAME.VD_COM_Tx_EngIntAirTmp, system-signal=SystemSignal_COM_Tx_EngIntAirTmp}
        sender-receiver-to-signal-mapping={data-element=CPT_MDG1_FlatView.PP_COM_Tx_OBD_CONTENT_FRAME.VD_COM_Tx_EngIntAirTmpV, system-signal=SystemSignal_COM_Tx_EngIntAirTmpV}
        sender-receiver-to-signal-mapping={data-element=CPT_MDG1_FlatView.PP_COM_Tx_OBD_CONTENT_FRAME.VD_COM_Tx_EngLoad_OBD_ePT, system-signal=SystemSignal_COM_Tx_EngLoad_OBD_ePT}
        sender-receiver-to-signal-mapping={data-element=CPT_MDG1_FlatView.PP_COM_Tx_OBD_CONTENT_FRAME.VD_COM_Tx_EngOffTmPT, system-signal=SystemSignal_COM_Tx_EngOffTmPT}
        sender-receiver-to-signal-mapping={data-element=CPT_MDG1_FlatView.PP_COM_Tx_OBD_CONTENT_FRAME.VD_COM_Tx_EngOffTmPTV, system-signal=SystemSignal_COM_Tx_EngOffTmPTV}
        sender-receiver-to-signal-mapping={data-element=CPT_MDG1_FlatView.PP_COM_Tx_OBD_CONTENT_FRAME.VD_COM_Tx_EngineOFFTime, system-signal=SystemSignal_COM_Tx_EngineOFFTime}
        sender-receiver-to-signal-mapping={data-element=CPT_MDG1_FlatView.PP_COM_Tx_OBD_CONTENT_FRAME.VD_COM_Tx_EstCatCnvTmp, system-signal=SystemSignal_COM_Tx_EstCatCnvTmp}
        sender-receiver-to-signal-mapping={data-element=CPT_MDG1_FlatView.PP_COM_Tx_OBD_CONTENT_FRAME.VD_COM_Tx_GenDenominator, system-signal=SystemSignal_COM_Tx_GenDenominator}
        sender-receiver-to-signal-mapping={data-element=CPT_MDG1_FlatView.PP_COM_Tx_OBD_CONTENT_FRAME.VD_COM_Tx_IgnCntrFuelEngTrue, system-signal=SystemSignal_COM_Tx_IgnCntrFuelEngTrue}
        sender-receiver-to-signal-mapping={data-element=CPT_MDG1_FlatView.PP_COM_Tx_OBD_CONTENT_FRAME.VD_COM_Tx_IgnCntrTrue, system-signal=SystemSignal_COM_Tx_IgnCntrTrue}
        sender-receiver-to-signal-mapping={data-element=CPT_MDG1_FlatView.PP_COM_Tx_OBD_CONTENT_FRAME.VD_COM_Tx_InpICCFuelEng_Fail, system-signal=SystemSignal_COM_Tx_InpICCFuelEng_Fail}
        sender-receiver-to-signal-mapping={data-element=CPT_MDG1_FlatView.PP_COM_Tx_OBD_CONTENT_FRAME.VD_COM_Tx_Inp_ICC_Fail, system-signal=SystemSignal_COM_Tx_Inp_ICC_Fail}
        sender-receiver-to-signal-mapping={data-element=CPT_MDG1_FlatView.PP_COM_Tx_OBD_CONTENT_FRAME.VD_COM_Tx_InputsGDFail, system-signal=SystemSignal_COM_Tx_InputsGDFail}
        sender-receiver-to-signal-mapping={data-element=CPT_MDG1_FlatView.PP_COM_Tx_OBD_CONTENT_FRAME.VD_COM_Tx_LgsDiagCldStrtCndFltPr, system-signal=SystemSignal_COM_Tx_LgsDiagCldStrtCndFltPr}
        sender-receiver-to-signal-mapping={data-element=CPT_MDG1_FlatView.PP_COM_Tx_OBD_CONTENT_FRAME.VD_COM_Tx_LgsDiagCldStrtCndMet, system-signal=SystemSignal_COM_Tx_LgsDiagCldStrtCndMet}
        sender-receiver-to-signal-mapping={data-element=CPT_MDG1_FlatView.PP_COM_Tx_OBD_CONTENT_FRAME.VD_COM_Tx_LgsDiagStndCondFltPrs, system-signal=SystemSignal_COM_Tx_LgsDiagStndCondFltPrs}
        sender-receiver-to-signal-mapping={data-element=CPT_MDG1_FlatView.PP_COM_Tx_OBD_CONTENT_FRAME.VD_COM_Tx_LgsDiagStndCondMet, system-signal=SystemSignal_COM_Tx_LgsDiagStndCondMet}
        sender-receiver-to-signal-mapping={data-element=CPT_MDG1_FlatView.PP_COM_Tx_OBD_CONTENT_FRAME.VD_COM_Tx_LoadOBD, system-signal=SystemSignal_COM_Tx_LoadOBD}
        sender-receiver-to-signal-mapping={data-element=CPT_MDG1_FlatView.PP_COM_Tx_OBD_CONTENT_FRAME.VD_COM_Tx_MessageCounter_OBDCONTENTFRAME, system-signal=SystemSignal_COM_Tx_MessageCounter_OBDCONTENTFRAME}
        sender-receiver-to-signal-mapping={data-element=CPT_MDG1_FlatView.PP_COM_Tx_OBD_CONTENT_FRAME.VD_COM_Tx_OAT_PT_Est, system-signal=SystemSignal_COM_Tx_OAT_PT_Est}
        sender-receiver-to-signal-mapping={data-element=CPT_MDG1_FlatView.PP_COM_Tx_OBD_CONTENT_FRAME.VD_COM_Tx_OAT_PT_EstV, system-signal=SystemSignal_COM_Tx_OAT_PT_EstV}
        sender-receiver-to-signal-mapping={data-element=CPT_MDG1_FlatView.PP_COM_Tx_PDC_INFO_FD_ECM.VD_COM_Tx_CurrentCanNMState_FD03_ECM, system-signal=SystemSignal_COM_Tx_CurrentCanNMState_FD03_ECM}
        sender-receiver-to-signal-mapping={data-element=CPT_MDG1_FlatView.PP_COM_Tx_PDC_INFO_FD_ECM.VD_COM_Tx_DES_FD03_ECM, system-signal=SystemSignal_COM_Tx_DES_FD03_ECM}
        sender-receiver-to-signal-mapping={data-element=CPT_MDG1_FlatView.PP_COM_Tx_PDC_INFO_FD_ECM.VD_COM_Tx_EOL_FD03_ECM, system-signal=SystemSignal_COM_Tx_EOL_FD03_ECM}
        sender-receiver-to-signal-mapping={data-element=CPT_MDG1_FlatView.PP_COM_Tx_PDC_INFO_FD_ECM.VD_COM_Tx_PreviousCanNMState_FD03_ECM, system-signal=SystemSignal_COM_Tx_PreviousCanNMState_FD03_ECM}
        sender-receiver-to-signal-mapping={data-element=CPT_MDG1_FlatView.RP_COM_Rx_ADAS_FD_HMI_FD14.VD_COM_Rx_CRC_ADAS_FD_HMI_FD14, system-signal=SystemSignal_COM_Rx_CRC_ADAS_FD_HMI_FD14}
        sender-receiver-to-signal-mapping={data-element=CPT_MDG1_FlatView.RP_COM_Rx_ADAS_FD_HMI_FD14.VD_COM_Rx_MessageCounter_ADAS_FD_HMI_FD14, system-signal=SystemSignal_COM_Rx_MessageCounter_ADAS_FD_HMI_FD14}
        sender-receiver-to-signal-mapping={data-element=CPT_MDG1_FlatView.RP_COM_Rx_ADAS_FD_HMI_FD14.VD_COM_Rx_Set_Speed_KPH_FD14, system-signal=SystemSignal_COM_Rx_Set_Speed_KPH_FD14}
        sender-receiver-to-signal-mapping={data-element=CPT_MDG1_FlatView.RP_COM_Rx_ADAS_FD_HMI_FD14.VD_COM_Rx_Set_Speed_MPH_FD14, system-signal=SystemSignal_COM_Rx_Set_Speed_MPH_FD14}
        sender-receiver-to-signal-mapping={data-element=CPT_MDG1_FlatView.RP_COM_Rx_BRAKE_FD_1_FD14.VD_COM_Rx_SelectSpdSts_FD14, system-signal=SystemSignal_COM_Rx_SelectSpdSts_FD14}
        sender-receiver-to-signal-mapping={data-element=CPT_MDG1_FlatView.RP_COM_Rx_HYBRID_POWERTRAIN1_FD14.VD_COM_Rx_PropulsionSystemActive_FD14, system-signal=SystemSignal_COM_Rx_PropulsionSystemActive_FD14}
        sender-receiver-to-signal-mapping={data-element=CPT_MDG1_FlatView.PP_COM_Tx_ENGINE_FD_1_FD14.VD_COM_Tx_CRC_ENGINE1_FD14, system-signal=SystemSignal_COM_Tx_CRC_ENGINE1_FD14}
        sender-receiver-to-signal-mapping={data-element=CPT_MDG1_FlatView.PP_COM_Tx_ENGINE_FD_1_FD14.VD_COM_Tx_MessageCounter_ENGINE1_FD14, system-signal=SystemSignal_COM_Tx_MessageCounter_ENGINE1_FD14}
        sender-receiver-to-signal-mapping={data-element=CPT_MDG1_FlatView.PP_COM_Tx_ENGINE_FD_1_FD14.VD_COM_Tx_ThermalManagementActive_W_FD14, system-signal=SystemSignal_COM_Tx_ThermalManagementActive_W_FD14}
        sender-receiver-to-signal-mapping={data-element=CPT_MDG1_FlatView.PP_COM_Tx_ENGINE_FD_3_FD14.VD_COM_Tx_CRC_ENGINE3_FD14, system-signal=SystemSignal_COM_Tx_CRC_ENGINE3_FD14}
        sender-receiver-to-signal-mapping={data-element=CPT_MDG1_FlatView.PP_COM_Tx_ENGINE_FD_3_FD14.VD_COM_Tx_MessageCounter_ENGINE3_FD14, system-signal=SystemSignal_COM_Tx_MessageCounter_ENGINE3_FD14}
        sender-receiver-to-signal-mapping={data-element=CPT_MDG1_FlatView.PP_COM_Tx_ENGINE_FD_7_FD14.VD_COM_Tx_CRC_ENGINE7_FD14, system-signal=SystemSignal_COM_Tx_CRC_ENGINE7_FD14}
        sender-receiver-to-signal-mapping={data-element=CPT_MDG1_FlatView.PP_COM_Tx_ENGINE_FD_7_FD14.VD_COM_Tx_MessageCounter_ENGINE7_FD14, system-signal=SystemSignal_COM_Tx_MessageCounter_ENGINE7_FD14}
        sender-receiver-to-signal-mapping={data-element=CPT_MDG1_FlatView.RP_COM_Rx_HYBRID_THERMAL_COMMAND_FD16.VD_COM_Rx_CRC_HYBRID_THERMAL_COMMAND, system-signal=SystemSignal_COM_Rx_CRC_HYBRID_THERMAL_COMMAND}
        sender-receiver-to-signal-mapping={data-element=CPT_MDG1_FlatView.RP_COM_Rx_HYBRID_THERMAL_COMMAND_FD16.VD_COM_Rx_MC_HYBRID_THERMAL_COMMAND, system-signal=SystemSignal_COM_Rx_MC_HYBRID_THERMAL_COMMAND}
        sender-receiver-to-signal-mapping={data-element=CPT_MDG1_FlatView.PP_COM_Tx_ENGINE_FD_1_FD16.VD_COM_Tx_AtmosphericPressureFailSts_WFD16, system-signal=SystemSignal_COM_Tx_AtmosphericPressureFailSts_WFD16}
        sender-receiver-to-signal-mapping={data-element=CPT_MDG1_FlatView.PP_COM_Tx_ENGINE_FD_1_FD16.VD_COM_Tx_AtmosphericPressure_W_FD16, system-signal=SystemSignal_COM_Tx_AtmosphericPressure_W_FD16}
        sender-receiver-to-signal-mapping={data-element=CPT_MDG1_FlatView.PP_COM_Tx_ENGINE_FD_1_FD16.VD_COM_Tx_CRC_ENGINE1_FD16, system-signal=SystemSignal_COM_Tx_CRC_ENGINE1_FD16}
        sender-receiver-to-signal-mapping={data-element=CPT_MDG1_FlatView.PP_COM_Tx_ENGINE_FD_1_FD16.VD_COM_Tx_EngMaxRPM_W_FD16, system-signal=SystemSignal_COM_Tx_EngMaxRPM_W_FD16}
        sender-receiver-to-signal-mapping={data-element=CPT_MDG1_FlatView.PP_COM_Tx_ENGINE_FD_1_FD16.VD_COM_Tx_MessageCounter_ENGINE1_FD16, system-signal=SystemSignal_COM_Tx_MessageCounter_ENGINE1_FD16}
        sender-receiver-to-signal-mapping={data-element=CPT_MDG1_FlatView.PP_COM_Tx_ENGINE_FD_1_FD16.VD_COM_Tx_ThermalManagementActive_W_FD16, system-signal=SystemSignal_COM_Tx_ThermalManagementActive_W_FD16}
        sender-receiver-to-signal-mapping={data-element=CPT_MDG1_FlatView.PP_COM_Tx_ENGINE_FD_1_FD16.VD_COM_Tx_TransWarmUpMin_RPM_FD16, system-signal=SystemSignal_COM_Tx_TransWarmUpMin_RPM_FD16}
        sender-receiver-to-signal-mapping={data-element=CPT_MDG1_FlatView.PP_COM_Tx_ENGINE_FD_1_FD16.VD_COM_Tx_TransWarmUpReq_FD16, system-signal=SystemSignal_COM_Tx_TransWarmUpReq_FD16}
        sender-receiver-to-signal-mapping={data-element=CPT_MDG1_FlatView.PP_COM_Tx_ENGINE_FD_1_FD16.VD_COM_Tx_VehicleSetSpeed_W_FD16, system-signal=SystemSignal_COM_Tx_VehicleSetSpeed_W_FD16}
        sender-receiver-to-signal-mapping={data-element=CPT_MDG1_FlatView.PP_COM_Tx_ENGINE_FD_3_FD16.VD_COM_Tx_CRC_ENGINE3_FD16, system-signal=SystemSignal_COM_Tx_CRC_ENGINE3_FD16}
        sender-receiver-to-signal-mapping={data-element=CPT_MDG1_FlatView.PP_COM_Tx_ENGINE_FD_3_FD16.VD_COM_Tx_MessageCounter_ENGINE3_FD16, system-signal=SystemSignal_COM_Tx_MessageCounter_ENGINE3_FD16}
        sender-receiver-to-signal-mapping={data-element=CPT_MDG1_FlatView.PP_COM_Tx_ENGINE_FD_6_FD16.VD_COM_Tx_CRC_ENGINE6_FD16, system-signal=SystemSignal_COM_Tx_CRC_ENGINE6_FD16}
        sender-receiver-to-signal-mapping={data-element=CPT_MDG1_FlatView.PP_COM_Tx_ENGINE_FD_6_FD16.VD_COM_Tx_EngineWaterTemp_FD16, system-signal=SystemSignal_COM_Tx_EngineWaterTemp_FD16}
        sender-receiver-to-signal-mapping={data-element=CPT_MDG1_FlatView.PP_COM_Tx_ENGINE_FD_6_FD16.VD_COM_Tx_MessageCounter_ENGINE6_FD16, system-signal=SystemSignal_COM_Tx_MessageCounter_ENGINE6_FD16}
        sender-receiver-to-signal-mapping={data-element=CPT_MDG1_FlatView.PP_COM_Tx_ENGINE_FD_6_FD16.VD_COM_Tx_Selector_SystemFailSts_FD16, system-signal=SystemSignal_COM_Tx_Selector_SystemFailSts_FD16}
        sender-receiver-to-signal-mapping={data-element=CPT_MDG1_FlatView.PP_COM_Tx_ENGINE_FD_6_FD16.VD_COM_Tx_StartRelayECMFeedbackFault_FD16, system-signal=SystemSignal_COM_Tx_StartRelayECMFeedbackFault_FD16}
        sender-receiver-to-signal-mapping={data-element=CPT_MDG1_FlatView.PP_COM_Tx_ENGINE_FD_6_FD16.VD_COM_Tx_TerrainModeDesiredStat_FD16, system-signal=SystemSignal_COM_Tx_TerrainModeDesiredStat_FD16}
        sender-receiver-to-signal-mapping={data-element=CPT_MDG1_FlatView.PP_COM_Tx_ENGINE_FD_6_FD16.VD_COM_Tx_TerrainModeStat_ECM_FD16, system-signal=SystemSignal_COM_Tx_TerrainModeStat_ECM_FD16}
        sender-receiver-to-signal-mapping={data-element=CPT_MDG1_FlatView.PP_COM_Tx_ENGINE_FD_6_FD16.VD_COM_Tx_Terrain_HMI_Rq_ECM_FD16, system-signal=SystemSignal_COM_Tx_Terrain_HMI_Rq_ECM_FD16}
        sender-receiver-to-signal-mapping={data-element=CPT_MDG1_FlatView.PP_COM_Tx_ENGINE_FD_6_FD16.VD_COM_Tx_Trns_DrvMdReq_ECM_FD16, system-signal=SystemSignal_COM_Tx_Trns_DrvMdReq_ECM_FD16}
        sender-receiver-to-signal-mapping={data-element=CPT_MDG1_FlatView.PP_COM_Tx_ENGINE_FD_7_FD16.VD_COM_Tx_CRC_ENGINE7_FD16, system-signal=SystemSignal_COM_Tx_CRC_ENGINE7_FD16}
        sender-receiver-to-signal-mapping={data-element=CPT_MDG1_FlatView.PP_COM_Tx_ENGINE_FD_7_FD16.VD_COM_Tx_MessageCounter_ENGINE7_FD16, system-signal=SystemSignal_COM_Tx_MessageCounter_ENGINE7_FD16}
        sender-receiver-to-signal-mapping={data-element=CPT_MDG1_FlatView.PP_COM_Tx_ENGINE_FD_8_FD16.VD_COM_Tx_CRC_ENGINE8_FD16, system-signal=SystemSignal_COM_Tx_CRC_ENGINE8_FD16}
        sender-receiver-to-signal-mapping={data-element=CPT_MDG1_FlatView.PP_COM_Tx_ENGINE_FD_8_FD16.VD_COM_Tx_MdsAct_FD16, system-signal=SystemSignal_COM_Tx_MdsAct_FD16}
        sender-receiver-to-signal-mapping={data-element=CPT_MDG1_FlatView.PP_COM_Tx_ENGINE_FD_8_FD16.VD_COM_Tx_MessageCounter_ENGINE8_FD16, system-signal=SystemSignal_COM_Tx_MessageCounter_ENGINE8_FD16}
        sender-receiver-to-signal-mapping={data-element=CPT_MDG1_FlatView.PP_COM_Tx_ENGINE_HYBD_FD_3_FD16.VD_COM_Tx_CRC_ENGINE_HYBD_FD_3_FD16, system-signal=SystemSignal_COM_Tx_CRC_ENGINE_HYBD_FD_3_FD16}
        sender-receiver-to-signal-mapping={data-element=CPT_MDG1_FlatView.PP_COM_Tx_ENGINE_HYBD_FD_3_FD16.VD_COM_Tx_EngCltTmpV_FD16, system-signal=SystemSignal_COM_Tx_EngCltTmpV_FD16}
        sender-receiver-to-signal-mapping={data-element=CPT_MDG1_FlatView.PP_COM_Tx_ENGINE_HYBD_FD_3_FD16.VD_COM_Tx_EngCltTmp_FD16, system-signal=SystemSignal_COM_Tx_EngCltTmp_FD16}
        sender-receiver-to-signal-mapping={data-element=CPT_MDG1_FlatView.PP_COM_Tx_ENGINE_HYBD_FD_3_FD16.VD_COM_Tx_EngSpd_FD16, system-signal=SystemSignal_COM_Tx_EngSpd_FD16}
        sender-receiver-to-signal-mapping={data-element=CPT_MDG1_FlatView.PP_COM_Tx_ENGINE_HYBD_FD_3_FD16.VD_COM_Tx_MC_ENGINE_HYBD_FD_3_FD16, system-signal=SystemSignal_COM_Tx_MC_ENGINE_HYBD_FD_3_FD16}
        sender-receiver-to-signal-mapping={data-element=CPT_MDG1_FlatView.PP_COM_Tx_ENGINE_HYBD_FD_3_FD16.VD_COM_Tx_MaxEngSpdCap_FD16, system-signal=SystemSignal_COM_Tx_MaxEngSpdCap_FD16}
        sender-receiver-to-signal-mapping={data-element=CPT_MDG1_FlatView.PP_COM_Tx_ENGINE_HYBD_FD_3_FD16.VD_COM_Tx_MinEngSpdCap_FD16, system-signal=SystemSignal_COM_Tx_MinEngSpdCap_FD16}
        sender-receiver-to-signal-mapping={data-element=CPT_MDG1_FlatView.PP_COM_Tx_ENGINE_HYBD_FD_3_FD16.VD_COM_Tx_ServiceHybSys_FD16, system-signal=SystemSignal_COM_Tx_ServiceHybSys_FD16}
        sender-receiver-to-signal-mapping={data-element=CPT_MDG1_FlatView.PP_COM_Tx_ENGINE_HYBD_FD_4_FD16.VD_COM_Tx_CRC_ENGINE_HYBD_FD_4_FD16, system-signal=SystemSignal_COM_Tx_CRC_ENGINE_HYBD_FD_4_FD16}
        sender-receiver-to-signal-mapping={data-element=CPT_MDG1_FlatView.PP_COM_Tx_ENGINE_HYBD_FD_4_FD16.VD_COM_Tx_EngTorqACCCapability_FD16, system-signal=SystemSignal_COM_Tx_EngTorqACCCapability_FD16}
        sender-receiver-to-signal-mapping={data-element=CPT_MDG1_FlatView.PP_COM_Tx_ENGINE_HYBD_FD_4_FD16.VD_COM_Tx_EngTorqCapbltyEngOpMd_FD16, system-signal=SystemSignal_COM_Tx_EngTorqCapbltyEngOpMd_FD16}
        sender-receiver-to-signal-mapping={data-element=CPT_MDG1_FlatView.PP_COM_Tx_ENGINE_HYBD_FD_4_FD16.VD_COM_Tx_EngTorqCapbltyFrmCntr_FD16, system-signal=SystemSignal_COM_Tx_EngTorqCapbltyFrmCntr_FD16}
        sender-receiver-to-signal-mapping={data-element=CPT_MDG1_FlatView.PP_COM_Tx_ENGINE_HYBD_FD_4_FD16.VD_COM_Tx_EngTorqCapbltyMaxOffTorq_FD16, system-signal=SystemSignal_COM_Tx_EngTorqCapbltyMaxOffTorq_FD16}
        sender-receiver-to-signal-mapping={data-element=CPT_MDG1_FlatView.PP_COM_Tx_ENGINE_HYBD_FD_4_FD16.VD_COM_Tx_EngTorqCapbltyMaxTorq_FD16, system-signal=SystemSignal_COM_Tx_EngTorqCapbltyMaxTorq_FD16}
        sender-receiver-to-signal-mapping={data-element=CPT_MDG1_FlatView.PP_COM_Tx_ENGINE_HYBD_FD_4_FD16.VD_COM_Tx_EngTorqCapbltyMinRunTorq_FD16, system-signal=SystemSignal_COM_Tx_EngTorqCapbltyMinRunTorq_FD16}
        sender-receiver-to-signal-mapping={data-element=CPT_MDG1_FlatView.PP_COM_Tx_ENGINE_HYBD_FD_4_FD16.VD_COM_Tx_EngTorqCapbltyMinTorq_FD16, system-signal=SystemSignal_COM_Tx_EngTorqCapbltyMinTorq_FD16}
        sender-receiver-to-signal-mapping={data-element=CPT_MDG1_FlatView.PP_COM_Tx_ENGINE_HYBD_FD_4_FD16.VD_COM_Tx_EngTorqCapbltyRefEngSpd_FD16, system-signal=SystemSignal_COM_Tx_EngTorqCapbltyRefEngSpd_FD16}
        sender-receiver-to-signal-mapping={data-element=CPT_MDG1_FlatView.PP_COM_Tx_ENGINE_HYBD_FD_4_FD16.VD_COM_Tx_MC_ENGINE_HYBD_FD_4_FD16, system-signal=SystemSignal_COM_Tx_MC_ENGINE_HYBD_FD_4_FD16}
        sender-receiver-to-signal-mapping={data-element=CPT_MDG1_FlatView.PP_COM_Tx_OBD_CONTENT_FRAME_FD16.VD_COM_Tx_AccelPdlPosn_OBD_FD16, system-signal=SystemSignal_COM_Tx_AccelPdlPosn_OBD_FD16}
        sender-receiver-to-signal-mapping={data-element=CPT_MDG1_FlatView.PP_COM_Tx_OBD_CONTENT_FRAME_FD16.VD_COM_Tx_CARB_PERM_FD16, system-signal=SystemSignal_COM_Tx_CARB_PERM_FD16}
        sender-receiver-to-signal-mapping={data-element=CPT_MDG1_FlatView.PP_COM_Tx_OBD_CONTENT_FRAME_FD16.VD_COM_Tx_CRC_OBDCONTENTFRAME_FD16, system-signal=SystemSignal_COM_Tx_CRC_OBDCONTENTFRAME_FD16}
        sender-receiver-to-signal-mapping={data-element=CPT_MDG1_FlatView.PP_COM_Tx_OBD_CONTENT_FRAME_FD16.VD_COM_Tx_CarbWarmUp_FD16, system-signal=SystemSignal_COM_Tx_CarbWarmUp_FD16}
        sender-receiver-to-signal-mapping={data-element=CPT_MDG1_FlatView.PP_COM_Tx_OBD_CONTENT_FRAME_FD16.VD_COM_Tx_CldStrtDenominator_FD16, system-signal=SystemSignal_COM_Tx_CldStrtDenominator_FD16}
        sender-receiver-to-signal-mapping={data-element=CPT_MDG1_FlatView.PP_COM_Tx_OBD_CONTENT_FRAME_FD16.VD_COM_Tx_EngOffTmPTV_FD16, system-signal=SystemSignal_COM_Tx_EngOffTmPTV_FD16}
        sender-receiver-to-signal-mapping={data-element=CPT_MDG1_FlatView.PP_COM_Tx_OBD_CONTENT_FRAME_FD16.VD_COM_Tx_EngOffTmPT_FD16, system-signal=SystemSignal_COM_Tx_EngOffTmPT_FD16}
        sender-receiver-to-signal-mapping={data-element=CPT_MDG1_FlatView.PP_COM_Tx_OBD_CONTENT_FRAME_FD16.VD_COM_Tx_EngineOFFTime_FD16, system-signal=SystemSignal_COM_Tx_EngineOFFTime_FD16}
        sender-receiver-to-signal-mapping={data-element=CPT_MDG1_FlatView.PP_COM_Tx_OBD_CONTENT_FRAME_FD16.VD_COM_Tx_GenDenominator_FD16, system-signal=SystemSignal_COM_Tx_GenDenominator_FD16}
        sender-receiver-to-signal-mapping={data-element=CPT_MDG1_FlatView.PP_COM_Tx_OBD_CONTENT_FRAME_FD16.VD_COM_Tx_IgnCntrTrue_FD16, system-signal=SystemSignal_COM_Tx_IgnCntrTrue_FD16}
        sender-receiver-to-signal-mapping={data-element=CPT_MDG1_FlatView.PP_COM_Tx_OBD_CONTENT_FRAME_FD16.VD_COM_Tx_Inp_ICC_Fail_FD16, system-signal=SystemSignal_COM_Tx_Inp_ICC_Fail_FD16}
        sender-receiver-to-signal-mapping={data-element=CPT_MDG1_FlatView.PP_COM_Tx_OBD_CONTENT_FRAME_FD16.VD_COM_Tx_InputsGDFail_FD16, system-signal=SystemSignal_COM_Tx_InputsGDFail_FD16}
        sender-receiver-to-signal-mapping={data-element=CPT_MDG1_FlatView.PP_COM_Tx_OBD_CONTENT_FRAME_FD16.VD_COM_Tx_LoadOBD_FD16, system-signal=SystemSignal_COM_Tx_LoadOBD_FD16}
        sender-receiver-to-signal-mapping={data-element=CPT_MDG1_FlatView.PP_COM_Tx_OBD_CONTENT_FRAME_FD16.VD_COM_Tx_MC_OBDCONTENTFRAME_FD16, system-signal=SystemSignal_COM_Tx_MC_OBDCONTENTFRAME_FD16}
        sender-receiver-to-signal-mapping={data-element=CPT_MDG1_FlatView.PP_COM_Tx_OBD_CONTENT_FRAME_FD16.VD_COM_Tx_OAT_PT_EstV_FD16, system-signal=SystemSignal_COM_Tx_OAT_PT_EstV_FD16}
        sender-receiver-to-signal-mapping={data-element=CPT_MDG1_FlatView.PP_COM_Tx_OBD_CONTENT_FRAME_FD16.VD_COM_Tx_OAT_PT_Est_FD16, system-signal=SystemSignal_COM_Tx_OAT_PT_Est_FD16}
      sw-impl-mappings:
        137 x swc to impl mapping:
          SwcToImplMapping_ATS_Std: component-implementation=Imp_ATS_Std, component=CPT_MDG1_FlatView.CPT_ATS_Std
          SwcToImplMapping_AVS_Std: component-implementation=Imp_AVS_Std, component=CPT_MDG1_FlatView.CPT_AVS_Std
          SwcToImplMapping_BGTHDEV: component-implementation=Imp_BGTHDEV, component=CPT_MDG1_FlatView.CPT_BGTHDEV
          SwcToImplMapping_CDShdG_GTMLib: component-implementation=Imp_CDShdG_GTMLib, component=CPT_MDG1_FlatView.CPT_CDShdG_GTMLib
          SwcToImplMapping_CoEng_ObdSig: component-implementation=Imp_CoEng_ObdSig, component=CPT_MDG1_FlatView.CPT_CoEng_ObdSig
          SwcToImplMapping_CoEng_StAdpr: component-implementation=Imp_CoEng_StAdpr, component=CPT_MDG1_FlatView.CPT_CoEng_StAdpr
          SwcToImplMapping_CoEng_StEng: component-implementation=Imp_CoEng_StEng, component=CPT_MDG1_FlatView.CPT_CoEng_StEng
          SwcToImplMapping_ComCo_Lyr: component-implementation=Imp_ComCo_Lyr, component=CPT_MDG1_FlatView.CPT_ComCo_Lyr
          SwcToImplMapping_ComPtc: component-implementation=Imp_ComPtc, component=CPT_MDG1_FlatView.CPT_ComPtc
          SwcToImplMapping_ComScl_Appl: component-implementation=Imp_ComScl_Appl, component=CPT_MDG1_FlatView.CPT_ComScl_Appl
          SwcToImplMapping_DEVE: component-implementation=Imp_DEVE, component=CPT_MDG1_FlatView.CPT_DEVE
          SwcToImplMapping_DSM_Conf: component-implementation=Imp_DSM_Conf, component=CPT_MDG1_FlatView.CPT_DSM_Conf
          SwcToImplMapping_DcmDspUDS_DID: component-implementation=Imp_DcmDspUDS_DID, component=CPT_MDG1_FlatView.CPT_DcmDspUDS_DID
          SwcToImplMapping_DcmDspUDS_SecA: component-implementation=Imp_DcmDspUDS_SecA, component=CPT_MDG1_FlatView.CPT_DcmDspUDS_SecA
          SwcToImplMapping_Dem_Main: component-implementation=Imp_Dem_Main, component=CPT_MDG1_FlatView.CPT_Dem_Main
          SwcToImplMapping_DevLib_PwrStgState: component-implementation=Imp_DevLib_PwrStgState, component=CPT_MDG1_FlatView.CPT_DevLib_PwrStgState
          SwcToImplMapping_EGSHeatr_Acttn: component-implementation=Imp_EGSHeatr_Acttn, component=CPT_MDG1_FlatView.CPT_EGSHeatr_Acttn
          SwcToImplMapping_EGSHeatr_Ctrl: component-implementation=Imp_EGSHeatr_Ctrl, component=CPT_MDG1_FlatView.CPT_EGSHeatr_Ctrl
          SwcToImplMapping_EGSHeatr_DiagPrfmnc: component-implementation=Imp_EGSHeatr_DiagPrfmnc, component=CPT_MDG1_FlatView.CPT_EGSHeatr_DiagPrfmnc
          SwcToImplMapping_EGSHeatr_DiagWire: component-implementation=Imp_EGSHeatr_DiagWire, component=CPT_MDG1_FlatView.CPT_EGSHeatr_DiagWire
          SwcToImplMapping_EGSHeatr_SnsrCoorn: component-implementation=Imp_EGSHeatr_SnsrCoorn, component=CPT_MDG1_FlatView.CPT_EGSHeatr_SnsrCoorn
          SwcToImplMapping_EGSHeatr_SnsrTMdl: component-implementation=Imp_EGSHeatr_SnsrTMdl, component=CPT_MDG1_FlatView.CPT_EGSHeatr_SnsrTMdl
          SwcToImplMapping_EGSHeatr_TiHeatrOff: component-implementation=Imp_EGSHeatr_TiHeatrOff, component=CPT_MDG1_FlatView.CPT_EGSHeatr_TiHeatrOff
          SwcToImplMapping_ETC_Std: component-implementation=Imp_ETC_Std, component=CPT_MDG1_FlatView.CPT_ETC_Std
          SwcToImplMapping_EngDa_PwrEng: component-implementation=Imp_EngDa_PwrEng, component=CPT_MDG1_FlatView.CPT_EngDa_PwrEng
          SwcToImplMapping_EnvP_DD: component-implementation=Imp_EnvP_DD, component=CPT_MDG1_FlatView.CPT_EnvP_DD
          SwcToImplMapping_EnvP_VDDiag: component-implementation=Imp_EnvP_VDDiag, component=CPT_MDG1_FlatView.CPT_EnvP_VDDiag
          SwcToImplMapping_EpmBCr_IntrCo: component-implementation=Imp_EpmBCr_IntrCo, component=CPT_MDG1_FlatView.CPT_EpmBCr_IntrCo
          SwcToImplMapping_EpmBCr_Pos: component-implementation=Imp_EpmBCr_Pos, component=CPT_MDG1_FlatView.CPT_EpmBCr_Pos
          SwcToImplMapping_EpmCaS_Adap: component-implementation=Imp_EpmCaS_Adap, component=CPT_MDG1_FlatView.CPT_EpmCaS_Adap
          SwcToImplMapping_EpmCaS_Diag: component-implementation=Imp_EpmCaS_Diag, component=CPT_MDG1_FlatView.CPT_EpmCaS_Diag
          SwcToImplMapping_EpmCaS_Meas: component-implementation=Imp_EpmCaS_Meas, component=CPT_MDG1_FlatView.CPT_EpmCaS_Meas
          SwcToImplMapping_EpmCaS_OfsDiag: component-implementation=Imp_EpmCaS_OfsDiag, component=CPT_MDG1_FlatView.CPT_EpmCaS_OfsDiag
          SwcToImplMapping_EpmCaS_RelsSigEvln: component-implementation=Imp_EpmCaS_RelsSigEvln, component=CPT_MDG1_FlatView.CPT_EpmCaS_RelsSigEvln
          SwcToImplMapping_EpmCaS_Seg: component-implementation=Imp_EpmCaS_Seg, component=CPT_MDG1_FlatView.CPT_EpmCaS_Seg
          SwcToImplMapping_EpmCaS_Spd: component-implementation=Imp_EpmCaS_Spd, component=CPT_MDG1_FlatView.CPT_EpmCaS_Spd
          SwcToImplMapping_EpmCaS_SyncnPatTi: component-implementation=Imp_EpmCaS_SyncnPatTi, component=CPT_MDG1_FlatView.CPT_EpmCaS_SyncnPatTi
          SwcToImplMapping_EpmCrS_Diag: component-implementation=Imp_EpmCrS_Diag, component=CPT_MDG1_FlatView.CPT_EpmCrS_Diag
          SwcToImplMapping_EpmCrS_RevCnt: component-implementation=Imp_EpmCrS_RevCnt, component=CPT_MDG1_FlatView.CPT_EpmCrS_RevCnt
          SwcToImplMapping_EpmCrS_Seg: component-implementation=Imp_EpmCrS_Seg, component=CPT_MDG1_FlatView.CPT_EpmCrS_Seg
          SwcToImplMapping_EpmCrS_Spd: component-implementation=Imp_EpmCrS_Spd, component=CPT_MDG1_FlatView.CPT_EpmCrS_Spd
          SwcToImplMapping_EpmErr_Trace: component-implementation=Imp_EpmErr_Trace, component=CPT_MDG1_FlatView.CPT_EpmErr_Trace
          SwcToImplMapping_EpmHAgClk_Gen: component-implementation=Imp_EpmHAgClk_Gen, component=CPT_MDG1_FlatView.CPT_EpmHAgClk_Gen
          SwcToImplMapping_EpmHCaS_SigEval: component-implementation=Imp_EpmHCaS_SigEval, component=CPT_MDG1_FlatView.CPT_EpmHCaS_SigEval
          SwcToImplMapping_EpmHCrS_IntHndlr: component-implementation=Imp_EpmHCrS_IntHndlr, component=CPT_MDG1_FlatView.CPT_EpmHCrS_IntHndlr
          SwcToImplMapping_EpmIf_Imprt: component-implementation=Imp_EpmIf_Imprt, component=CPT_MDG1_FlatView.CPT_EpmIf_Imprt
          SwcToImplMapping_EpmRRS_AgDetect: component-implementation=Imp_EpmRRS_AgDetect, component=CPT_MDG1_FlatView.CPT_EpmRRS_AgDetect
          SwcToImplMapping_EpmRRS_StopDetect: component-implementation=Imp_EpmRRS_StopDetect, component=CPT_MDG1_FlatView.CPT_EpmRRS_StopDetect
          SwcToImplMapping_EpmSeq_EveHndlr: component-implementation=Imp_EpmSeq_EveHndlr, component=CPT_MDG1_FlatView.CPT_EpmSeq_EveHndlr
          SwcToImplMapping_EpmSeq_StateMn: component-implementation=Imp_EpmSeq_StateMn, component=CPT_MDG1_FlatView.CPT_EpmSeq_StateMn
          SwcToImplMapping_EpmSrv_Lib: component-implementation=Imp_EpmSrv_Lib, component=CPT_MDG1_FlatView.CPT_EpmSrv_Lib
          SwcToImplMapping_EpmSyn_CaSPos: component-implementation=Imp_EpmSyn_CaSPos, component=CPT_MDG1_FlatView.CPT_EpmSyn_CaSPos
          SwcToImplMapping_EpmSyn_CrSPos: component-implementation=Imp_EpmSyn_CrSPos, component=CPT_MDG1_FlatView.CPT_EpmSyn_CrSPos
          SwcToImplMapping_EpmTDC_Corrn: component-implementation=Imp_EpmTDC_Corrn, component=CPT_MDG1_FlatView.CPT_EpmTDC_Corrn
          SwcToImplMapping_Epm_CustAdp: component-implementation=Imp_Epm_CustAdp, component=CPT_MDG1_FlatView.CPT_Epm_CustAdp
          SwcToImplMapping_Epm_Ini: component-implementation=Imp_Epm_Ini, component=CPT_MDG1_FlatView.CPT_Epm_Ini
          SwcToImplMapping_Epm_OpMode: component-implementation=Imp_Epm_OpMode, component=CPT_MDG1_FlatView.CPT_Epm_OpMode
          SwcToImplMapping_Epm_Spd: component-implementation=Imp_Epm_Spd, component=CPT_MDG1_FlatView.CPT_Epm_Spd
          SwcToImplMapping_Epm_SpdFeat: component-implementation=Imp_Epm_SpdFeat, component=CPT_MDG1_FlatView.CPT_Epm_SpdFeat
          SwcToImplMapping_Epm_SpdGrd: component-implementation=Imp_Epm_SpdGrd, component=CPT_MDG1_FlatView.CPT_Epm_SpdGrd
          SwcToImplMapping_FEL_EvapSysIfAdp: component-implementation=Imp_FEL_EvapSysIfAdp, component=CPT_MDG1_FlatView.CPT_FEL_EvapSysIfAdp
          SwcToImplMapping_GlbDaAdapt_Adapt: component-implementation=Imp_GlbDaAdapt_Adapt, component=CPT_MDG1_FlatView.CPT_GlbDaAdapt_Adapt
          SwcToImplMapping_GlbDa_ECUOnTime: component-implementation=Imp_GlbDa_ECUOnTime, component=CPT_MDG1_FlatView.CPT_GlbDa_ECUOnTime
          SwcToImplMapping_HEGO_Htg: component-implementation=Imp_HEGO_Htg, component=CPT_MDG1_FlatView.CPT_HEGO_Htg
          SwcToImplMapping_HEGO_OBDElec: component-implementation=Imp_HEGO_OBDElec, component=CPT_MDG1_FlatView.CPT_HEGO_OBDElec
          SwcToImplMapping_HEGO_Sens: component-implementation=Imp_HEGO_Sens, component=CPT_MDG1_FlatView.CPT_HEGO_Sens
          SwcToImplMapping_IVGdiCtl_CvoAdpn: component-implementation=Imp_IVGdiCtl_CvoAdpn, component=CPT_MDG1_FlatView.CPT_IVGdiCtl_CvoAdpn
          SwcToImplMapping_IVGdiCtl_CvoCsersPlausyDiag: component-implementation=Imp_IVGdiCtl_CvoCsersPlausyDiag, component=CPT_MDG1_FlatView.CPT_IVGdiCtl_CvoCsersPlausyDiag
          SwcToImplMapping_IVGdiCtl_CvoDiag: component-implementation=Imp_IVGdiCtl_CvoDiag, component=CPT_MDG1_FlatView.CPT_IVGdiCtl_CvoDiag
          SwcToImplMapping_IVGdiCtl_CvoSigAcq: component-implementation=Imp_IVGdiCtl_CvoSigAcq, component=CPT_MDG1_FlatView.CPT_IVGdiCtl_CvoSigAcq
          SwcToImplMapping_IVGdiCtl_CvoSigEvln: component-implementation=Imp_IVGdiCtl_CvoSigEvln, component=CPT_MDG1_FlatView.CPT_IVGdiCtl_CvoSigEvln
          SwcToImplMapping_IVGdiCtl_CvoSimnErr: component-implementation=Imp_IVGdiCtl_CvoSimnErr, component=CPT_MDG1_FlatView.CPT_IVGdiCtl_CvoSimnErr
          SwcToImplMapping_IgCPrimI_AcqnAdc: component-implementation=Imp_IgCPrimI_AcqnAdc, component=CPT_MDG1_FlatView.CPT_IgCPrimI_AcqnAdc
          SwcToImplMapping_IgnClPs_Dia: component-implementation=Imp_IgnClPs_Dia, component=CPT_MDG1_FlatView.CPT_IgnClPs_Dia
          SwcToImplMapping_IgnCoilDiagCoorn: component-implementation=Imp_IgnCoilDiagCoorn, component=CPT_MDG1_FlatView.CPT_IgnCoilDiagCoorn
          SwcToImplMapping_IgnDD_Calcn: component-implementation=Imp_IgnDD_Calcn, component=CPT_MDG1_FlatView.CPT_IgnDD_Calcn
          SwcToImplMapping_IgnDD_ModCtrlr: component-implementation=Imp_IgnDD_ModCtrlr, component=CPT_MDG1_FlatView.CPT_IgnDD_ModCtrlr
          SwcToImplMapping_InjDDGdi: component-implementation=Imp_InjDDGdi, component=CPT_MDG1_FlatView.CPT_InjDDGdi
          SwcToImplMapping_InjDDPfi: component-implementation=Imp_InjDDPfi, component=CPT_MDG1_FlatView.CPT_InjDDPfi
          SwcToImplMapping_InjSyG_AdpnCdnCvo: component-implementation=Imp_InjSyG_AdpnCdnCvo, component=CPT_MDG1_FlatView.CPT_InjSyG_AdpnCdnCvo
          SwcToImplMapping_InjSyG_CalcCnvnFac: component-implementation=Imp_InjSyG_CalcCnvnFac, component=CPT_MDG1_FlatView.CPT_InjSyG_CalcCnvnFac
          SwcToImplMapping_InjSyG_CoCvo: component-implementation=Imp_InjSyG_CoCvo, component=CPT_MDG1_FlatView.CPT_InjSyG_CoCvo
          SwcToImplMapping_InjSyG_DdIf: component-implementation=Imp_InjSyG_DdIf, component=CPT_MDG1_FlatView.CPT_InjSyG_DdIf
          SwcToImplMapping_InjSyG_InjTi: component-implementation=Imp_InjSyG_InjTi, component=CPT_MDG1_FlatView.CPT_InjSyG_InjTi
          SwcToImplMapping_InjSyG_InjTmngAdpr: component-implementation=Imp_InjSyG_InjTmngAdpr, component=CPT_MDG1_FlatView.CPT_InjSyG_InjTmngAdpr
          SwcToImplMapping_InjSyG_SpCvo: component-implementation=Imp_InjSyG_SpCvo, component=CPT_MDG1_FlatView.CPT_InjSyG_SpCvo
          SwcToImplMapping_InjVlvPs_ConCJ: component-implementation=Imp_InjVlvPs_ConCJ, component=CPT_MDG1_FlatView.CPT_InjVlvPs_ConCJ
          SwcToImplMapping_InjVlvPs_Dia: component-implementation=Imp_InjVlvPs_Dia, component=CPT_MDG1_FlatView.CPT_InjVlvPs_Dia
          SwcToImplMapping_IoSigSwAdpr_SwSStellantis: component-implementation=Imp_IoSigSwAdpr_SwSStellantis, component=CPT_MDG1_FlatView.CPT_IoSigSwAdpr_SwSStellantis
          SwcToImplMapping_KONCW: component-implementation=Imp_KONCW, component=CPT_MDG1_FlatView.CPT_KONCW
          SwcToImplMapping_KnDetControl: component-implementation=Imp_KnDetControl, component=CPT_MDG1_FlatView.CPT_KnDetControl
          SwcToImplMapping_KnDetLTest: component-implementation=Imp_KnDetLTest, component=CPT_MDG1_FlatView.CPT_KnDetLTest
          SwcToImplMapping_KnDetSigEval: component-implementation=Imp_KnDetSigEval, component=CPT_MDG1_FlatView.CPT_KnDetSigEval
          SwcToImplMapping_MRly_Vld2Lcy: component-implementation=Imp_MRly_Vld2Lcy, component=CPT_MDG1_FlatView.CPT_MRly_Vld2Lcy
          SwcToImplMapping_MfDD: component-implementation=Imp_MfDD, component=CPT_MDG1_FlatView.CPT_MfDD
          SwcToImplMapping_MfPsDia: component-implementation=Imp_MfPsDia, component=CPT_MDG1_FlatView.CPT_MfPsDia
          SwcToImplMapping_MfPs_ConCY: component-implementation=Imp_MfPs_ConCY, component=CPT_MDG1_FlatView.CPT_MfPs_ConCY
          SwcToImplMapping_MoCCom_Co: component-implementation=Imp_MoCCom_Co, component=CPT_MDG1_FlatView.CPT_MoCCom_Co
          SwcToImplMapping_MoCSOP_Co: component-implementation=Imp_MoCSOP_Co, component=CPT_MDG1_FlatView.CPT_MoCSOP_Co
          SwcToImplMapping_OilCmbdSen_DD: component-implementation=Imp_OilCmbdSen_DD, component=CPT_MDG1_FlatView.CPT_OilCmbdSen_DD
          SwcToImplMapping_Reset_CallBack: component-implementation=Imp_Reset_CallBack, component=CPT_MDG1_FlatView.CPT_Reset_CallBack
          SwcToImplMapping_SWAdp: component-implementation=Imp_SWAdp, component=CPT_MDG1_FlatView.CPT_SWAdp
          SwcToImplMapping_SYNTIZW: component-implementation=Imp_SYNTIZW, component=CPT_MDG1_FlatView.CPT_SYNTIZW
          SwcToImplMapping_SrvB: component-implementation=Imp_SrvB, component=CPT_MDG1_FlatView.CPT_SrvB
          SwcToImplMapping_SyC_Vld2Lcy: component-implementation=Imp_SyC_Vld2Lcy, component=CPT_MDG1_FlatView.CPT_SyC_Vld2Lcy
          SwcToImplMapping_T15_Vld2Lcy: component-implementation=Imp_T15_Vld2Lcy, component=CPT_MDG1_FlatView.CPT_T15_Vld2Lcy
          SwcToImplMapping_UEGO_Dac: component-implementation=Imp_UEGO_Dac, component=CPT_MDG1_FlatView.CPT_UEGO_Dac
          SwcToImplMapping_UEGO_DiagRels: component-implementation=Imp_UEGO_DiagRels, component=CPT_MDG1_FlatView.CPT_UEGO_DiagRels
          SwcToImplMapping_UEGO_DiagSigEcuAsic: component-implementation=Imp_UEGO_DiagSigEcuAsic, component=CPT_MDG1_FlatView.CPT_UEGO_DiagSigEcuAsic
          SwcToImplMapping_UEGO_DiagSigOperPlaus: component-implementation=Imp_UEGO_DiagSigOperPlaus, component=CPT_MDG1_FlatView.CPT_UEGO_DiagSigOperPlaus
          SwcToImplMapping_UEGO_DiagSigSnsr: component-implementation=Imp_UEGO_DiagSigSnsr, component=CPT_MDG1_FlatView.CPT_UEGO_DiagSigSnsr
          SwcToImplMapping_UEGO_DiagSigWireOl: component-implementation=Imp_UEGO_DiagSigWireOl, component=CPT_MDG1_FlatView.CPT_UEGO_DiagSigWireOl
          SwcToImplMapping_UEGO_DiagSigWireSc: component-implementation=Imp_UEGO_DiagSigWireSc, component=CPT_MDG1_FlatView.CPT_UEGO_DiagSigWireSc
          SwcToImplMapping_UEGO_ICntct: component-implementation=Imp_UEGO_ICntct, component=CPT_MDG1_FlatView.CPT_UEGO_ICntct
          SwcToImplMapping_UEGO_IPmpPck: component-implementation=Imp_UEGO_IPmpPck, component=CPT_MDG1_FlatView.CPT_UEGO_IPmpPck
          SwcToImplMapping_UEGO_IPmpRef: component-implementation=Imp_UEGO_IPmpRef, component=CPT_MDG1_FlatView.CPT_UEGO_IPmpRef
          SwcToImplMapping_UEGO_IPmpSeg: component-implementation=Imp_UEGO_IPmpSeg, component=CPT_MDG1_FlatView.CPT_UEGO_IPmpSeg
          SwcToImplMapping_UEGO_ISrc: component-implementation=Imp_UEGO_ISrc, component=CPT_MDG1_FlatView.CPT_UEGO_ISrc
          SwcToImplMapping_UEGO_ModCtrl: component-implementation=Imp_UEGO_ModCtrl, component=CPT_MDG1_FlatView.CPT_UEGO_ModCtrl
          SwcToImplMapping_UEGO_O2: component-implementation=Imp_UEGO_O2, component=CPT_MDG1_FlatView.CPT_UEGO_O2
          SwcToImplMapping_UEGO_O2Ref: component-implementation=Imp_UEGO_O2Ref, component=CPT_MDG1_FlatView.CPT_UEGO_O2Ref
          SwcToImplMapping_UEGO_OperRels: component-implementation=Imp_UEGO_OperRels, component=CPT_MDG1_FlatView.CPT_UEGO_OperRels
          SwcToImplMapping_UEGO_OperRelsExtInhb: component-implementation=Imp_UEGO_OperRelsExtInhb, component=CPT_MDG1_FlatView.CPT_UEGO_OperRelsExtInhb
          SwcToImplMapping_UEGO_RCmp: component-implementation=Imp_UEGO_RCmp, component=CPT_MDG1_FlatView.CPT_UEGO_RCmp
          SwcToImplMapping_UEGO_RNernst: component-implementation=Imp_UEGO_RNernst, component=CPT_MDG1_FlatView.CPT_UEGO_RNernst
          SwcToImplMapping_UEGO_RPmp: component-implementation=Imp_UEGO_RPmp, component=CPT_MDG1_FlatView.CPT_UEGO_RPmp
          SwcToImplMapping_UEGO_TCeramic: component-implementation=Imp_UEGO_TCeramic, component=CPT_MDG1_FlatView.CPT_UEGO_TCeramic
          SwcToImplMapping_UEGO_Tstr: component-implementation=Imp_UEGO_Tstr, component=CPT_MDG1_FlatView.CPT_UEGO_Tstr
          SwcToImplMapping_UEGO_UNernst: component-implementation=Imp_UEGO_UNernst, component=CPT_MDG1_FlatView.CPT_UEGO_UNernst
          SwcToImplMapping_UEGO_UPmp: component-implementation=Imp_UEGO_UPmp, component=CPT_MDG1_FlatView.CPT_UEGO_UPmp
          SwcToImplMapping_XcpAppl: component-implementation=Imp_XcpAppl, component=CPT_MDG1_FlatView.CPT_XcpAppl
          SwcToImplMapping_dcmcore_dsldsd_appl: component-implementation=Imp_dcmcore_dsldsd_appl, component=CPT_MDG1_FlatView.CPT_dcmcore_dsldsd_appl
          SwcToImplMapping_rba_EepAdaptDGS: component-implementation=Imp_rba_EepAdaptDGS, component=CPT_MDG1_FlatView.CPT_rba_EepAdaptDGS
          SwcToImplMapping_rba_MemDiag: component-implementation=Imp_rba_MemDiag, component=CPT_MDG1_FlatView.CPT_rba_MemDiag
          SwcToImplMapping_rba_OsArSchedExtn_OS: component=CPT_MDG1_FlatView.CPT_rba_OsArSchedExtn_OS
          SwcToImplMapping_rba_OsArSchedExtn_mcop: component-implementation=Imp_rba_OsArSchedExtn_mcop, component=CPT_MDG1_FlatView.CPT_rba_OsArSchedExtn_mcop
          SwcToImplMapping_rba_Svbb: component-implementation=Imp_rba_Svbb, component=CPT_MDG1_FlatView.CPT_rba_Svbb
      sw-mappings:
        swc to ecu mapping SwcToEcuMapping_0: ecu-instance=MDG1
          component:
            CPT_MDG1_FlatView.AC_CluRlyDigOutp
            CPT_MDG1_FlatView.AMTR
            CPT_MDG1_FlatView.ASnsrRatly
            CPT_MDG1_FlatView.AccrPedlEstimr
            CPT_MDG1_FlatView.AccrPedlMpg
            CPT_MDG1_FlatView.AccrPedlSnsr
            CPT_MDG1_FlatView.ActrSyncnCoorr
            CPT_MDG1_FlatView.ActrSyncnCoorrPrm
            CPT_MDG1_FlatView.AftmntPhysCoorr
            CPT_MDG1_FlatView.AftmntPhysCoorrPrm
            CPT_MDG1_FlatView.AftmntSysPEstimr
            CPT_MDG1_FlatView.AftmntThermMgr
            CPT_MDG1_FlatView.AgsCtrl
            CPT_MDG1_FlatView.AgsRatly
            CPT_MDG1_FlatView.AirCdngCtrl
            CPT_MDG1_FlatView.AirCdngPEstimr
            CPT_MDG1_FlatView.AirCdngPSnsr
            CPT_MDG1_FlatView.AirCdngPSnsrAdcInpSwc
            CPT_MDG1_FlatView.AirTempSnsrDiag
            CPT_MDG1_FlatView.AllGrPosnSnsr1PwmInp
            CPT_MDG1_FlatView.AllGrPosnSnsr2PwmInp
            CPT_MDG1_FlatView.AlterFieCtrlPwmOutp
            CPT_MDG1_FlatView.AmbTEstimr
            CPT_MDG1_FlatView.AmbTSnsr
            CPT_MDG1_FlatView.AuxBattDiag
            CPT_MDG1_FlatView.BaroPEstimr
            CPT_MDG1_FlatView.BaroPSnsr
            CPT_MDG1_FlatView.BoostTemp1AdcInpSwc
            CPT_MDG1_FlatView.BoostTemp2AdcInpSwc
            CPT_MDG1_FlatView.BrkPdlPosnSnsrAdcInp
            CPT_MDG1_FlatView.BrkPedlEstimr
            CPT_MDG1_FlatView.BrkPedlSnsr
            CPT_MDG1_FlatView.BrkSwDigInp
            CPT_MDG1_FlatView.BrkSysRatly
            CPT_MDG1_FlatView.BrkSysRatlyPrm
            CPT_MDG1_FlatView.C3WVCtrl
            CPT_MDG1_FlatView.C3WVRatly
            CPT_MDG1_FlatView.CDAConstrDetrmn
            CPT_MDG1_FlatView.CEGR_PosnSns
            CPT_MDG1_FlatView.CPT_BswM
            CPT_MDG1_FlatView.CPT_ComCIL_Adapt
            CPT_MDG1_FlatView.CPT_ComDia_Dcm_Rte_Adapter
            CPT_MDG1_FlatView.CPT_ComM
            CPT_MDG1_FlatView.CPT_ComScl_EngLin
            CPT_MDG1_FlatView.CPT_ComScl_EngLinTxAdapt
            CPT_MDG1_FlatView.CPT_ComScl_EngLin_Scl
            CPT_MDG1_FlatView.CPT_ComScl_NetMtrx
            CPT_MDG1_FlatView.CPT_ComScl_NetMtrx2
            CPT_MDG1_FlatView.CPT_ComScl_NetMtrx2TxAdapt
            CPT_MDG1_FlatView.CPT_ComScl_NetMtrx2_Scl
            CPT_MDG1_FlatView.CPT_ComScl_NetMtrx3
            CPT_MDG1_FlatView.CPT_ComScl_NetMtrx3TxAdapt
            CPT_MDG1_FlatView.CPT_ComScl_NetMtrx3_Scl
            CPT_MDG1_FlatView.CPT_ComScl_NetMtrxTxAdapt
            CPT_MDG1_FlatView.CPT_ComScl_NetMtrx_Scl
            CPT_MDG1_FlatView.CPT_Csm
            CPT_MDG1_FlatView.CPT_Dcm
            CPT_MDG1_FlatView.CPT_Dem
            CPT_MDG1_FlatView.CPT_Det
            CPT_MDG1_FlatView.CPT_ESC_EveCfg
            CPT_MDG1_FlatView.CPT_ESC_HwIntrptEveGen
            CPT_MDG1_FlatView.CPT_ESC_Ladp
            CPT_MDG1_FlatView.CPT_ESC_OsTskActvnHndlr
            CPT_MDG1_FlatView.CPT_EcuM
            CPT_MDG1_FlatView.CPT_Epm_Ladp
            CPT_MDG1_FlatView.CPT_FiM
            CPT_MDG1_FlatView.CPT_IoSigAdc_SwSStellantisParm
            CPT_MDG1_FlatView.CPT_IoSigDioInp_SwSStellantisParam
            CPT_MDG1_FlatView.CPT_IoSigDioOutp_SwSStellantisParam
            CPT_MDG1_FlatView.CPT_IoSigPwmInp_SwSStellantisParm
            CPT_MDG1_FlatView.CPT_IoSigPwmOutp_SwSStellantisParm
            CPT_MDG1_FlatView.CPT_KeyM
            CPT_MDG1_FlatView.CPT_NvM
            CPT_MDG1_FlatView.CPT_SWC_VcodProxi
            CPT_MDG1_FlatView.CPT_SecOC
            CPT_MDG1_FlatView.CPT_SentStack_SwSStellantisParm
            CPT_MDG1_FlatView.CPT_SysC_Ladp
            CPT_MDG1_FlatView.CPT_WdgM
            CPT_MDG1_FlatView.CPT_esc_stack
            CPT_MDG1_FlatView.CPT_esc_tasklink
            CPT_MDG1_FlatView.CPT_rba_DiagLib
            CPT_MDG1_FlatView.CPT_rba_IoDiagHbr
            CPT_MDG1_FlatView.CPT_rba_IoDiagHlfBr
            CPT_MDG1_FlatView.CPT_rba_IoDiagPs
            CPT_MDG1_FlatView.CPT_rba_IoDiagPwr
            CPT_MDG1_FlatView.CPT_rba_IoSigAdc
            CPT_MDG1_FlatView.CPT_rba_IoSigDio
            CPT_MDG1_FlatView.CPT_rba_IoSigHlfBr
            CPT_MDG1_FlatView.CPT_rba_IoSigIcu
            CPT_MDG1_FlatView.CPT_rba_IoSigObs
            CPT_MDG1_FlatView.CPT_rba_IoSigPwm
            CPT_MDG1_FlatView.CPT_rba_IoSigPwr
            CPT_MDG1_FlatView.CPT_rba_IoSigRtc
            CPT_MDG1_FlatView.CPT_rba_OsArSchedExtn_OS
            CPT_MDG1_FlatView.CPT_rba_OsShell
            CPT_MDG1_FlatView.CPT_rba_SyC_States
            CPT_MDG1_FlatView.CPT_rba_SyC_States_Cfg_0_Q_1
            CPT_MDG1_FlatView.CPT_rba_SyC_States_Cfg_1_B_1
            CPT_MDG1_FlatView.CPT_rba_SyC_States_Cfg_{1..3}_Q_1
            CPT_MDG1_FlatView.CPT_rbm_DSM_Conf
            CPT_MDG1_FlatView.CalInp1AdcInpSwc
            CPT_MDG1_FlatView.CalInp2AdcInpSwc
            CPT_MDG1_FlatView.CamCrksftDifVldFEEBlkSwc
            CPT_MDG1_FlatView.CatAndUsOxSnsrRatly
            CPT_MDG1_FlatView.CatTEstimr
            CPT_MDG1_FlatView.CatTEstimrPrm
            CPT_MDG1_FlatView.CdsnMgr
            CPT_MDG1_FlatView.ClsdLoopFuCtrlEnaTRatly
            CPT_MDG1_FlatView.ClsdLoopFuCtrlEnaTiRatly
            CPT_MDG1_FlatView.CluInterLockSwDigInp
            CPT_MDG1_FlatView.CluSnsAdcInp
            CPT_MDG1_FlatView.CmbPhsgTar
            CPT_MDG1_FlatView.CmprInletPEstimr
            CPT_MDG1_FlatView.CmprInletPSnsr
            CPT_MDG1_FlatView.CmprInletTempAdcInp
            CPT_MDG1_FlatView.CmprOutlTEstimr
            CPT_MDG1_FlatView.CmprOutlTSnsr
            CPT_MDG1_FlatView.CoEng_SwSStellantis
            CPT_MDG1_FlatView.ColdCrkCasePSnsrAdcInpSwc
            CPT_MDG1_FlatView.ColdStrtCamRatly
            CPT_MDG1_FlatView.ColdStrtDirectInjRatly
            CPT_MDG1_FlatView.ColdStrtDynCrksftFuCtrlDiagc
            CPT_MDG1_FlatView.ColdStrtDynCrksftFuCtrlDiagcPrm
            CPT_MDG1_FlatView.ColdStrtSprkRatly
            CPT_MDG1_FlatView.CoolEgrTAdcInpSwc
            CPT_MDG1_FlatView.Coolt3WayVlvAdcInpSwc
            CPT_MDG1_FlatView.CooltElecPmpCtrl
            CPT_MDG1_FlatView.CrkBattMonrAdcInpSwc
            CPT_MDG1_FlatView.CrkTrainCpby
            CPT_MDG1_FlatView.CrkTrainEstimr
            CPT_MDG1_FlatView.CrkTrainPhysCoorr
            CPT_MDG1_FlatView.CrkcsFrshAirLinePEstimr
            CPT_MDG1_FlatView.CrkcsFrshAirLinePSnsr
            CPT_MDG1_FlatView.CrksftSpdLimn
            CPT_MDG1_FlatView.CrsSwtEstimr
            CPT_MDG1_FlatView.CrsSwtEstimrPrm
            CPT_MDG1_FlatView.CylDeactvnActrCtrl
            CPT_MDG1_FlatView.CylDeactvnActrCtrlDiag
            CPT_MDG1_FlatView.CylDeactvnSysCoorr
            CPT_MDG1_FlatView.CylImepEstimr
            CPT_MDG1_FlatView.CylPEstimr
            CPT_MDG1_FlatView.CylPhiImbDiagc
            CPT_MDG1_FlatView.CylPhiImbEstimr
            CPT_MDG1_FlatView.CylPhiTar
            CPT_MDG1_FlatView.CylPhiTarPrm
            CPT_MDG1_FlatView.CylPhysCoorr
            CPT_MDG1_FlatView.CylPmepEstimr
            CPT_MDG1_FlatView.DMTLLkPmpDigOutp
            CPT_MDG1_FlatView.DP_VlvPosnSns
            CPT_MDG1_FlatView.DSM_SwSStellantis
            CPT_MDG1_FlatView.DoorRatly
            CPT_MDG1_FlatView.DrvAwayInhb
            CPT_MDG1_FlatView.DrvModDetermn
            CPT_MDG1_FlatView.DrvlnEstimr
            CPT_MDG1_FlatView.DsFuTrimRatly
            CPT_MDG1_FlatView.DsOxSnsrRatly
            CPT_MDG1_FlatView.DsvlActrCtrl
            CPT_MDG1_FlatView.DsvlRatly
            CPT_MDG1_FlatView.DsvlSolnDiag
            CPT_MDG1_FlatView.DsvlSysCoorr
            CPT_MDG1_FlatView.DualBattRlyRatly
            CPT_MDG1_FlatView.DualFuTankEnblRlyDigOutp
            CPT_MDG1_FlatView.DualStgOilPmpRatly
            CPT_MDG1_FlatView.DynCrksftFuCtrl
            CPT_MDG1_FlatView.DynoFuDsblReqSwDigInp
            CPT_MDG1_FlatView.ECM_WakeUpDigInp
            CPT_MDG1_FlatView.EGRCoolr_DeltAbsPresSnsr
            CPT_MDG1_FlatView.EGRMonrAndPosnSnsrDiagc
            CPT_MDG1_FlatView.EGRMonrAndPosnSnsrDiagcPrm
            CPT_MDG1_FlatView.ELCM_ChgOvrVlvDigOutp
            CPT_MDG1_FlatView.ELCM_VacPmpPwmOutp
            CPT_MDG1_FlatView.ETDR
            CPT_MDG1_FlatView.EVNR
            CPT_MDG1_FlatView.EcmOdomEstimr
            CPT_MDG1_FlatView.EepNVBlkSwcCmpstn
            CPT_MDG1_FlatView.EepNVBlkSwc_Core1
            CPT_MDG1_FlatView.EepNVBlkSwc_OsApp_0_Q_1
            CPT_MDG1_FlatView.EepNVBlkSwc_OsApp_1_Q_1
            CPT_MDG1_FlatView.EgrTEstimr
            CPT_MDG1_FlatView.EgrTSnsr
            CPT_MDG1_FlatView.EgrTSnsrRatly
            CPT_MDG1_FlatView.EgrVlvDeltaPEstimr
            CPT_MDG1_FlatView.EgrVlvDeltaPSnsr
            CPT_MDG1_FlatView.EgrVlvPosnEstimr
            CPT_MDG1_FlatView.EgrVlvPosnSnsr
            CPT_MDG1_FlatView.ElecPhsrDiagPwmInp
            CPT_MDG1_FlatView.ElecPhsrMtrCmdOutpPwmOutp
            CPT_MDG1_FlatView.ElecThHeatrCtrl
            CPT_MDG1_FlatView.ElecVacPmpCtrl
            CPT_MDG1_FlatView.ElecVvtActrCtrl
            CPT_MDG1_FlatView.ElecVvtPosn
            CPT_MDG1_FlatView.ElecWtrPmpRatly
            CPT_MDG1_FlatView.ElectcVacPmpRlyDigOutp
            CPT_MDG1_FlatView.EngAdpnCoorr
            CPT_MDG1_FlatView.EngCooltTAdcInpSwc
            CPT_MDG1_FlatView.EngCooltTEstimr
            CPT_MDG1_FlatView.EngCooltTSnsr
            CPT_MDG1_FlatView.EngFricEstimr
            CPT_MDG1_FlatView.EngInletCooltTSnsr
            CPT_MDG1_FlatView.EngMeclPpty
            CPT_MDG1_FlatView.EngMeclPptyPrm
            CPT_MDG1_FlatView.EngOilAertnEstimr
            CPT_MDG1_FlatView.EngOilChgEstimr
            CPT_MDG1_FlatView.EngOilDilEstimr
            CPT_MDG1_FlatView.EngOilLvlEstimr
            CPT_MDG1_FlatView.EngOilLvlSnsr
            CPT_MDG1_FlatView.EngOilPEstimr
            CPT_MDG1_FlatView.EngOilPSnsr
            CPT_MDG1_FlatView.EngOilPSnsrDiagc
            CPT_MDG1_FlatView.EngOilPmpCtrl
            CPT_MDG1_FlatView.EngOilTEstimr
            CPT_MDG1_FlatView.EngOilTSnsr
            CPT_MDG1_FlatView.EngOilTSnsrDiagc
            CPT_MDG1_FlatView.EngSpdConstr
            CPT_MDG1_FlatView.EngSpdCtrl
            CPT_MDG1_FlatView.EngSpdTarDetrmn
            CPT_MDG1_FlatView.EngSwtBattAdcInpSwc
            CPT_MDG1_FlatView.EngTraDetn
            CPT_MDG1_FlatView.EnvP_SwSStellantis
            CPT_MDG1_FlatView.Epm_SwSStellantis
            CPT_MDG1_FlatView.Epm_SwSStellantis_PSwc
            CPT_MDG1_FlatView.EssDiSwtEstimr
            CPT_MDG1_FlatView.EssEveMgr
            CPT_MDG1_FlatView.EssOccptSenMgr
            CPT_MDG1_FlatView.EthnlConcEstimr
            CPT_MDG1_FlatView.EthnlVapEstimr
            CPT_MDG1_FlatView.EvapLkChkMonSnsAdcInpSwc
            CPT_MDG1_FlatView.ExhEstimr
            CPT_MDG1_FlatView.ExhPhiEstimr
            CPT_MDG1_FlatView.ExhPhiSnsr
            CPT_MDG1_FlatView.ExhPhiSnsrDiag
            CPT_MDG1_FlatView.ExhPhiTar
            CPT_MDG1_FlatView.ExhTThermMngt
            CPT_MDG1_FlatView.ExtEgrActrCtrl
            CPT_MDG1_FlatView.ExtEgrActrCtrlDiag
            CPT_MDG1_FlatView.ExtEgrSysCoorr
            CPT_MDG1_FlatView.ExtTqReq
            CPT_MDG1_FlatView.FEELubCtrlBlkSwc
            CPT_MDG1_FlatView.FPCMFb1PwmInp
            CPT_MDG1_FlatView.FTIVCtrl
            CPT_MDG1_FlatView.FiveVoltAuxAdcInpSwc
            CPT_MDG1_FlatView.FiveVoltOutpAdcInpSwc
            CPT_MDG1_FlatView.FiveVoltSnsAdcInpSwc
            CPT_MDG1_FlatView.FldPpty
            CPT_MDG1_FlatView.FsoAndCylDeactvnPhysCoorr
            CPT_MDG1_FlatView.FuAgeEstimr
            CPT_MDG1_FlatView.FuBrnFracEstimr
            CPT_MDG1_FlatView.FuCnsEstimr
            CPT_MDG1_FlatView.FuDoorDigOutp
            CPT_MDG1_FlatView.FuDoorSwDigInp
            CPT_MDG1_FlatView.FuFlowAdpn
            CPT_MDG1_FlatView.FuInjrCtrl
            CPT_MDG1_FlatView.FuInjrDICtrl
            CPT_MDG1_FlatView.FuInjrDiag
            CPT_MDG1_FlatView.FuInjrEna
            CPT_MDG1_FlatView.FuInjrIf
            CPT_MDG1_FlatView.FuInjrMSplitTar
            CPT_MDG1_FlatView.FuInjrMTar
            CPT_MDG1_FlatView.FuInjrSplitRatioMgr
            CPT_MDG1_FlatView.FuLvlEstimr
            CPT_MDG1_FlatView.FuLvlRatly
            CPT_MDG1_FlatView.FuLvlSnsr
            CPT_MDG1_FlatView.FuPSnsrRatly
            CPT_MDG1_FlatView.FuPmpCtlMdul2CmdPwmOutp
            CPT_MDG1_FlatView.FuPmpCtlMdulCmdPwmOutp
            CPT_MDG1_FlatView.FuPptyEstimr
            CPT_MDG1_FlatView.FuPptyEstimrPrm
            CPT_MDG1_FlatView.FuRailHeatrActr
            CPT_MDG1_FlatView.FuRailHeatrCtrl
            CPT_MDG1_FlatView.FuRailPEstimr
            CPT_MDG1_FlatView.FuRailPSnsr
            CPT_MDG1_FlatView.FuRailPTar
            CPT_MDG1_FlatView.FuRailTEstimr
            CPT_MDG1_FlatView.FuSysMon
            CPT_MDG1_FlatView.FuTankIsolnVlvDigOutp
            CPT_MDG1_FlatView.FuTankPEstimr
            CPT_MDG1_FlatView.FuTankPSnsr
            CPT_MDG1_FlatView.FuTankPSnsrAdcInpSwc
            CPT_MDG1_FlatView.FuWallFilmEstimr
            CPT_MDG1_FlatView.GEVlv_SwSStellantis
            CPT_MDG1_FlatView.GPF_DeltAbsPresSnsr1
            CPT_MDG1_FlatView.GPF_DeltAbsPresSnsr2
            CPT_MDG1_FlatView.GasFlowActrLimn
            CPT_MDG1_FlatView.GasFlowEstimr
            CPT_MDG1_FlatView.GasFlowPrm
            CPT_MDG1_FlatView.GasXchgEstimr
            CPT_MDG1_FlatView.GasXchgPhysCoorr
            CPT_MDG1_FlatView.GasXchgPrm
            CPT_MDG1_FlatView.GasXchgSysCoorr
            CPT_MDG1_FlatView.GdiFuRailP1AdcInpSwc
            CPT_MDG1_FlatView.GdiFuRailP2AdcInpSwc
            CPT_MDG1_FlatView.HTLSysCoorr
            CPT_MDG1_FlatView.HTR_MeclWtrPmpActrPwmOutp
            CPT_MDG1_FlatView.HTR_TempCtrlVlvSolnPwmOutp
            CPT_MDG1_FlatView.Hbrdg_Coold_EGR
            CPT_MDG1_FlatView.Hbrdg_DP
            CPT_MDG1_FlatView.Hbrdg_ETC_Motor
            CPT_MDG1_FlatView.Hbrdg_VarGeomTrb
            CPT_MDG1_FlatView.Hbrdg_Wg1
            CPT_MDG1_FlatView.HevEssIF
            CPT_MDG1_FlatView.HiPFuPmpCtrl
            CPT_MDG1_FlatView.HiPFuPmpRatly
            CPT_MDG1_FlatView.HiTRadrOutlTSnsrAdcInpSwc
            CPT_MDG1_FlatView.HoodAjarAdcInpSwc
            CPT_MDG1_FlatView.HoodSwtRatly
            CPT_MDG1_FlatView.HvacSigDiagc
            CPT_MDG1_FlatView.HybEngStrtFuEstimr
            CPT_MDG1_FlatView.HybSprkPlgFoulgEstimr
            CPT_MDG1_FlatView.IdleSpdRatly
            CPT_MDG1_FlatView.IgnCl_SwSStellantis
            CPT_MDG1_FlatView.IgnCoilCtrl
            CPT_MDG1_FlatView.IgnRunStrtSwDigInp
            CPT_MDG1_FlatView.IgnSwtStEstimr
            CPT_MDG1_FlatView.IgnTimgTar
            CPT_MDG1_FlatView.InRushIRednRly
            CPT_MDG1_FlatView.InjSyG_SwSStellantis
            CPT_MDG1_FlatView.InjVvGPfi_SwSStellantis
            CPT_MDG1_FlatView.InjVvG_SwSStellantis
            CPT_MDG1_FlatView.InjrBallstcRegnMngt
            CPT_MDG1_FlatView.InjrBallstcRegnRatly
            CPT_MDG1_FlatView.InletAirTEstimr
            CPT_MDG1_FlatView.InletAirTSnsr
            CPT_MDG1_FlatView.InletPresVlvActrCtrl
            CPT_MDG1_FlatView.InletPresVlvPosnEstimr
            CPT_MDG1_FlatView.InletPresVlvPosnSnsr
            CPT_MDG1_FlatView.InrushCircRlyDigOutp
            CPT_MDG1_FlatView.IntgrdEvapSysRatly
            CPT_MDG1_FlatView.IntkAirTAdcInpSwc
            CPT_MDG1_FlatView.IntkEstimr
            CPT_MDG1_FlatView.IntkMnfldPEstimr
            CPT_MDG1_FlatView.IntkMnfldPSnsr
            CPT_MDG1_FlatView.IntkMnfldTEstimr
            CPT_MDG1_FlatView.IntkMnfldTSnsr
            CPT_MDG1_FlatView.IntkPhysCoorr
            CPT_MDG1_FlatView.IoSigAdc_SwSStellantisParm
            CPT_MDG1_FlatView.IoSigDioInp_SwSStellantisParam
            CPT_MDG1_FlatView.IoSigDioOutp_SwSStellantisParam
            CPT_MDG1_FlatView.IoSigHbrdg_SwSStellantisParam
            CPT_MDG1_FlatView.IoSigIfAdapt_SwSStellantis
            CPT_MDG1_FlatView.IoSigPwmInp_SwSStellantisParm
            CPT_MDG1_FlatView.IoSigPwmOutp_SwSStellantisParm
            CPT_MDG1_FlatView.IoSigPwr_SwSStellantis
            CPT_MDG1_FlatView.IonSnsCoilRatly
            CPT_MDG1_FlatView.KnDet_SwSStellantis
            CPT_MDG1_FlatView.KnkIntenEstimr
            CPT_MDG1_FlatView.KnkLspiReactn
            CPT_MDG1_FlatView.KnkReactn
            CPT_MDG1_FlatView.KnkSnsr
            CPT_MDG1_FlatView.KnkSnsrCircDiag
            CPT_MDG1_FlatView.KnkSnsrRatly
            CPT_MDG1_FlatView.KnkSnsrRatlyPrm
            CPT_MDG1_FlatView.LTLSysCoorr
            CPT_MDG1_FlatView.LoPFuPmpActrCtrl
            CPT_MDG1_FlatView.LoPFuSnsrAdcInpSwc
            CPT_MDG1_FlatView.LoPresFuPmpRlyDigOutp
            CPT_MDG1_FlatView.LoTCooltElecPmpRatly
            CPT_MDG1_FlatView.LoTRadrCooltTEstimr
            CPT_MDG1_FlatView.LoTRadrCooltTSnsr
            CPT_MDG1_FlatView.LoTRadrTSnsrAdcInpSwc
            CPT_MDG1_FlatView.LoUElecPhysCoorr
            CPT_MDG1_FlatView.LoUElecSysCoorr
            CPT_MDG1_FlatView.LoUElecSysEstimr
            CPT_MDG1_FlatView.LoUElecSysSnsr
            CPT_MDG1_FlatView.LubCtrlSysCoorr
            CPT_MDG1_FlatView.Lvl1SysSftyReactn
            CPT_MDG1_FlatView.Lvl2Data
            CPT_MDG1_FlatView.Lvl2DataIdMngt
            CPT_MDG1_FlatView.Lvl2SysSftyAPI
            CPT_MDG1_FlatView.LvlInin
            CPT_MDG1_FlatView.LvlRstFlg
            CPT_MDG1_FlatView.MAF_Hum_Snsr
            CPT_MDG1_FlatView.MAirFlowEstimr
            CPT_MDG1_FlatView.MFVlv_SwSStellantis
            CPT_MDG1_FlatView.MafAndHumSnsr
            CPT_MDG1_FlatView.MaiRly
            CPT_MDG1_FlatView.MaiRlyDigOutp
            CPT_MDG1_FlatView.MakeUpAirVlvDigOutp
            CPT_MDG1_FlatView.MisfDetn
            CPT_MDG1_FlatView.MisfDetnPrm
            CPT_MDG1_FlatView.MnfldAirPAdcInpSwc
            CPT_MDG1_FlatView.MnfldGasTAdcInpSwc
            CPT_MDG1_FlatView.MnfldPPredEstimr
            CPT_MDG1_FlatView.NVLD_SwDigInp
            CPT_MDG1_FlatView.O2Snsr_SwSStellantis
            CPT_MDG1_FlatView.OBD_PurgVentVlvDigOutp
            CPT_MDG1_FlatView.ObdStopStrtRespMgr
            CPT_MDG1_FlatView.OilLvlSnsrPwmInp
            CPT_MDG1_FlatView.OilPSnsrAdcInpSwc
            CPT_MDG1_FlatView.OilShutOffValveFbAdcInp
            CPT_MDG1_FlatView.OilShutOffVlvDigOutp
            CPT_MDG1_FlatView.OilTSnsrAdcInpSwc
            CPT_MDG1_FlatView.OptmPrpnSysRatDetrmn
            CPT_MDG1_FlatView.OxSnsrHeatrActtn
            CPT_MDG1_FlatView.OxSnsrHeatrRatly
            CPT_MDG1_FlatView.PFIFuRailPressAdcInp
            CPT_MDG1_FlatView.PFIFuRailTempAdcInp
            CPT_MDG1_FlatView.PSnsrCohEstimr
            CPT_MDG1_FlatView.ParkNeutSwtRatly
            CPT_MDG1_FlatView.PcvEngLineRatly
            CPT_MDG1_FlatView.PcvFrshAirLineRatly
            CPT_MDG1_FlatView.PedlValSnsr1AdcInpSwc
            CPT_MDG1_FlatView.PedlValSnsr2AdcInpSwc
            CPT_MDG1_FlatView.PedlValSnsr2AuxAdcInpSwc
            CPT_MDG1_FlatView.PhiCtrlr
            CPT_MDG1_FlatView.PhiCtrlrPrm
            CPT_MDG1_FlatView.PhyConPrm
            CPT_MDG1_FlatView.PredVlvMtnEstimr
            CPT_MDG1_FlatView.PresTankRefuCtrl
            CPT_MDG1_FlatView.PrimAltCtrl
            CPT_MDG1_FlatView.PrimLinAltCtrl
            CPT_MDG1_FlatView.PrimLinAltRatly
            CPT_MDG1_FlatView.PtHmiDisp
            CPT_MDG1_FlatView.PtLashCtrl
            CPT_MDG1_FlatView.PtoCtrl
            CPT_MDG1_FlatView.PurgEstimr
            CPT_MDG1_FlatView.PurgFlowPhysCoorr
            CPT_MDG1_FlatView.PurgSoln2PwmOutp
            CPT_MDG1_FlatView.PurgSolnPwmOutp
            CPT_MDG1_FlatView.PurgVlvActrCtrl
            CPT_MDG1_FlatView.PwrSplitOptimn
            CPT_MDG1_FlatView.PwrSplyDiagc
            CPT_MDG1_FlatView.RadrFanCtrl
            CPT_MDG1_FlatView.RadrFanCtrlPwmPwmOutp
            CPT_MDG1_FlatView.RadrFanRlyHiSpdDigOutp
            CPT_MDG1_FlatView.ReAxleTempSnsrAdcInp
            CPT_MDG1_FlatView.RoadLoadEstimr
            CPT_MDG1_FlatView.RoughRoadEstimr
            CPT_MDG1_FlatView.RunOutOfGas
            CPT_MDG1_FlatView.SeatBltRatly
            CPT_MDG1_FlatView.SecdAirPmpRlyDigOutp
            CPT_MDG1_FlatView.SecdAirShutOffSoln1DigOutp
            CPT_MDG1_FlatView.SecdLinAltCtrl
            CPT_MDG1_FlatView.SentStack_SwSStellantisParm
            CPT_MDG1_FlatView.ShiftrPosnEstimr
            CPT_MDG1_FlatView.ShoRunrVlvActrCtrl
            CPT_MDG1_FlatView.ShoRunrVlvRatly
            CPT_MDG1_FlatView.ShoRunrVlvSysCoorr
            CPT_MDG1_FlatView.ShutDwnTmrRatly
            CPT_MDG1_FlatView.SrgSoln1DigOutp
            CPT_MDG1_FlatView.SrgSoln2DigOutp
            CPT_MDG1_FlatView.SteerAgRatly
            CPT_MDG1_FlatView.StrtrMotActtn
            CPT_MDG1_FlatView.StrtrMotRlyRatly
            CPT_MDG1_FlatView.StrtrRlyDigOutp
            CPT_MDG1_FlatView.StrtrRlyFbDigInp
            CPT_MDG1_FlatView.SurgeVlvRatly
            CPT_MDG1_FlatView.SwilEngMnt1DigOutp
            CPT_MDG1_FlatView.SwilEngMnt2DigOutp
            CPT_MDG1_FlatView.SwtgOxSnsr
            CPT_MDG1_FlatView.SwtgOxSnsrDiag
            CPT_MDG1_FlatView.SwtgOxSnsrPrm
            CPT_MDG1_FlatView.SysSftyComAb
            CPT_MDG1_FlatView.SysSftyComAbAGSM
            CPT_MDG1_FlatView.SysSftyComAbBCM
            CPT_MDG1_FlatView.SysSftyComAbBSM
            CPT_MDG1_FlatView.SysSftyComAbBSM_Prm
            CPT_MDG1_FlatView.SysSftyComAbCADM
            CPT_MDG1_FlatView.SysSftyComAbDPDM
            CPT_MDG1_FlatView.SysSftyComAbDTCM
            CPT_MDG1_FlatView.SysSftyComAbORC
            CPT_MDG1_FlatView.SysSftyComAbTCM
            CPT_MDG1_FlatView.SysSftyComAbTRSCM
            CPT_MDG1_FlatView.SysSftyComAbVDCM
            CPT_MDG1_FlatView.SysSftyComAbVDCM_Prm
            CPT_MDG1_FlatView.SysSftyComAbVSIM
            CPT_MDG1_FlatView.SysU12VoltAdcInpSwc
            CPT_MDG1_FlatView.TAFSysCoorr
            CPT_MDG1_FlatView.TOH_ShutOffVlvDigOutp
            CPT_MDG1_FlatView.TSnsrRatly
            CPT_MDG1_FlatView.ThRatly
            CPT_MDG1_FlatView.ThermAxleTSnsr
            CPT_MDG1_FlatView.ThermPhysCoorr
            CPT_MDG1_FlatView.ThermStEstimr
            CPT_MDG1_FlatView.ThrActrCtrl
            CPT_MDG1_FlatView.ThrActrCtrlDiag
            CPT_MDG1_FlatView.ThrInletAirPEstimr
            CPT_MDG1_FlatView.ThrInletAirPSnsr
            CPT_MDG1_FlatView.ThrInletAirTEstimr
            CPT_MDG1_FlatView.ThrInletAirTSnsr
            CPT_MDG1_FlatView.ThrIntkGasTAdcInpSwc
            CPT_MDG1_FlatView.ThrIntkPAdcInpSwc
            CPT_MDG1_FlatView.ThrMgr
            CPT_MDG1_FlatView.ThrPosnEstimr
            CPT_MDG1_FlatView.ThrPosnSnsr
            CPT_MDG1_FlatView.ThrPosnSnsr1AdcInpSwc
            CPT_MDG1_FlatView.ThrPosnSnsr2AdcInpSwc
            CPT_MDG1_FlatView.TrbChrgActrCtrl
            CPT_MDG1_FlatView.TrboChrgrMgr
            CPT_MDG1_FlatView.TrboPurgBypVlvDiag
            CPT_MDG1_FlatView.TrsmEstimr
            CPT_MDG1_FlatView.TrsmOilTEstimr
            CPT_MDG1_FlatView.TrsmTqDetrmn
            CPT_MDG1_FlatView.VGTR
            CPT_MDG1_FlatView.VapBlkgVlv
            CPT_MDG1_FlatView.VapBlockingVlvDigOutp
            CPT_MDG1_FlatView.VarGeomTrbFb
            CPT_MDG1_FlatView.VarOilSolnPwmOutp
            CPT_MDG1_FlatView.VarSpdFuPmpRatly
            CPT_MDG1_FlatView.VehCfgPrm
            CPT_MDG1_FlatView.VehFReqArbn
            CPT_MDG1_FlatView.VehOdomEstimr
            CPT_MDG1_FlatView.VehSecrmtCtrl
            CPT_MDG1_FlatView.VehSpdCtrl
            CPT_MDG1_FlatView.VehSpdCtrlPrm
            CPT_MDG1_FlatView.VehSpdEstimr
            CPT_MDG1_FlatView.VehSpdSnsrRatly
            CPT_MDG1_FlatView.VlvMtnAdpn
            CPT_MDG1_FlatView.VvaActrCtrl
            CPT_MDG1_FlatView.VvtActrCtrl
            CPT_MDG1_FlatView.VvtActrCtrlDiag
            CPT_MDG1_FlatView.VvtExh1PwmOutp
            CPT_MDG1_FlatView.VvtIntk1PwmOutp
            CPT_MDG1_FlatView.VvtRatly
            CPT_MDG1_FlatView.WgPosn1AdcInpSwc
            CPT_MDG1_FlatView.WgPosn2AdcInpSwc
            CPT_MDG1_FlatView.WgPosnEstimr
            CPT_MDG1_FlatView.WgPosnSnsr
            CPT_MDG1_FlatView.WgRatly
            CPT_MDG1_FlatView.WgSolnPwmOutp
            CPT_MDG1_FlatView.WhlSpdRatly
        swc to ecu mapping SwcToEcuMapping_MSR2AR: ecu-instance=MDG1
          component:
            CPT_MDG1_FlatView.CPT_ATS_Std
            CPT_MDG1_FlatView.CPT_AVS_Std
            CPT_MDG1_FlatView.CPT_BGTHDEV
            CPT_MDG1_FlatView.CPT_CDShdG_GTMLib
            CPT_MDG1_FlatView.CPT_CoEng_ObdSig
            CPT_MDG1_FlatView.CPT_CoEng_StAdpr
            CPT_MDG1_FlatView.CPT_CoEng_StEng
            CPT_MDG1_FlatView.CPT_ComCo_Lyr
            CPT_MDG1_FlatView.CPT_ComPtc
            CPT_MDG1_FlatView.CPT_ComScl_Appl
            CPT_MDG1_FlatView.CPT_DEVE
            CPT_MDG1_FlatView.CPT_DSM_Conf
            CPT_MDG1_FlatView.CPT_DcmDspUDS_DID
            CPT_MDG1_FlatView.CPT_DcmDspUDS_SecA
            CPT_MDG1_FlatView.CPT_Dem_Main
            CPT_MDG1_FlatView.CPT_DevLib_PwrStgState
            CPT_MDG1_FlatView.CPT_EGSHeatr_Acttn
            CPT_MDG1_FlatView.CPT_EGSHeatr_Ctrl
            CPT_MDG1_FlatView.CPT_EGSHeatr_DiagPrfmnc
            CPT_MDG1_FlatView.CPT_EGSHeatr_DiagWire
            CPT_MDG1_FlatView.CPT_EGSHeatr_SnsrCoorn
            CPT_MDG1_FlatView.CPT_EGSHeatr_SnsrTMdl
            CPT_MDG1_FlatView.CPT_EGSHeatr_TiHeatrOff
            CPT_MDG1_FlatView.CPT_ETC_Std
            CPT_MDG1_FlatView.CPT_EngDa_PwrEng
            CPT_MDG1_FlatView.CPT_EnvP_DD
            CPT_MDG1_FlatView.CPT_EnvP_VDDiag
            CPT_MDG1_FlatView.CPT_EpmBCr_IntrCo
            CPT_MDG1_FlatView.CPT_EpmBCr_Pos
            CPT_MDG1_FlatView.CPT_EpmCaS_Adap
            CPT_MDG1_FlatView.CPT_EpmCaS_Diag
            CPT_MDG1_FlatView.CPT_EpmCaS_Meas
            CPT_MDG1_FlatView.CPT_EpmCaS_OfsDiag
            CPT_MDG1_FlatView.CPT_EpmCaS_RelsSigEvln
            CPT_MDG1_FlatView.CPT_EpmCaS_Seg
            CPT_MDG1_FlatView.CPT_EpmCaS_Spd
            CPT_MDG1_FlatView.CPT_EpmCaS_SyncnPatTi
            CPT_MDG1_FlatView.CPT_EpmCrS_Diag
            CPT_MDG1_FlatView.CPT_EpmCrS_RevCnt
            CPT_MDG1_FlatView.CPT_EpmCrS_Seg
            CPT_MDG1_FlatView.CPT_EpmCrS_Spd
            CPT_MDG1_FlatView.CPT_EpmErr_Trace
            CPT_MDG1_FlatView.CPT_EpmHAgClk_Gen
            CPT_MDG1_FlatView.CPT_EpmHCaS_SigEval
            CPT_MDG1_FlatView.CPT_EpmHCrS_IntHndlr
            CPT_MDG1_FlatView.CPT_EpmIf_Imprt
            CPT_MDG1_FlatView.CPT_EpmRRS_AgDetect
            CPT_MDG1_FlatView.CPT_EpmRRS_StopDetect
            CPT_MDG1_FlatView.CPT_EpmSeq_EveHndlr
            CPT_MDG1_FlatView.CPT_EpmSeq_StateMn
            CPT_MDG1_FlatView.CPT_EpmSrv_Lib
            CPT_MDG1_FlatView.CPT_EpmSyn_CaSPos
            CPT_MDG1_FlatView.CPT_EpmSyn_CrSPos
            CPT_MDG1_FlatView.CPT_EpmTDC_Corrn
            CPT_MDG1_FlatView.CPT_Epm_CustAdp
            CPT_MDG1_FlatView.CPT_Epm_Ini
            CPT_MDG1_FlatView.CPT_Epm_OpMode
            CPT_MDG1_FlatView.CPT_Epm_Spd
            CPT_MDG1_FlatView.CPT_Epm_SpdFeat
            CPT_MDG1_FlatView.CPT_Epm_SpdGrd
            CPT_MDG1_FlatView.CPT_FEL_EvapSysIfAdp
            CPT_MDG1_FlatView.CPT_GlbDaAdapt_Adapt
            CPT_MDG1_FlatView.CPT_GlbDa_ECUOnTime
            CPT_MDG1_FlatView.CPT_HEGO_Htg
            CPT_MDG1_FlatView.CPT_HEGO_OBDElec
            CPT_MDG1_FlatView.CPT_HEGO_Sens
            CPT_MDG1_FlatView.CPT_IVGdiCtl_CvoAdpn
            CPT_MDG1_FlatView.CPT_IVGdiCtl_CvoCsersPlausyDiag
            CPT_MDG1_FlatView.CPT_IVGdiCtl_CvoDiag
            CPT_MDG1_FlatView.CPT_IVGdiCtl_CvoSigAcq
            CPT_MDG1_FlatView.CPT_IVGdiCtl_CvoSigEvln
            CPT_MDG1_FlatView.CPT_IVGdiCtl_CvoSimnErr
            CPT_MDG1_FlatView.CPT_IgCPrimI_AcqnAdc
            CPT_MDG1_FlatView.CPT_IgnClPs_Dia
            CPT_MDG1_FlatView.CPT_IgnCoilDiagCoorn
            CPT_MDG1_FlatView.CPT_IgnDD_Calcn
            CPT_MDG1_FlatView.CPT_IgnDD_ModCtrlr
            CPT_MDG1_FlatView.CPT_InjDDGdi
            CPT_MDG1_FlatView.CPT_InjDDPfi
            CPT_MDG1_FlatView.CPT_InjSyG_AdpnCdnCvo
            CPT_MDG1_FlatView.CPT_InjSyG_CalcCnvnFac
            CPT_MDG1_FlatView.CPT_InjSyG_CoCvo
            CPT_MDG1_FlatView.CPT_InjSyG_DdIf
            CPT_MDG1_FlatView.CPT_InjSyG_InjTi
            CPT_MDG1_FlatView.CPT_InjSyG_InjTmngAdpr
            CPT_MDG1_FlatView.CPT_InjSyG_SpCvo
            CPT_MDG1_FlatView.CPT_InjVlvPs_ConCJ
            CPT_MDG1_FlatView.CPT_InjVlvPs_Dia
            CPT_MDG1_FlatView.CPT_IoSigSwAdpr_SwSStellantis
            CPT_MDG1_FlatView.CPT_KONCW
            CPT_MDG1_FlatView.CPT_KnDetControl
            CPT_MDG1_FlatView.CPT_KnDetLTest
            CPT_MDG1_FlatView.CPT_KnDetSigEval
            CPT_MDG1_FlatView.CPT_MRly_Vld2Lcy
            CPT_MDG1_FlatView.CPT_MfDD
            CPT_MDG1_FlatView.CPT_MfPsDia
            CPT_MDG1_FlatView.CPT_MfPs_ConCY
            CPT_MDG1_FlatView.CPT_MoCCom_Co
            CPT_MDG1_FlatView.CPT_MoCSOP_Co
            CPT_MDG1_FlatView.CPT_OilCmbdSen_DD
            CPT_MDG1_FlatView.CPT_Reset_CallBack
            CPT_MDG1_FlatView.CPT_SWAdp
            CPT_MDG1_FlatView.CPT_SYNTIZW
            CPT_MDG1_FlatView.CPT_SrvB
            CPT_MDG1_FlatView.CPT_SyC_Vld2Lcy
            CPT_MDG1_FlatView.CPT_T15_Vld2Lcy
            CPT_MDG1_FlatView.CPT_UEGO_Dac
            CPT_MDG1_FlatView.CPT_UEGO_DiagRels
            CPT_MDG1_FlatView.CPT_UEGO_DiagSigEcuAsic
            CPT_MDG1_FlatView.CPT_UEGO_DiagSigOperPlaus
            CPT_MDG1_FlatView.CPT_UEGO_DiagSigSnsr
            CPT_MDG1_FlatView.CPT_UEGO_DiagSigWireOl
            CPT_MDG1_FlatView.CPT_UEGO_DiagSigWireSc
            CPT_MDG1_FlatView.CPT_UEGO_ICntct
            CPT_MDG1_FlatView.CPT_UEGO_IPmpPck
            CPT_MDG1_FlatView.CPT_UEGO_IPmpRef
            CPT_MDG1_FlatView.CPT_UEGO_IPmpSeg
            CPT_MDG1_FlatView.CPT_UEGO_ISrc
            CPT_MDG1_FlatView.CPT_UEGO_ModCtrl
            CPT_MDG1_FlatView.CPT_UEGO_O2
            CPT_MDG1_FlatView.CPT_UEGO_O2Ref
            CPT_MDG1_FlatView.CPT_UEGO_OperRels
            CPT_MDG1_FlatView.CPT_UEGO_OperRelsExtInhb
            CPT_MDG1_FlatView.CPT_UEGO_RCmp
            CPT_MDG1_FlatView.CPT_UEGO_RNernst
            CPT_MDG1_FlatView.CPT_UEGO_RPmp
            CPT_MDG1_FlatView.CPT_UEGO_TCeramic
            CPT_MDG1_FlatView.CPT_UEGO_Tstr
            CPT_MDG1_FlatView.CPT_UEGO_UNernst
            CPT_MDG1_FlatView.CPT_UEGO_UPmp
            CPT_MDG1_FlatView.CPT_XcpAppl
            CPT_MDG1_FlatView.CPT_dcmcore_dsldsd_appl
            CPT_MDG1_FlatView.CPT_rba_EepAdaptDGS
            CPT_MDG1_FlatView.CPT_rba_MemDiag
            CPT_MDG1_FlatView.CPT_rba_OsArSchedExtn_mcop
            CPT_MDG1_FlatView.CPT_rba_Svbb
    root-software-compositions:
      root sw composition prototype CPT_MDG1_FlatView: flat-map=MDG1_FlatMap, software-composition=MDG1_FlatView
