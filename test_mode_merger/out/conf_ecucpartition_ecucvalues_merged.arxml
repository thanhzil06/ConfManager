AUTOSAR XML (schema 4-3-0)
package /RB/UBK/Project/EcucModuleConfigurationValuess
  module config EcuC
    EcucPartitionCollection
      18 x EcucPartition:
        EcucPartition_OsApp_0_A_1: EcucPartitionBswModuleExecution=false, PartitionCanBeRestarted=false, EcucPartitionSoftwareComponentInstanceRef=CPT_rba_OsArSchedExtn_OS, EcucPartitionSoftwareComponentInstanceRef=CPT_esc_stack, EcucPartitionSoftwareComponentInstanceRef=CPT_rba_OsArSchedExtn_mcop
        EcucPartition_OsApp_{1..3}_A_1: EcucPartitionBswModuleExecution=false, PartitionCanBeRestarted=false
        EcucPartition_OsApp_0_B_1: EcucPartitionBswModuleExecution=false, PartitionCanBeRestarted=false
        EcucPartition_OsApp_1_B_1: EcucPartitionBswModuleExecution=false, PartitionCanBeRestarted=false, EcucPartitionSoftwareComponentInstanceRef=CPT_ComScl_NetMtrxTxAdapt
        EcucPartition_OsApp_1_Q_1: EcucPartitionBswModuleExecution=false, PartitionCanBeRestarted=false, EcucPartitionSoftwareComponentInstanceRef=CPT_NvM, EcucPartitionSoftwareComponentInstanceRef=CPT_rba_IoSigIcu, EcucPartitionSoftwareComponentInstanceRef=CPT_EcuM, EcucPartitionSoftwareComponentInstanceRef=CPT_Dem, EcucPartitionSoftwareComponentInstanceRef=CPT_rba_IoDiagHbr, EcucPartitionSoftwareComponentInstanceRef=CPT_ComDia_Dcm_Rte_Adapter, EcucPartitionSoftwareComponentInstanceRef=CPT_WdgM, EcucPartitionSoftwareComponentInstanceRef=CPT_rba_IoSigAdc, EcucPartitionSoftwareComponentInstanceRef=CPT_rba_IoSigRtc, EcucPartitionSoftwareComponentInstanceRef=CPT_rba_IoDiagPwr, EcucPartitionSoftwareComponentInstanceRef=, EcucPartitionSoftwareComponentInstanceRef=CPT_rba_SyC_States, EcucPartitionSoftwareComponentInstanceRef=CPT_FiM, EcucPartitionSoftwareComponentInstanceRef=CPT_rba_IoSigDio, EcucPartitionSoftwareComponentInstanceRef=CPT_rba_IoSigPwr, EcucPartitionSoftwareComponentInstanceRef=CPT_Dcm, EcucPartitionSoftwareComponentInstanceRef=CPT_BswM, EcucPartitionSoftwareComponentInstanceRef=CPT_rba_IoSigObs, EcucPartitionSoftwareComponentInstanceRef=CPT_rba_IoDiagPs, EcucPartitionSoftwareComponentInstanceRef=CPT_rba_IoSigPwm, EcucPartitionSoftwareComponentInstanceRef=CPT_Det, EcucPartitionSoftwareComponentInstanceRef=CPT_ComM, EcucPartitionSoftwareComponentInstanceRef=CPT_Csm, EcucPartitionSoftwareComponentInstanceRef=CPT_SecOC, EcucPartitionSoftwareComponentInstanceRef=CPT_rba_IoSigHlfBr, EcucPartitionSoftwareComponentInstanceRef=CPT_rba_IoDiagHlfBr, EcucPartitionSoftwareComponentInstanceRef=CPT_rba_DiagLib, EcucPartitionSoftwareComponentInstanceRef=CPT_KeyM, EcucPartitionSoftwareComponentInstanceRef=CPT_ComCIL_Adapt, EcucPartitionSoftwareComponentInstanceRef=CPT_ComScl_NetMtrxTxAdapt, EcucPartitionSoftwareComponentInstanceRef=CPT_ComScl_NetMtrx2TxAdapt, EcucPartitionSoftwareComponentInstanceRef=CPT_ComScl_NetMtrx3TxAdapt, EcucPartitionSoftwareComponentInstanceRef=CPT_ComScl_EngLinTxAdapt, EcucPartitionSoftwareComponentInstanceRef=CPT_ComScl_EngLin, EcucPartitionSoftwareComponentInstanceRef=CPT_ComScl_NetMtrx2, EcucPartitionSoftwareComponentInstanceRef=CPT_ComScl_NetMtrx3, EcucPartitionSoftwareComponentInstanceRef=CPT_ComScl_NetMtrx, EcucPartitionSoftwareComponentInstanceRef=CPT_IoSigAdc_SwSStellantisParm, EcucPartitionSoftwareComponentInstanceRef=IoSigAdc_SwSStellantisParm, EcucPartitionSoftwareComponentInstanceRef=CPT_IoSigPwmOutp_SwSStellantisParm, EcucPartitionSoftwareComponentInstanceRef=CPT_IoSigPwmInp_SwSStellantisParm, EcucPartitionSoftwareComponentInstanceRef=CPT_IoSigDioInp_SwSStellantisParam, EcucPartitionSoftwareComponentInstanceRef=CPT_SentStack_SwSStellantisParm, EcucPartitionSoftwareComponentInstanceRef=CPT_IoSigDioOutp_SwSStellantisParam, EcucPartitionSoftwareComponentInstanceRef=EGRCoolr_DeltAbsPresSnsr, EcucPartitionSoftwareComponentInstanceRef=DP_VlvPosnSns, EcucPartitionSoftwareComponentInstanceRef=IoSigDioInp_SwSStellantisParam, EcucPartitionSoftwareComponentInstanceRef=IoSigAdc_SwSStellantisParm, EcucPartitionSoftwareComponentInstanceRef=SentStack_SwSStellantisParm, EcucPartitionSoftwareComponentInstanceRef=IoSigHbrdg_SwSStellantisParam, EcucPartitionSoftwareComponentInstanceRef=IoSigPwmOutp_SwSStellantisParm, EcucPartitionSoftwareComponentInstanceRef=IoSigDioOutp_SwSStellantisParam, EcucPartitionSoftwareComponentInstanceRef=Epm_SwSStellantis_PSwc, EcucPartitionSoftwareComponentInstanceRef=IoSigPwmInp_SwSStellantisParm, EcucPartitionSoftwareComponentInstanceRef=MAF_Hum_Snsr, EcucPartitionSoftwareComponentInstanceRef=SysSftyComAbVDCM_Prm, EcucPartitionSoftwareComponentInstanceRef=SysSftyComAbBSM_Prm, EcucPartitionSoftwareComponentInstanceRef=MisfDetnPrm, EcucPartitionSoftwareComponentInstanceRef=PhyConPrm, EcucPartitionSoftwareComponentInstanceRef=AftmntPhysCoorrPrm, EcucPartitionSoftwareComponentInstanceRef=SwtgOxSnsrPrm, EcucPartitionSoftwareComponentInstanceRef=ActrSyncnCoorrPrm, EcucPartitionSoftwareComponentInstanceRef=PhiCtrlrPrm, EcucPartitionSoftwareComponentInstanceRef=CatTEstimrPrm, EcucPartitionSoftwareComponentInstanceRef=VehSpdCtrlPrm, EcucPartitionSoftwareComponentInstanceRef=GasXchgPrm, EcucPartitionSoftwareComponentInstanceRef=GasFlowPrm, EcucPartitionSoftwareComponentInstanceRef=CrsSwtEstimrPrm, EcucPartitionSoftwareComponentInstanceRef=VehCfgPrm, EcucPartitionSoftwareComponentInstanceRef=EGRMonrAndPosnSnsrDiagcPrm, EcucPartitionSoftwareComponentInstanceRef=CylPhiTarPrm, EcucPartitionSoftwareComponentInstanceRef=BrkSysRatlyPrm, EcucPartitionSoftwareComponentInstanceRef=KnkSnsrRatlyPrm, EcucPartitionSoftwareComponentInstanceRef=ColdStrtDynCrksftFuCtrlDiagcPrm, EcucPartitionSoftwareComponentInstanceRef=EngMeclPptyPrm, EcucPartitionSoftwareComponentInstanceRef=FuPptyEstimrPrm
        EcucPartition_OsApp_2_Q_1: EcucPartitionBswModuleExecution=0, PartitionCanBeRestarted=false, EcucPartitionSoftwareComponentInstanceRef=ShoRunrVlvActrCtrl, EcucPartitionSoftwareComponentInstanceRef=CPT_EGSHeatr_SnsrCoorn, EcucPartitionSoftwareComponentInstanceRef=FiveVoltOutpAdcInpSwc, EcucPartitionSoftwareComponentInstanceRef=SysSftyComAbORC, EcucPartitionSoftwareComponentInstanceRef=CPT_XcpAppl, EcucPartitionSoftwareComponentInstanceRef=GdiFuRailP1AdcInpSwc, EcucPartitionSoftwareComponentInstanceRef=HoodAjarAdcInpSwc, EcucPartitionSoftwareComponentInstanceRef=PedlValSnsr2AuxAdcInpSwc, EcucPartitionSoftwareComponentInstanceRef=SysSftyComAb, EcucPartitionSoftwareComponentInstanceRef=CPT_ComScl_EngLinTxAdapt, EcucPartitionSoftwareComponentInstanceRef=OxSnsrHeatrActtn, EcucPartitionSoftwareComponentInstanceRef=VehSpdCtrl, EcucPartitionSoftwareComponentInstanceRef=AirCdngPSnsrAdcInpSwc, EcucPartitionSoftwareComponentInstanceRef=PedlValSnsr1AdcInpSwc, EcucPartitionSoftwareComponentInstanceRef=CPT_FiM, EcucPartitionSoftwareComponentInstanceRef=EgrVlvDeltaPEstimr, EcucPartitionSoftwareComponentInstanceRef=Lvl2SysSftyAPI, EcucPartitionSoftwareComponentInstanceRef=CPT_rba_OsArSchedExtn_OS, EcucPartitionSoftwareComponentInstanceRef=CalInp1AdcInpSwc, EcucPartitionSoftwareComponentInstanceRef=CPT_Dem, EcucPartitionSoftwareComponentInstanceRef=CmprInletPEstimr, EcucPartitionSoftwareComponentInstanceRef=CPT_InjVlvPs_Dia, EcucPartitionSoftwareComponentInstanceRef=CPT_EGSHeatr_DiagPrfmnc, EcucPartitionSoftwareComponentInstanceRef=EngSwtBattAdcInpSwc, EcucPartitionSoftwareComponentInstanceRef=OilPSnsrAdcInpSwc, EcucPartitionSoftwareComponentInstanceRef=CPT_ComDia_Dcm_Rte_Adapter, EcucPartitionSoftwareComponentInstanceRef=FiveVoltSnsAdcInpSwc, EcucPartitionSoftwareComponentInstanceRef=CPT_rba_Svbb, EcucPartitionSoftwareComponentInstanceRef=GasFlowActrLimn, EcucPartitionSoftwareComponentInstanceRef=CPT_DevLib_PwrStgState, EcucPartitionSoftwareComponentInstanceRef=Coolt3WayVlvAdcInpSwc, EcucPartitionSoftwareComponentInstanceRef=IgnSwtStEstimr, EcucPartitionSoftwareComponentInstanceRef=EgrVlvPosnSnsr, EcucPartitionSoftwareComponentInstanceRef=EGRMonrAndPosnSnsrDiagc, EcucPartitionSoftwareComponentInstanceRef=EgrVlvDeltaPSnsr, EcucPartitionSoftwareComponentInstanceRef=CPT_EpmHCrS_IntHndlr, EcucPartitionSoftwareComponentInstanceRef=ExtEgrSysCoorr, EcucPartitionSoftwareComponentInstanceRef=MnfldAirPAdcInpSwc, EcucPartitionSoftwareComponentInstanceRef=CPT_ETC_Std, EcucPartitionSoftwareComponentInstanceRef=PtHmiDisp, EcucPartitionSoftwareComponentInstanceRef=ThrPosnSnsr1AdcInpSwc, EcucPartitionSoftwareComponentInstanceRef=CPT_HEGO_Sens, EcucPartitionSoftwareComponentInstanceRef=CPT_GlbDaAdapt_Adapt, EcucPartitionSoftwareComponentInstanceRef=ETDR, EcucPartitionSoftwareComponentInstanceRef=SysSftyComAbBSM, EcucPartitionSoftwareComponentInstanceRef=VehSecrmtCtrl, EcucPartitionSoftwareComponentInstanceRef=PrimLinAltCtrl, EcucPartitionSoftwareComponentInstanceRef=CPT_EpmCrS_Diag, EcucPartitionSoftwareComponentInstanceRef=CluSnsAdcInp, EcucPartitionSoftwareComponentInstanceRef=CPT_IgnClPs_Dia, EcucPartitionSoftwareComponentInstanceRef=EngOilDilEstimr, EcucPartitionSoftwareComponentInstanceRef=CPT_Epm_CustAdp, EcucPartitionSoftwareComponentInstanceRef=CPT_UEGO_DiagSigOperPlaus, EcucPartitionSoftwareComponentInstanceRef=ShiftrPosnEstimr, EcucPartitionSoftwareComponentInstanceRef=ElecVvtPosn, EcucPartitionSoftwareComponentInstanceRef=CPT_EpmCaS_OfsDiag, EcucPartitionSoftwareComponentInstanceRef=AccrPedlMpg, EcucPartitionSoftwareComponentInstanceRef=LvlRstFlg, EcucPartitionSoftwareComponentInstanceRef=CPT_rba_EepAdaptDGS, EcucPartitionSoftwareComponentInstanceRef=IntkPhysCoorr, EcucPartitionSoftwareComponentInstanceRef=PFIFuRailTempAdcInp, EcucPartitionSoftwareComponentInstanceRef=CPT_IgCPrimI_AcqnAdc, EcucPartitionSoftwareComponentInstanceRef=CPT_InjSyG_InjTi, EcucPartitionSoftwareComponentInstanceRef=CPT_EpmCaS_RelsSigEvln, EcucPartitionSoftwareComponentInstanceRef=CPT_BGTHDEV, EcucPartitionSoftwareComponentInstanceRef=CrkBattMonrAdcInpSwc, EcucPartitionSoftwareComponentInstanceRef=CPT_DEVE, EcucPartitionSoftwareComponentInstanceRef=CPT_rba_SyC_States_Cfg_2_Q_1, EcucPartitionSoftwareComponentInstanceRef=ThrPosnEstimr, EcucPartitionSoftwareComponentInstanceRef=SysSftyComAbTRSCM, EcucPartitionSoftwareComponentInstanceRef=VapBlkgVlv, EcucPartitionSoftwareComponentInstanceRef=PrimAltCtrl, EcucPartitionSoftwareComponentInstanceRef=CPT_esc_stack, EcucPartitionSoftwareComponentInstanceRef=CPT_EpmRRS_AgDetect, EcucPartitionSoftwareComponentInstanceRef=SysSftyComAbDTCM, EcucPartitionSoftwareComponentInstanceRef=OilTSnsrAdcInpSwc, EcucPartitionSoftwareComponentInstanceRef=BrkPdlPosnSnsrAdcInp, EcucPartitionSoftwareComponentInstanceRef=CPT_IVGdiCtl_CvoDiag, EcucPartitionSoftwareComponentInstanceRef=CPT_EGSHeatr_DiagWire, EcucPartitionSoftwareComponentInstanceRef=EngOilChgEstimr, EcucPartitionSoftwareComponentInstanceRef=WgPosn1AdcInpSwc, EcucPartitionSoftwareComponentInstanceRef=SecdLinAltCtrl, EcucPartitionSoftwareComponentInstanceRef=CPT_rbm_DSM_Conf, EcucPartitionSoftwareComponentInstanceRef=CPT_MfDD, EcucPartitionSoftwareComponentInstanceRef=CPT_OilCmbdSen_DD, EcucPartitionSoftwareComponentInstanceRef=CPT_EpmErr_Trace, EcucPartitionSoftwareComponentInstanceRef=SysSftyComAbTCM, EcucPartitionSoftwareComponentInstanceRef=CPT_Epm_Spd, EcucPartitionSoftwareComponentInstanceRef=GasXchgSysCoorr, EcucPartitionSoftwareComponentInstanceRef=MAirFlowEstimr, EcucPartitionSoftwareComponentInstanceRef=CPT_KnDetControl, EcucPartitionSoftwareComponentInstanceRef=SysSftyComAbDPDM, EcucPartitionSoftwareComponentInstanceRef=IntkAirTAdcInpSwc, EcucPartitionSoftwareComponentInstanceRef=ColdCrkCasePSnsrAdcInpSwc, EcucPartitionSoftwareComponentInstanceRef=WgPosnEstimr, EcucPartitionSoftwareComponentInstanceRef=ThrPosnSnsr2AdcInpSwc, EcucPartitionSoftwareComponentInstanceRef=LoTRadrTSnsrAdcInpSwc, EcucPartitionSoftwareComponentInstanceRef=CoolEgrTAdcInpSwc, EcucPartitionSoftwareComponentInstanceRef=EngOilPEstimr, EcucPartitionSoftwareComponentInstanceRef=EngSpdTarDetrmn, EcucPartitionSoftwareComponentInstanceRef=CrkTrainCpby, EcucPartitionSoftwareComponentInstanceRef=PresTankRefuCtrl, EcucPartitionSoftwareComponentInstanceRef=HiTRadrOutlTSnsrAdcInpSwc, EcucPartitionSoftwareComponentInstanceRef=MnfldGasTAdcInpSwc, EcucPartitionSoftwareComponentInstanceRef=EngOilPSnsr, EcucPartitionSoftwareComponentInstanceRef=EngTraDetn, EcucPartitionSoftwareComponentInstanceRef=CPT_SWAdp, EcucPartitionSoftwareComponentInstanceRef=CPT_EnvP_DD, EcucPartitionSoftwareComponentInstanceRef=CPT_HEGO_Htg, EcucPartitionSoftwareComponentInstanceRef=BoostTemp1AdcInpSwc, EcucPartitionSoftwareComponentInstanceRef=PedlValSnsr2AdcInpSwc, EcucPartitionSoftwareComponentInstanceRef=CalInp2AdcInpSwc, EcucPartitionSoftwareComponentInstanceRef=CPT_InjSyG_CoCvo, EcucPartitionSoftwareComponentInstanceRef=TrsmTqDetrmn, EcucPartitionSoftwareComponentInstanceRef=PFIFuRailPressAdcInp, EcucPartitionSoftwareComponentInstanceRef=LoUElecSysCoorr, EcucPartitionSoftwareComponentInstanceRef=InletPresVlvActrCtrl, EcucPartitionSoftwareComponentInstanceRef=CdsnMgr, EcucPartitionSoftwareComponentInstanceRef=VGTR, EcucPartitionSoftwareComponentInstanceRef=FuRailPEstimr, EcucPartitionSoftwareComponentInstanceRef=VehFReqArbn, EcucPartitionSoftwareComponentInstanceRef=CPT_MfPs_ConCY, EcucPartitionSoftwareComponentInstanceRef=OilShutOffValveFbAdcInp, EcucPartitionSoftwareComponentInstanceRef=MaiRly, EcucPartitionSoftwareComponentInstanceRef=EvapLkChkMonSnsAdcInpSwc, EcucPartitionSoftwareComponentInstanceRef=CPT_InjDDPfi, EcucPartitionSoftwareComponentInstanceRef=WgPosn2AdcInpSwc, EcucPartitionSoftwareComponentInstanceRef=ExtTqReq, EcucPartitionSoftwareComponentInstanceRef=EngCooltTAdcInpSwc, EcucPartitionSoftwareComponentInstanceRef=PurgEstimr, EcucPartitionSoftwareComponentInstanceRef=CPT_EGSHeatr_SnsrTMdl, EcucPartitionSoftwareComponentInstanceRef=FiveVoltAuxAdcInpSwc, EcucPartitionSoftwareComponentInstanceRef=VehSpdEstimr, EcucPartitionSoftwareComponentInstanceRef=LoUElecSysSnsr, EcucPartitionSoftwareComponentInstanceRef=LoPFuSnsrAdcInpSwc, EcucPartitionSoftwareComponentInstanceRef=BrkPedlEstimr, EcucPartitionSoftwareComponentInstanceRef=CPT_ATS_Std, EcucPartitionSoftwareComponentInstanceRef=SysSftyComAbVDCM, EcucPartitionSoftwareComponentInstanceRef=AccrPedlSnsr, EcucPartitionSoftwareComponentInstanceRef=MafAndHumSnsr, EcucPartitionSoftwareComponentInstanceRef=CPT_EGSHeatr_TiHeatrOff, EcucPartitionSoftwareComponentInstanceRef=ThrMgr, EcucPartitionSoftwareComponentInstanceRef=FuRailHeatrActr, EcucPartitionSoftwareComponentInstanceRef=BrkPedlSnsr, EcucPartitionSoftwareComponentInstanceRef=CPT_EnvP_VDDiag, EcucPartitionSoftwareComponentInstanceRef=CPT_IVGdiCtl_CvoCsersPlausyDiag, EcucPartitionSoftwareComponentInstanceRef=CrkcsFrshAirLinePEstimr, EcucPartitionSoftwareComponentInstanceRef=WgPosnSnsr, EcucPartitionSoftwareComponentInstanceRef=CPT_InjSyG_AdpnCdnCvo, EcucPartitionSoftwareComponentInstanceRef=RoadLoadEstimr, EcucPartitionSoftwareComponentInstanceRef=EepNVBlkSwcCmpstn, EcucPartitionSoftwareComponentInstanceRef=ExtEgrActrCtrl, EcucPartitionSoftwareComponentInstanceRef=EnvP_SwSStellantis, EcucPartitionSoftwareComponentInstanceRef=DrvAwayInhb, EcucPartitionSoftwareComponentInstanceRef=PurgFlowPhysCoorr, EcucPartitionSoftwareComponentInstanceRef=CPT_KnDetLTest, EcucPartitionSoftwareComponentInstanceRef=CPT_rba_MemDiag, EcucPartitionSoftwareComponentInstanceRef=CPT_HEGO_OBDElec, EcucPartitionSoftwareComponentInstanceRef=CrkcsFrshAirLinePSnsr, EcucPartitionSoftwareComponentInstanceRef=HybSprkPlgFoulgEstimr, EcucPartitionSoftwareComponentInstanceRef=AftmntSysPEstimr, EcucPartitionSoftwareComponentInstanceRef=HevEssIF, EcucPartitionSoftwareComponentInstanceRef=CPT_EpmIf_Imprt, EcucPartitionSoftwareComponentInstanceRef=SysSftyComAbVSIM, EcucPartitionSoftwareComponentInstanceRef=CPT_KONCW, EcucPartitionSoftwareComponentInstanceRef=SysSftyComAbAGSM, EcucPartitionSoftwareComponentInstanceRef=BaroPEstimr, EcucPartitionSoftwareComponentInstanceRef=CmprInletTempAdcInp, EcucPartitionSoftwareComponentInstanceRef=CPT_EpmCaS_Adap, EcucPartitionSoftwareComponentInstanceRef=CPT_GlbDa_ECUOnTime, EcucPartitionSoftwareComponentInstanceRef=VarGeomTrbFb, EcucPartitionSoftwareComponentInstanceRef=TrboChrgrMgr, EcucPartitionSoftwareComponentInstanceRef=EgrVlvPosnEstimr, EcucPartitionSoftwareComponentInstanceRef=ElecVacPmpCtrl, EcucPartitionSoftwareComponentInstanceRef=ReAxleTempSnsrAdcInp, EcucPartitionSoftwareComponentInstanceRef=CPT_EGSHeatr_Ctrl, EcucPartitionSoftwareComponentInstanceRef=BoostTemp2AdcInpSwc, EcucPartitionSoftwareComponentInstanceRef=ThrIntkGasTAdcInpSwc, EcucPartitionSoftwareComponentInstanceRef=CrsSwtEstimr, EcucPartitionSoftwareComponentInstanceRef=GdiFuRailP2AdcInpSwc, EcucPartitionSoftwareComponentInstanceRef=TrsmEstimr, EcucPartitionSoftwareComponentInstanceRef=CPT_UEGO_DiagSigSnsr, EcucPartitionSoftwareComponentInstanceRef=RoughRoadEstimr, EcucPartitionSoftwareComponentInstanceRef=CPT_MfPsDia, EcucPartitionSoftwareComponentInstanceRef=SysSftyComAbCADM, EcucPartitionSoftwareComponentInstanceRef=SysSftyComAbBCM, EcucPartitionSoftwareComponentInstanceRef=ThrIntkPAdcInpSwc, EcucPartitionSoftwareComponentInstanceRef=CPT_EpmCaS_Seg, EcucPartitionSoftwareComponentInstanceRef=MisfDetn, EcucPartitionSoftwareComponentInstanceRef=CPT_DSM_Conf, EcucPartitionSoftwareComponentInstanceRef=SysU12VoltAdcInpSwc, EcucPartitionSoftwareComponentInstanceRef=InjrBallstcRegnMngt, EcucPartitionSoftwareComponentInstanceRef=CPT_rba_OsArSchedExtn_mcop, EcucPartitionSoftwareComponentInstanceRef=PurgVlvActrCtrl, EcucPartitionSoftwareComponentInstanceRef=FuSysMon, EcucPartitionSoftwareComponentInstanceRef=ExhTThermMngt, EcucPartitionSoftwareComponentInstanceRef=CmprInletPSnsr, EcucPartitionSoftwareComponentInstanceRef=CPT_EGSHeatr_Acttn, EcucPartitionSoftwareComponentInstanceRef=CPT_InjSyG_CalcCnvnFac, EcucPartitionSoftwareComponentInstanceRef=CPT_UEGO_DiagSigEcuAsic, EcucPartitionSoftwareComponentInstanceRef=AMTR, EcucPartitionSoftwareComponentInstanceRef=CPT_ComScl_Appl, EcucPartitionSoftwareComponentInstanceRef=FuTankPSnsrAdcInpSwc, EcucPartitionSoftwareComponentInstanceRef=ThrActrCtrl, EcucPartitionSoftwareComponentInstanceRef=AftmntThermMgr, EcucPartitionSoftwareComponentInstanceRef=ThrPosnSnsr, EcucPartitionSoftwareComponentInstanceRef=LoUElecPhysCoorr, EcucPartitionSoftwareComponentInstanceRef=AccrPedlEstimr, EcucPartitionSoftwareComponentInstanceRef=LoUElecSysEstimr, EcucPartitionSoftwareComponentInstanceRef=PtoCtrl, EcucPartitionSoftwareComponentInstanceRef=ShoRunrVlvSysCoorr
        EcucPartition_OsApp_3_Q_1: EcucPartitionBswModuleExecution=0, PartitionCanBeRestarted=false, EcucPartitionSoftwareComponentInstanceRef=CPT_ComScl_EngLinTxAdapt, EcucPartitionSoftwareComponentInstanceRef=CPT_ComScl_NetMtrxTxAdapt, EcucPartitionSoftwareComponentInstanceRef=CPT_ComScl_NetMtrx2TxAdapt
        EcucPartition_OsApp_0_Q_1: EcucPartitionBswModuleExecution=1, PartitionCanBeRestarted=false, EcucPartitionSoftwareComponentInstanceRef=CPT_ComScl_NetMtrx_Scl, EcucPartitionSoftwareComponentInstanceRef=CPT_ComScl_NetMtrx2_Scl, EcucPartitionSoftwareComponentInstanceRef=CPT_ComScl_NetMtrx3_Scl, EcucPartitionSoftwareComponentInstanceRef=CPT_ComScl_EngLin_Scl, EcucPartitionSoftwareComponentInstanceRef=CPT_SWC_VcodProxi, EcucPartitionSoftwareComponentInstanceRef=CPT_ComScl_NetMtrxTxAdapt, EcucPartitionSoftwareComponentInstanceRef=FEELubCtrlBlkSwc, EcucPartitionSoftwareComponentInstanceRef=CamCrksftDifVldFEEBlkSwc
        EcucPartition_OsApp_0_B_1: EcucPartitionSoftwareComponentInstanceRef=CPT_FiM, EcucPartitionSoftwareComponentInstanceRef=CPT_rba_OsArSchedExtn_OS, EcucPartitionSoftwareComponentInstanceRef=CPT_Dem, EcucPartitionSoftwareComponentInstanceRef=CPT_esc_stack, EcucPartitionSoftwareComponentInstanceRef=CPT_SWAdp, EcucPartitionSoftwareComponentInstanceRef=CPT_rba_OsArSchedExtn_mcop
        EcucPartition_OsApp_0_Q_1: EcucPartitionSoftwareComponentInstanceRef=FiveVoltOutpAdcInpSwc, EcucPartitionSoftwareComponentInstanceRef=FuInjrMTar, EcucPartitionSoftwareComponentInstanceRef=GdiFuRailP1AdcInpSwc, EcucPartitionSoftwareComponentInstanceRef=KnkSnsr, EcucPartitionSoftwareComponentInstanceRef=HoodAjarAdcInpSwc, EcucPartitionSoftwareComponentInstanceRef=PedlValSnsr2AuxAdcInpSwc, EcucPartitionSoftwareComponentInstanceRef=MnfldPPredEstimr, EcucPartitionSoftwareComponentInstanceRef=AirCdngPSnsrAdcInpSwc, EcucPartitionSoftwareComponentInstanceRef=FuInjrEna, EcucPartitionSoftwareComponentInstanceRef=PedlValSnsr1AdcInpSwc, EcucPartitionSoftwareComponentInstanceRef=EngFricEstimr, EcucPartitionSoftwareComponentInstanceRef=CPT_rba_OsArSchedExtn_OS, EcucPartitionSoftwareComponentInstanceRef=CalInp1AdcInpSwc, EcucPartitionSoftwareComponentInstanceRef=CPT_Dem, EcucPartitionSoftwareComponentInstanceRef=GasFlowEstimr, EcucPartitionSoftwareComponentInstanceRef=EngSwtBattAdcInpSwc, EcucPartitionSoftwareComponentInstanceRef=OilPSnsrAdcInpSwc, EcucPartitionSoftwareComponentInstanceRef=FsoAndCylDeactvnPhysCoorr, EcucPartitionSoftwareComponentInstanceRef=FiveVoltSnsAdcInpSwc, EcucPartitionSoftwareComponentInstanceRef=CPT_rba_Svbb, EcucPartitionSoftwareComponentInstanceRef=CPT_rba_SyC_States_Cfg_0_Q_1, EcucPartitionSoftwareComponentInstanceRef=Coolt3WayVlvAdcInpSwc, EcucPartitionSoftwareComponentInstanceRef=CPT_Epm_SpdFeat, EcucPartitionSoftwareComponentInstanceRef=MnfldAirPAdcInpSwc, EcucPartitionSoftwareComponentInstanceRef=CPT_ComScl_NetMtrx3_Scl, EcucPartitionSoftwareComponentInstanceRef=DrvlnEstimr, EcucPartitionSoftwareComponentInstanceRef=EssEveMgr, EcucPartitionSoftwareComponentInstanceRef=ThrPosnSnsr1AdcInpSwc, EcucPartitionSoftwareComponentInstanceRef=CylDeactvnSysCoorr, EcucPartitionSoftwareComponentInstanceRef=DsvlActrCtrl, EcucPartitionSoftwareComponentInstanceRef=FuInjrMSplitTar, EcucPartitionSoftwareComponentInstanceRef=DsvlSysCoorr, EcucPartitionSoftwareComponentInstanceRef=IgnTimgTar, EcucPartitionSoftwareComponentInstanceRef=ThermStEstimr, EcucPartitionSoftwareComponentInstanceRef=CylPhysCoorr, EcucPartitionSoftwareComponentInstanceRef=SwtgOxSnsr, EcucPartitionSoftwareComponentInstanceRef=PredVlvMtnEstimr, EcucPartitionSoftwareComponentInstanceRef=FuBrnFracEstimr, EcucPartitionSoftwareComponentInstanceRef=CluSnsAdcInp, EcucPartitionSoftwareComponentInstanceRef=CPT_T15_Vld2Lcy, EcucPartitionSoftwareComponentInstanceRef=CylDeactvnActrCtrl, EcucPartitionSoftwareComponentInstanceRef=EepNVBlkSwc_OsApp_0_Q_1, EcucPartitionSoftwareComponentInstanceRef=CPT_rba_EepAdaptDGS, EcucPartitionSoftwareComponentInstanceRef=PFIFuRailTempAdcInp, EcucPartitionSoftwareComponentInstanceRef=EngSpdCtrl, EcucPartitionSoftwareComponentInstanceRef=CrkBattMonrAdcInpSwc, EcucPartitionSoftwareComponentInstanceRef=CPT_esc_stack, EcucPartitionSoftwareComponentInstanceRef=CatTEstimr, EcucPartitionSoftwareComponentInstanceRef=CPT_ComScl_NetMtrx2_Scl, EcucPartitionSoftwareComponentInstanceRef=PwrSplitOptimn, EcucPartitionSoftwareComponentInstanceRef=GasXchgEstimr, EcucPartitionSoftwareComponentInstanceRef=OilTSnsrAdcInpSwc, EcucPartitionSoftwareComponentInstanceRef=BrkPdlPosnSnsrAdcInp, EcucPartitionSoftwareComponentInstanceRef=IntkEstimr, EcucPartitionSoftwareComponentInstanceRef=CDAConstrDetrmn, EcucPartitionSoftwareComponentInstanceRef=FuInjrSplitRatioMgr, EcucPartitionSoftwareComponentInstanceRef=WgPosn1AdcInpSwc, EcucPartitionSoftwareComponentInstanceRef=ExhEstimr, EcucPartitionSoftwareComponentInstanceRef=EngAdpnCoorr, EcucPartitionSoftwareComponentInstanceRef=FuInjrIf, EcucPartitionSoftwareComponentInstanceRef=VvaActrCtrl, EcucPartitionSoftwareComponentInstanceRef=IntkAirTAdcInpSwc, EcucPartitionSoftwareComponentInstanceRef=ColdCrkCasePSnsrAdcInpSwc, EcucPartitionSoftwareComponentInstanceRef=ThrPosnSnsr2AdcInpSwc, EcucPartitionSoftwareComponentInstanceRef=CylPhiImbEstimr, EcucPartitionSoftwareComponentInstanceRef=LoTRadrTSnsrAdcInpSwc, EcucPartitionSoftwareComponentInstanceRef=CPT_ComScl_NetMtrx_Scl, EcucPartitionSoftwareComponentInstanceRef=CoolEgrTAdcInpSwc, EcucPartitionSoftwareComponentInstanceRef=HiTRadrOutlTSnsrAdcInpSwc, EcucPartitionSoftwareComponentInstanceRef=MnfldGasTAdcInpSwc, EcucPartitionSoftwareComponentInstanceRef=FuRailPTar, EcucPartitionSoftwareComponentInstanceRef=ActrSyncnCoorr, EcucPartitionSoftwareComponentInstanceRef=PSnsrCohEstimr, EcucPartitionSoftwareComponentInstanceRef=CylPhiTar, EcucPartitionSoftwareComponentInstanceRef=CPT_SWAdp, EcucPartitionSoftwareComponentInstanceRef=BoostTemp1AdcInpSwc, EcucPartitionSoftwareComponentInstanceRef=PedlValSnsr2AdcInpSwc, EcucPartitionSoftwareComponentInstanceRef=HybEngStrtFuEstimr, EcucPartitionSoftwareComponentInstanceRef=CalInp2AdcInpSwc, EcucPartitionSoftwareComponentInstanceRef=FuRailPSnsr, EcucPartitionSoftwareComponentInstanceRef=PtLashCtrl, EcucPartitionSoftwareComponentInstanceRef=CrkTrainPhysCoorr, EcucPartitionSoftwareComponentInstanceRef=PFIFuRailPressAdcInp, EcucPartitionSoftwareComponentInstanceRef=KnkReactn, EcucPartitionSoftwareComponentInstanceRef=OilShutOffValveFbAdcInp, EcucPartitionSoftwareComponentInstanceRef=EvapLkChkMonSnsAdcInpSwc, EcucPartitionSoftwareComponentInstanceRef=WgPosn2AdcInpSwc, EcucPartitionSoftwareComponentInstanceRef=ThrInletAirPSnsr, EcucPartitionSoftwareComponentInstanceRef=EngCooltTAdcInpSwc, EcucPartitionSoftwareComponentInstanceRef=IntkMnfldPSnsr, EcucPartitionSoftwareComponentInstanceRef=FuInjrDICtrl, EcucPartitionSoftwareComponentInstanceRef=EthnlVapEstimr, EcucPartitionSoftwareComponentInstanceRef=FiveVoltAuxAdcInpSwc, EcucPartitionSoftwareComponentInstanceRef=ExhPhiTar, EcucPartitionSoftwareComponentInstanceRef=KnkIntenEstimr, EcucPartitionSoftwareComponentInstanceRef=LoPFuSnsrAdcInpSwc, EcucPartitionSoftwareComponentInstanceRef=CPT_ATS_Std, EcucPartitionSoftwareComponentInstanceRef=FuWallFilmEstimr, EcucPartitionSoftwareComponentInstanceRef=IgnCoilCtrl, EcucPartitionSoftwareComponentInstanceRef=FuFlowAdpn, EcucPartitionSoftwareComponentInstanceRef=ExhPhiEstimr, EcucPartitionSoftwareComponentInstanceRef=VlvMtnAdpn, EcucPartitionSoftwareComponentInstanceRef=AftmntPhysCoorr, EcucPartitionSoftwareComponentInstanceRef=ExhPhiSnsr, EcucPartitionSoftwareComponentInstanceRef=CmbPhsgTar, EcucPartitionSoftwareComponentInstanceRef=ThrInletAirPEstimr, EcucPartitionSoftwareComponentInstanceRef=EngMeclPpty, EcucPartitionSoftwareComponentInstanceRef=PhiCtrlr, EcucPartitionSoftwareComponentInstanceRef=CmprInletTempAdcInp, EcucPartitionSoftwareComponentInstanceRef=VarGeomTrbFb, EcucPartitionSoftwareComponentInstanceRef=IntkMnfldPEstimr, EcucPartitionSoftwareComponentInstanceRef=ReAxleTempSnsrAdcInp, EcucPartitionSoftwareComponentInstanceRef=BoostTemp2AdcInpSwc, EcucPartitionSoftwareComponentInstanceRef=ThrIntkGasTAdcInpSwc, EcucPartitionSoftwareComponentInstanceRef=GdiFuRailP2AdcInpSwc, EcucPartitionSoftwareComponentInstanceRef=ThrIntkPAdcInpSwc, EcucPartitionSoftwareComponentInstanceRef=HiPFuPmpCtrl, EcucPartitionSoftwareComponentInstanceRef=SysU12VoltAdcInpSwc, EcucPartitionSoftwareComponentInstanceRef=DynCrksftFuCtrl, EcucPartitionSoftwareComponentInstanceRef=CPT_rba_OsArSchedExtn_mcop, EcucPartitionSoftwareComponentInstanceRef=FuInjrCtrl, EcucPartitionSoftwareComponentInstanceRef=FuCnsEstimr, EcucPartitionSoftwareComponentInstanceRef=CrkTrainEstimr, EcucPartitionSoftwareComponentInstanceRef=FuTankPSnsrAdcInpSwc, EcucPartitionSoftwareComponentInstanceRef=CylImepEstimr, EcucPartitionSoftwareComponentInstanceRef=CPT_ComCIL_Adapt, EcucPartitionSoftwareComponentInstanceRef=CPT_ComPtc, EcucPartitionSoftwareComponentInstanceRef=GasXchgPhysCoorr
        EcucPartition_OsApp_1_A_1: EcucPartitionSoftwareComponentInstanceRef=CPT_esc_stack, EcucPartitionSoftwareComponentInstanceRef=CPT_rba_OsArSchedExtn_mcop
        EcucPartition_OsApp_1_B_1: EcucPartitionSoftwareComponentInstanceRef=CPT_Dem, EcucPartitionSoftwareComponentInstanceRef=CPT_rba_SyC_States_Cfg_1_B_1, EcucPartitionSoftwareComponentInstanceRef=CPT_esc_stack, EcucPartitionSoftwareComponentInstanceRef=CPT_MoCCom_Co, EcucPartitionSoftwareComponentInstanceRef=Lvl2Data, EcucPartitionSoftwareComponentInstanceRef=EssOccptSenMgr, EcucPartitionSoftwareComponentInstanceRef=CPT_rba_OsShell, EcucPartitionSoftwareComponentInstanceRef=Lvl1SysSftyReactn, EcucPartitionSoftwareComponentInstanceRef=CPT_MoCSOP_Co, EcucPartitionSoftwareComponentInstanceRef=CPT_rba_OsArSchedExtn_mcop, EcucPartitionSoftwareComponentInstanceRef=LvlInin
        EcucPartition_OsApp_1_Q_1: EcucPartitionSoftwareComponentInstanceRef=AllGrPosnSnsr2PwmInp, EcucPartitionSoftwareComponentInstanceRef=CluInterLockSwDigInp, EcucPartitionSoftwareComponentInstanceRef=CPT_EGSHeatr_SnsrCoorn, EcucPartitionSoftwareComponentInstanceRef=CPT_EpmCaS_Spd, EcucPartitionSoftwareComponentInstanceRef=CPT_esc_tasklink, EcucPartitionSoftwareComponentInstanceRef=SwilEngMnt2DigOutp, EcucPartitionSoftwareComponentInstanceRef=FiveVoltOutpAdcInpSwc, EcucPartitionSoftwareComponentInstanceRef=CPT_XcpAppl, EcucPartitionSoftwareComponentInstanceRef=GdiFuRailP1AdcInpSwc, EcucPartitionSoftwareComponentInstanceRef=CPT_CoEng_ObdSig, EcucPartitionSoftwareComponentInstanceRef=HoodAjarAdcInpSwc, EcucPartitionSoftwareComponentInstanceRef=PedlValSnsr2AuxAdcInpSwc, EcucPartitionSoftwareComponentInstanceRef=CPT_UEGO_UNernst, EcucPartitionSoftwareComponentInstanceRef=Hbrdg_Wg1, EcucPartitionSoftwareComponentInstanceRef=RadrFanRlyHiSpdDigOutp, EcucPartitionSoftwareComponentInstanceRef=CPT_EpmTDC_Corrn, EcucPartitionSoftwareComponentInstanceRef=AirCdngPSnsrAdcInpSwc, EcucPartitionSoftwareComponentInstanceRef=CPT_Dem_Main, EcucPartitionSoftwareComponentInstanceRef=PedlValSnsr1AdcInpSwc, EcucPartitionSoftwareComponentInstanceRef=LoPFuPmpActrCtrl, EcucPartitionSoftwareComponentInstanceRef=CPT_rba_OsArSchedExtn_OS, EcucPartitionSoftwareComponentInstanceRef=CalInp1AdcInpSwc, EcucPartitionSoftwareComponentInstanceRef=CPT_Dem, EcucPartitionSoftwareComponentInstanceRef=AirCdngCtrl, EcucPartitionSoftwareComponentInstanceRef=CPT_InjVlvPs_Dia, EcucPartitionSoftwareComponentInstanceRef=CPT_EGSHeatr_DiagPrfmnc, EcucPartitionSoftwareComponentInstanceRef=EngSwtBattAdcInpSwc, EcucPartitionSoftwareComponentInstanceRef=OilPSnsrAdcInpSwc, EcucPartitionSoftwareComponentInstanceRef=InRushIRednRly, EcucPartitionSoftwareComponentInstanceRef=CPT_DcmDspUDS_SecA, EcucPartitionSoftwareComponentInstanceRef=CPT_UEGO_OperRelsExtInhb, EcucPartitionSoftwareComponentInstanceRef=LoPresFuPmpRlyDigOutp, EcucPartitionSoftwareComponentInstanceRef=InjSyG_SwSStellantis, EcucPartitionSoftwareComponentInstanceRef=FiveVoltSnsAdcInpSwc, EcucPartitionSoftwareComponentInstanceRef=CPT_rba_Svbb, EcucPartitionSoftwareComponentInstanceRef=InjVvGPfi_SwSStellantis, EcucPartitionSoftwareComponentInstanceRef=CPT_IVGdiCtl_CvoAdpn, EcucPartitionSoftwareComponentInstanceRef=CPT_DevLib_PwrStgState, EcucPartitionSoftwareComponentInstanceRef=Coolt3WayVlvAdcInpSwc, EcucPartitionSoftwareComponentInstanceRef=FuPmpCtlMdulCmdPwmOutp, EcucPartitionSoftwareComponentInstanceRef=CPT_Epm_SpdFeat, EcucPartitionSoftwareComponentInstanceRef=CPT_EpmBCr_IntrCo, EcucPartitionSoftwareComponentInstanceRef=CPT_EpmHCrS_IntHndlr, EcucPartitionSoftwareComponentInstanceRef=FuTankIsolnVlvDigOutp, EcucPartitionSoftwareComponentInstanceRef=CPT_FEL_EvapSysIfAdp, EcucPartitionSoftwareComponentInstanceRef=CPT_IVGdiCtl_CvoSigAcq, EcucPartitionSoftwareComponentInstanceRef=MnfldAirPAdcInpSwc, EcucPartitionSoftwareComponentInstanceRef=CPT_ESC_EveCfg, EcucPartitionSoftwareComponentInstanceRef=CPT_InjSyG_SpCvo, EcucPartitionSoftwareComponentInstanceRef=ThrPosnSnsr1AdcInpSwc, EcucPartitionSoftwareComponentInstanceRef=CPT_EpmSeq_StateMn, EcucPartitionSoftwareComponentInstanceRef=CPT_CoEng_StAdpr, EcucPartitionSoftwareComponentInstanceRef=CPT_HEGO_Sens, EcucPartitionSoftwareComponentInstanceRef=DMTLLkPmpDigOutp, EcucPartitionSoftwareComponentInstanceRef=CPT_GlbDaAdapt_Adapt, EcucPartitionSoftwareComponentInstanceRef=Hbrdg_ETC_Motor, EcucPartitionSoftwareComponentInstanceRef=CPT_EpmCrS_Diag, EcucPartitionSoftwareComponentInstanceRef=CluSnsAdcInp, EcucPartitionSoftwareComponentInstanceRef=CPT_SrvB, EcucPartitionSoftwareComponentInstanceRef=CPT_IgnClPs_Dia, EcucPartitionSoftwareComponentInstanceRef=CPT_T15_Vld2Lcy, EcucPartitionSoftwareComponentInstanceRef=KnDet_SwSStellantis, EcucPartitionSoftwareComponentInstanceRef=MFVlv_SwSStellantis, EcucPartitionSoftwareComponentInstanceRef=CPT_EpmCaS_SyncnPatTi, EcucPartitionSoftwareComponentInstanceRef=CPT_Epm_CustAdp, EcucPartitionSoftwareComponentInstanceRef=CPT_UEGO_DiagSigOperPlaus, EcucPartitionSoftwareComponentInstanceRef=BrkSwDigInp, EcucPartitionSoftwareComponentInstanceRef=DP_VlvPosnSns, EcucPartitionSoftwareComponentInstanceRef=CPT_EpmCaS_OfsDiag, EcucPartitionSoftwareComponentInstanceRef=DualFuTankEnblRlyDigOutp, EcucPartitionSoftwareComponentInstanceRef=CPT_CoEng_StEng, EcucPartitionSoftwareComponentInstanceRef=CPT_UEGO_DiagSigWireOl, EcucPartitionSoftwareComponentInstanceRef=CPT_ComScl_EngLin_Scl, EcucPartitionSoftwareComponentInstanceRef=CPT_rba_EepAdaptDGS, EcucPartitionSoftwareComponentInstanceRef=PFIFuRailTempAdcInp, EcucPartitionSoftwareComponentInstanceRef=DynoFuDsblReqSwDigInp, EcucPartitionSoftwareComponentInstanceRef=CPT_IgCPrimI_AcqnAdc, EcucPartitionSoftwareComponentInstanceRef=CPT_InjSyG_InjTi, EcucPartitionSoftwareComponentInstanceRef=CPT_EpmCaS_RelsSigEvln, EcucPartitionSoftwareComponentInstanceRef=CPT_EpmSyn_CaSPos, EcucPartitionSoftwareComponentInstanceRef=CPT_BGTHDEV, EcucPartitionSoftwareComponentInstanceRef=CrkBattMonrAdcInpSwc, EcucPartitionSoftwareComponentInstanceRef=CPT_DEVE, EcucPartitionSoftwareComponentInstanceRef=FPCMFb1PwmInp, EcucPartitionSoftwareComponentInstanceRef=IoSigPwr_SwSStellantis, EcucPartitionSoftwareComponentInstanceRef=MaiRlyDigOutp, EcucPartitionSoftwareComponentInstanceRef=GEVlv_SwSStellantis, EcucPartitionSoftwareComponentInstanceRef=CPT_esc_stack, EcucPartitionSoftwareComponentInstanceRef=OilShutOffVlvDigOutp, EcucPartitionSoftwareComponentInstanceRef=CPT_EpmRRS_AgDetect, EcucPartitionSoftwareComponentInstanceRef=CPT_IgnDD_Calcn, EcucPartitionSoftwareComponentInstanceRef=InrushCircRlyDigOutp, EcucPartitionSoftwareComponentInstanceRef=HTR_MeclWtrPmpActrPwmOutp, EcucPartitionSoftwareComponentInstanceRef=CPT_UEGO_DiagSigWireSc, EcucPartitionSoftwareComponentInstanceRef=NVLD_SwDigInp, EcucPartitionSoftwareComponentInstanceRef=CPT_rba_SyC_States_Cfg_1_Q_1, EcucPartitionSoftwareComponentInstanceRef=OilTSnsrAdcInpSwc, EcucPartitionSoftwareComponentInstanceRef=IgnCl_SwSStellantis, EcucPartitionSoftwareComponentInstanceRef=AllGrPosnSnsr1PwmInp, EcucPartitionSoftwareComponentInstanceRef=WgSolnPwmOutp, EcucPartitionSoftwareComponentInstanceRef=BrkPdlPosnSnsrAdcInp, EcucPartitionSoftwareComponentInstanceRef=CPT_Reset_CallBack, EcucPartitionSoftwareComponentInstanceRef=CPT_DcmDspUDS_DID, EcucPartitionSoftwareComponentInstanceRef=InjVvG_SwSStellantis, EcucPartitionSoftwareComponentInstanceRef=CPT_IVGdiCtl_CvoDiag, EcucPartitionSoftwareComponentInstanceRef=AlterFieCtrlPwmOutp, EcucPartitionSoftwareComponentInstanceRef=Hbrdg_VarGeomTrb, EcucPartitionSoftwareComponentInstanceRef=RadrFanCtrlPwmPwmOutp, EcucPartitionSoftwareComponentInstanceRef=StrtrRlyDigOutp, EcucPartitionSoftwareComponentInstanceRef=SwilEngMnt1DigOutp, EcucPartitionSoftwareComponentInstanceRef=WgPosn1AdcInpSwc, EcucPartitionSoftwareComponentInstanceRef=CPT_dcmcore_dsldsd_appl, EcucPartitionSoftwareComponentInstanceRef=CPT_UEGO_O2Ref, EcucPartitionSoftwareComponentInstanceRef=CEGR_PosnSns, EcucPartitionSoftwareComponentInstanceRef=FTIVCtrl, EcucPartitionSoftwareComponentInstanceRef=CPT_MfDD, EcucPartitionSoftwareComponentInstanceRef=CPT_OilCmbdSen_DD, EcucPartitionSoftwareComponentInstanceRef=CPT_Epm_Spd, EcucPartitionSoftwareComponentInstanceRef=VapBlockingVlvDigOutp, EcucPartitionSoftwareComponentInstanceRef=CPT_EngDa_PwrEng, EcucPartitionSoftwareComponentInstanceRef=CPT_MoCCom_Co, EcucPartitionSoftwareComponentInstanceRef=CPT_IVGdiCtl_CvoSimnErr, EcucPartitionSoftwareComponentInstanceRef=CPT_ComCo_Lyr, EcucPartitionSoftwareComponentInstanceRef=CPT_KnDetSigEval, EcucPartitionSoftwareComponentInstanceRef=CPT_KnDetControl, EcucPartitionSoftwareComponentInstanceRef=IntkAirTAdcInpSwc, EcucPartitionSoftwareComponentInstanceRef=IntgrdEvapSysRatly, EcucPartitionSoftwareComponentInstanceRef=ELCM_VacPmpPwmOutp, EcucPartitionSoftwareComponentInstanceRef=ColdCrkCasePSnsrAdcInpSwc, EcucPartitionSoftwareComponentInstanceRef=ThrPosnSnsr2AdcInpSwc, EcucPartitionSoftwareComponentInstanceRef=LoTRadrTSnsrAdcInpSwc, EcucPartitionSoftwareComponentInstanceRef=FuDoorSwDigInp, EcucPartitionSoftwareComponentInstanceRef=CoolEgrTAdcInpSwc, EcucPartitionSoftwareComponentInstanceRef=PcvFrshAirLineRatly, EcucPartitionSoftwareComponentInstanceRef=CPT_UEGO_ISrc, EcucPartitionSoftwareComponentInstanceRef=SecdAirPmpRlyDigOutp, EcucPartitionSoftwareComponentInstanceRef=HiTRadrOutlTSnsrAdcInpSwc, EcucPartitionSoftwareComponentInstanceRef=MnfldGasTAdcInpSwc, EcucPartitionSoftwareComponentInstanceRef=FuDoorDigOutp, EcucPartitionSoftwareComponentInstanceRef=CPT_EpmCrS_RevCnt, EcucPartitionSoftwareComponentInstanceRef=VvtExh1PwmOutp, EcucPartitionSoftwareComponentInstanceRef=HTR_TempCtrlVlvSolnPwmOutp, EcucPartitionSoftwareComponentInstanceRef=CPT_ESC_HwIntrptEveGen, EcucPartitionSoftwareComponentInstanceRef=CPT_SWAdp, EcucPartitionSoftwareComponentInstanceRef=CPT_EnvP_DD, EcucPartitionSoftwareComponentInstanceRef=CPT_HEGO_Htg, EcucPartitionSoftwareComponentInstanceRef=Hbrdg_Coold_EGR, EcucPartitionSoftwareComponentInstanceRef=BoostTemp1AdcInpSwc, EcucPartitionSoftwareComponentInstanceRef=PedlValSnsr2AdcInpSwc, EcucPartitionSoftwareComponentInstanceRef=DSM_SwSStellantis, EcucPartitionSoftwareComponentInstanceRef=CalInp2AdcInpSwc, EcucPartitionSoftwareComponentInstanceRef=CPT_InjSyG_CoCvo, EcucPartitionSoftwareComponentInstanceRef=PFIFuRailPressAdcInp, EcucPartitionSoftwareComponentInstanceRef=ElecPhsrDiagPwmInp, EcucPartitionSoftwareComponentInstanceRef=IgnRunStrtSwDigInp, EcucPartitionSoftwareComponentInstanceRef=CPT_SYNTIZW, EcucPartitionSoftwareComponentInstanceRef=CPT_IoSigSwAdpr_SwSStellantis, EcucPartitionSoftwareComponentInstanceRef=CPT_IgnDD_ModCtrlr, EcucPartitionSoftwareComponentInstanceRef=CPT_EpmCrS_Seg, EcucPartitionSoftwareComponentInstanceRef=OilShutOffValveFbAdcInp, EcucPartitionSoftwareComponentInstanceRef=EvapLkChkMonSnsAdcInpSwc, EcucPartitionSoftwareComponentInstanceRef=CPT_InjDDPfi, EcucPartitionSoftwareComponentInstanceRef=CPT_EpmRRS_StopDetect, EcucPartitionSoftwareComponentInstanceRef=WgPosn2AdcInpSwc, EcucPartitionSoftwareComponentInstanceRef=EngCooltTAdcInpSwc, EcucPartitionSoftwareComponentInstanceRef=CPT_SyC_Vld2Lcy, EcucPartitionSoftwareComponentInstanceRef=CPT_IgnCoilDiagCoorn, EcucPartitionSoftwareComponentInstanceRef=CPT_UEGO_O2, EcucPartitionSoftwareComponentInstanceRef=FiveVoltAuxAdcInpSwc, EcucPartitionSoftwareComponentInstanceRef=CPT_EpmHCaS_SigEval, EcucPartitionSoftwareComponentInstanceRef=FuPmpCtlMdul2CmdPwmOutp, EcucPartitionSoftwareComponentInstanceRef=CPT_UEGO_ModCtrl, EcucPartitionSoftwareComponentInstanceRef=LoPFuSnsrAdcInpSwc, EcucPartitionSoftwareComponentInstanceRef=CPT_ATS_Std, EcucPartitionSoftwareComponentInstanceRef=SrgSoln2DigOutp, EcucPartitionSoftwareComponentInstanceRef=VvtActrCtrl, EcucPartitionSoftwareComponentInstanceRef=CPT_Epm_Ini, EcucPartitionSoftwareComponentInstanceRef=MAF_Hum_Snsr, EcucPartitionSoftwareComponentInstanceRef=Epm_SwSStellantis, EcucPartitionSoftwareComponentInstanceRef=Hbrdg_DP, EcucPartitionSoftwareComponentInstanceRef=CPT_UEGO_Tstr, EcucPartitionSoftwareComponentInstanceRef=CPT_Epm_Ladp, EcucPartitionSoftwareComponentInstanceRef=CPT_EpmSyn_CrSPos, EcucPartitionSoftwareComponentInstanceRef=CPT_AVS_Std, EcucPartitionSoftwareComponentInstanceRef=GPF_DeltAbsPresSnsr1, EcucPartitionSoftwareComponentInstanceRef=GPF_DeltAbsPresSnsr2, EcucPartitionSoftwareComponentInstanceRef=PurgSolnPwmOutp, EcucPartitionSoftwareComponentInstanceRef=CPT_UEGO_DiagRels, EcucPartitionSoftwareComponentInstanceRef=O2Snsr_SwSStellantis, EcucPartitionSoftwareComponentInstanceRef=CPT_UEGO_UPmp, EcucPartitionSoftwareComponentInstanceRef=TOH_ShutOffVlvDigOutp, EcucPartitionSoftwareComponentInstanceRef=EGRCoolr_DeltAbsPresSnsr, EcucPartitionSoftwareComponentInstanceRef=CoEng_SwSStellantis, EcucPartitionSoftwareComponentInstanceRef=CPT_EnvP_VDDiag, EcucPartitionSoftwareComponentInstanceRef=ElecVvtActrCtrl, EcucPartitionSoftwareComponentInstanceRef=CPT_IVGdiCtl_CvoCsersPlausyDiag, EcucPartitionSoftwareComponentInstanceRef=SrgSoln1DigOutp, EcucPartitionSoftwareComponentInstanceRef=CPT_IVGdiCtl_CvoSigEvln, EcucPartitionSoftwareComponentInstanceRef=CPT_EpmSeq_EveHndlr, EcucPartitionSoftwareComponentInstanceRef=CPT_InjSyG_AdpnCdnCvo, EcucPartitionSoftwareComponentInstanceRef=EngOilPmpCtrl, EcucPartitionSoftwareComponentInstanceRef=CPT_SWC_VcodProxi, EcucPartitionSoftwareComponentInstanceRef=CPT_MRly_Vld2Lcy, EcucPartitionSoftwareComponentInstanceRef=CPT_EpmHAgClk_Gen, EcucPartitionSoftwareComponentInstanceRef=CPT_EpmCaS_Meas, EcucPartitionSoftwareComponentInstanceRef=CPT_rba_MemDiag, EcucPartitionSoftwareComponentInstanceRef=CPT_HEGO_OBDElec, EcucPartitionSoftwareComponentInstanceRef=CPT_Epm_SpdGrd, EcucPartitionSoftwareComponentInstanceRef=ElecPhsrMtrCmdOutpPwmOutp, EcucPartitionSoftwareComponentInstanceRef=CPT_EpmBCr_Pos, EcucPartitionSoftwareComponentInstanceRef=CPT_EpmIf_Imprt, EcucPartitionSoftwareComponentInstanceRef=CPT_CDShdG_GTMLib, EcucPartitionSoftwareComponentInstanceRef=MakeUpAirVlvDigOutp, EcucPartitionSoftwareComponentInstanceRef=PurgSoln2PwmOutp, EcucPartitionSoftwareComponentInstanceRef=OilLvlSnsrPwmInp, EcucPartitionSoftwareComponentInstanceRef=ECM_WakeUpDigInp, EcucPartitionSoftwareComponentInstanceRef=EepNVBlkSwc_OsApp_1_Q_1, EcucPartitionSoftwareComponentInstanceRef=ELCM_ChgOvrVlvDigOutp, EcucPartitionSoftwareComponentInstanceRef=CPT_EpmCaS_Diag, EcucPartitionSoftwareComponentInstanceRef=CPT_Epm_OpMode, EcucPartitionSoftwareComponentInstanceRef=CPT_ESC_OsTskActvnHndlr, EcucPartitionSoftwareComponentInstanceRef=CPT_KONCW, EcucPartitionSoftwareComponentInstanceRef=ElectcVacPmpRlyDigOutp, EcucPartitionSoftwareComponentInstanceRef=CPT_InjDDGdi, EcucPartitionSoftwareComponentInstanceRef=CmprInletTempAdcInp, EcucPartitionSoftwareComponentInstanceRef=CPT_EpmCaS_Adap, EcucPartitionSoftwareComponentInstanceRef=TrbChrgActrCtrl, EcucPartitionSoftwareComponentInstanceRef=CPT_GlbDa_ECUOnTime, EcucPartitionSoftwareComponentInstanceRef=VarGeomTrbFb, EcucPartitionSoftwareComponentInstanceRef=StrtrMotActtn, EcucPartitionSoftwareComponentInstanceRef=CPT_InjSyG_DdIf, EcucPartitionSoftwareComponentInstanceRef=RadrFanCtrl, EcucPartitionSoftwareComponentInstanceRef=ReAxleTempSnsrAdcInp, EcucPartitionSoftwareComponentInstanceRef=CPT_EGSHeatr_Ctrl, EcucPartitionSoftwareComponentInstanceRef=BoostTemp2AdcInpSwc, EcucPartitionSoftwareComponentInstanceRef=ThrIntkGasTAdcInpSwc, EcucPartitionSoftwareComponentInstanceRef=SecdAirShutOffSoln1DigOutp, EcucPartitionSoftwareComponentInstanceRef=GdiFuRailP2AdcInpSwc, EcucPartitionSoftwareComponentInstanceRef=CPT_InjSyG_InjTmngAdpr, EcucPartitionSoftwareComponentInstanceRef=CPT_UEGO_DiagSigSnsr, EcucPartitionSoftwareComponentInstanceRef=CPT_MoCSOP_Co, EcucPartitionSoftwareComponentInstanceRef=CPT_MfPsDia, EcucPartitionSoftwareComponentInstanceRef=CPT_ESC_Ladp, EcucPartitionSoftwareComponentInstanceRef=ThrIntkPAdcInpSwc, EcucPartitionSoftwareComponentInstanceRef=CPT_EpmCaS_Seg, EcucPartitionSoftwareComponentInstanceRef=CPT_SysC_Ladp, EcucPartitionSoftwareComponentInstanceRef=CPT_DSM_Conf, EcucPartitionSoftwareComponentInstanceRef=SysU12VoltAdcInpSwc, EcucPartitionSoftwareComponentInstanceRef=OBD_PurgVentVlvDigOutp, EcucPartitionSoftwareComponentInstanceRef=CPT_rba_OsArSchedExtn_mcop, EcucPartitionSoftwareComponentInstanceRef=CPT_UEGO_OperRels, EcucPartitionSoftwareComponentInstanceRef=VvtIntk1PwmOutp, EcucPartitionSoftwareComponentInstanceRef=IoSigIfAdapt_SwSStellantis, EcucPartitionSoftwareComponentInstanceRef=CPT_EpmCrS_Spd, EcucPartitionSoftwareComponentInstanceRef=AC_CluRlyDigOutp, EcucPartitionSoftwareComponentInstanceRef=CPT_InjVlvPs_ConCJ, EcucPartitionSoftwareComponentInstanceRef=CPT_UEGO_DiagSigEcuAsic, EcucPartitionSoftwareComponentInstanceRef=CPT_ComScl_Appl, EcucPartitionSoftwareComponentInstanceRef=FuTankPSnsrAdcInpSwc, EcucPartitionSoftwareComponentInstanceRef=VarOilSolnPwmOutp, EcucPartitionSoftwareComponentInstanceRef=CPT_EpmSrv_Lib, EcucPartitionSoftwareComponentInstanceRef=StrtrRlyFbDigInp, EcucPartitionSoftwareComponentInstanceRef=CPT_UEGO_TCeramic
        EcucPartition_OsApp_3_Q_1: EcucPartitionSoftwareComponentInstanceRef=IntkMnfldTEstimr, EcucPartitionSoftwareComponentInstanceRef=FiveVoltOutpAdcInpSwc, EcucPartitionSoftwareComponentInstanceRef=ThermPhysCoorr, EcucPartitionSoftwareComponentInstanceRef=Lvl2DataIdMngt, EcucPartitionSoftwareComponentInstanceRef=EngOilPSnsrDiagc, EcucPartitionSoftwareComponentInstanceRef=RunOutOfGas, EcucPartitionSoftwareComponentInstanceRef=HvacSigDiagc, EcucPartitionSoftwareComponentInstanceRef=GdiFuRailP1AdcInpSwc, EcucPartitionSoftwareComponentInstanceRef=EngCooltTEstimr, EcucPartitionSoftwareComponentInstanceRef=HoodAjarAdcInpSwc, EcucPartitionSoftwareComponentInstanceRef=PedlValSnsr2AuxAdcInpSwc, EcucPartitionSoftwareComponentInstanceRef=CPT_UEGO_UNernst, EcucPartitionSoftwareComponentInstanceRef=CPT_ComScl_EngLinTxAdapt, EcucPartitionSoftwareComponentInstanceRef=TrboPurgBypVlvDiag, EcucPartitionSoftwareComponentInstanceRef=AirCdngPSnsrAdcInpSwc, EcucPartitionSoftwareComponentInstanceRef=ParkNeutSwtRatly, EcucPartitionSoftwareComponentInstanceRef=PedlValSnsr1AdcInpSwc, EcucPartitionSoftwareComponentInstanceRef=FuInjrDiag, EcucPartitionSoftwareComponentInstanceRef=KnkSnsrCircDiag, EcucPartitionSoftwareComponentInstanceRef=DualBattRlyRatly, EcucPartitionSoftwareComponentInstanceRef=CPT_rba_OsArSchedExtn_OS, EcucPartitionSoftwareComponentInstanceRef=CPT_UEGO_RPmp, EcucPartitionSoftwareComponentInstanceRef=CalInp1AdcInpSwc, EcucPartitionSoftwareComponentInstanceRef=CPT_Dem, EcucPartitionSoftwareComponentInstanceRef=ShoRunrVlvRatly, EcucPartitionSoftwareComponentInstanceRef=EngSwtBattAdcInpSwc, EcucPartitionSoftwareComponentInstanceRef=OilPSnsrAdcInpSwc, EcucPartitionSoftwareComponentInstanceRef=FiveVoltSnsAdcInpSwc, EcucPartitionSoftwareComponentInstanceRef=CPT_rba_Svbb, EcucPartitionSoftwareComponentInstanceRef=Coolt3WayVlvAdcInpSwc, EcucPartitionSoftwareComponentInstanceRef=CPT_Epm_SpdFeat, EcucPartitionSoftwareComponentInstanceRef=CPT_EpmHCrS_IntHndlr, EcucPartitionSoftwareComponentInstanceRef=MnfldAirPAdcInpSwc, EcucPartitionSoftwareComponentInstanceRef=FldPpty, EcucPartitionSoftwareComponentInstanceRef=SeatBltRatly, EcucPartitionSoftwareComponentInstanceRef=ThrPosnSnsr1AdcInpSwc, EcucPartitionSoftwareComponentInstanceRef=ThrInletAirTEstimr, EcucPartitionSoftwareComponentInstanceRef=VvtRatly, EcucPartitionSoftwareComponentInstanceRef=EgrTEstimr, EcucPartitionSoftwareComponentInstanceRef=InletAirTEstimr, EcucPartitionSoftwareComponentInstanceRef=AirCdngPSnsr, EcucPartitionSoftwareComponentInstanceRef=TAFSysCoorr, EcucPartitionSoftwareComponentInstanceRef=CluSnsAdcInp, EcucPartitionSoftwareComponentInstanceRef=AirCdngPEstimr, EcucPartitionSoftwareComponentInstanceRef=KnkSnsrRatly, EcucPartitionSoftwareComponentInstanceRef=WhlSpdRatly, EcucPartitionSoftwareComponentInstanceRef=InjrBallstcRegnRatly, EcucPartitionSoftwareComponentInstanceRef=CPT_Epm_CustAdp, EcucPartitionSoftwareComponentInstanceRef=EngInletCooltTSnsr, EcucPartitionSoftwareComponentInstanceRef=CmprOutlTEstimr, EcucPartitionSoftwareComponentInstanceRef=DualStgOilPmpRatly, EcucPartitionSoftwareComponentInstanceRef=LoTCooltElecPmpRatly, EcucPartitionSoftwareComponentInstanceRef=PcvEngLineRatly, EcucPartitionSoftwareComponentInstanceRef=VvtActrCtrlDiag, EcucPartitionSoftwareComponentInstanceRef=ColdStrtDirectInjRatly, EcucPartitionSoftwareComponentInstanceRef=EVNR, EcucPartitionSoftwareComponentInstanceRef=PFIFuRailTempAdcInp, EcucPartitionSoftwareComponentInstanceRef=InletAirTSnsr, EcucPartitionSoftwareComponentInstanceRef=FuLvlRatly, EcucPartitionSoftwareComponentInstanceRef=CrkBattMonrAdcInpSwc, EcucPartitionSoftwareComponentInstanceRef=AgsRatly, EcucPartitionSoftwareComponentInstanceRef=HoodSwtRatly, EcucPartitionSoftwareComponentInstanceRef=FuRailTEstimr, EcucPartitionSoftwareComponentInstanceRef=ExtEgrActrCtrlDiag, EcucPartitionSoftwareComponentInstanceRef=EngOilTEstimr, EcucPartitionSoftwareComponentInstanceRef=CPT_esc_stack, EcucPartitionSoftwareComponentInstanceRef=ColdStrtSprkRatly, EcucPartitionSoftwareComponentInstanceRef=CPT_UEGO_ICntct, EcucPartitionSoftwareComponentInstanceRef=AirTempSnsrDiag, EcucPartitionSoftwareComponentInstanceRef=DoorRatly, EcucPartitionSoftwareComponentInstanceRef=HTLSysCoorr, EcucPartitionSoftwareComponentInstanceRef=AmbTSnsr, EcucPartitionSoftwareComponentInstanceRef=OilTSnsrAdcInpSwc, EcucPartitionSoftwareComponentInstanceRef=DsOxSnsrRatly, EcucPartitionSoftwareComponentInstanceRef=InletPresVlvPosnSnsr, EcucPartitionSoftwareComponentInstanceRef=AuxBattDiag, EcucPartitionSoftwareComponentInstanceRef=BrkPdlPosnSnsrAdcInp, EcucPartitionSoftwareComponentInstanceRef=WgPosn1AdcInpSwc, EcucPartitionSoftwareComponentInstanceRef=EcmOdomEstimr, EcucPartitionSoftwareComponentInstanceRef=EngOilAertnEstimr, EcucPartitionSoftwareComponentInstanceRef=ElecWtrPmpRatly, EcucPartitionSoftwareComponentInstanceRef=ThrInletAirTSnsr, EcucPartitionSoftwareComponentInstanceRef=ClsdLoopFuCtrlEnaTRatly, EcucPartitionSoftwareComponentInstanceRef=EngOilLvlSnsr, EcucPartitionSoftwareComponentInstanceRef=LTLSysCoorr, EcucPartitionSoftwareComponentInstanceRef=KnkLspiReactn, EcucPartitionSoftwareComponentInstanceRef=FuTankPSnsr, EcucPartitionSoftwareComponentInstanceRef=CylPEstimr, EcucPartitionSoftwareComponentInstanceRef=IntkMnfldTSnsr, EcucPartitionSoftwareComponentInstanceRef=BaroPSnsr, EcucPartitionSoftwareComponentInstanceRef=ThRatly, EcucPartitionSoftwareComponentInstanceRef=IntkAirTAdcInpSwc, EcucPartitionSoftwareComponentInstanceRef=CPT_rba_SyC_States_Cfg_3_Q_1, EcucPartitionSoftwareComponentInstanceRef=SteerAgRatly, EcucPartitionSoftwareComponentInstanceRef=ColdCrkCasePSnsrAdcInpSwc, EcucPartitionSoftwareComponentInstanceRef=ThrPosnSnsr2AdcInpSwc, EcucPartitionSoftwareComponentInstanceRef=CatAndUsOxSnsrRatly, EcucPartitionSoftwareComponentInstanceRef=EgrTSnsrRatly, EcucPartitionSoftwareComponentInstanceRef=LoTRadrTSnsrAdcInpSwc, EcucPartitionSoftwareComponentInstanceRef=CoolEgrTAdcInpSwc, EcucPartitionSoftwareComponentInstanceRef=CPT_UEGO_RNernst, EcucPartitionSoftwareComponentInstanceRef=CPT_UEGO_IPmpSeg, EcucPartitionSoftwareComponentInstanceRef=FuPSnsrRatly, EcucPartitionSoftwareComponentInstanceRef=CPT_UEGO_ISrc, EcucPartitionSoftwareComponentInstanceRef=EepNVBlkSwc_Core1, EcucPartitionSoftwareComponentInstanceRef=IdleSpdRatly, EcucPartitionSoftwareComponentInstanceRef=HiTRadrOutlTSnsrAdcInpSwc, EcucPartitionSoftwareComponentInstanceRef=MnfldGasTAdcInpSwc, EcucPartitionSoftwareComponentInstanceRef=CPT_UEGO_Dac, EcucPartitionSoftwareComponentInstanceRef=SwtgOxSnsrDiag, EcucPartitionSoftwareComponentInstanceRef=PrimLinAltRatly, EcucPartitionSoftwareComponentInstanceRef=EssDiSwtEstimr, EcucPartitionSoftwareComponentInstanceRef=IonSnsCoilRatly, EcucPartitionSoftwareComponentInstanceRef=ColdStrtDynCrksftFuCtrlDiagc, EcucPartitionSoftwareComponentInstanceRef=AgsCtrl, EcucPartitionSoftwareComponentInstanceRef=CPT_SWAdp, EcucPartitionSoftwareComponentInstanceRef=BoostTemp1AdcInpSwc, EcucPartitionSoftwareComponentInstanceRef=PedlValSnsr2AdcInpSwc, EcucPartitionSoftwareComponentInstanceRef=CalInp2AdcInpSwc, EcucPartitionSoftwareComponentInstanceRef=AmbTEstimr, EcucPartitionSoftwareComponentInstanceRef=PFIFuRailPressAdcInp, EcucPartitionSoftwareComponentInstanceRef=FuLvlEstimr, EcucPartitionSoftwareComponentInstanceRef=CylDeactvnActrCtrlDiag, EcucPartitionSoftwareComponentInstanceRef=FuPptyEstimr, EcucPartitionSoftwareComponentInstanceRef=ExhPhiSnsrDiag, EcucPartitionSoftwareComponentInstanceRef=DsFuTrimRatly, EcucPartitionSoftwareComponentInstanceRef=DsvlRatly, EcucPartitionSoftwareComponentInstanceRef=BrkSysRatly, EcucPartitionSoftwareComponentInstanceRef=DsvlSolnDiag, EcucPartitionSoftwareComponentInstanceRef=OilShutOffValveFbAdcInp, EcucPartitionSoftwareComponentInstanceRef=CylPhiImbDiagc, EcucPartitionSoftwareComponentInstanceRef=EvapLkChkMonSnsAdcInpSwc, EcucPartitionSoftwareComponentInstanceRef=ThermAxleTSnsr, EcucPartitionSoftwareComponentInstanceRef=InletPresVlvPosnEstimr, EcucPartitionSoftwareComponentInstanceRef=WgPosn2AdcInpSwc, EcucPartitionSoftwareComponentInstanceRef=EngCooltTAdcInpSwc, EcucPartitionSoftwareComponentInstanceRef=ObdStopStrtRespMgr, EcucPartitionSoftwareComponentInstanceRef=CPT_UEGO_O2, EcucPartitionSoftwareComponentInstanceRef=FuLvlSnsr, EcucPartitionSoftwareComponentInstanceRef=C3WVCtrl, EcucPartitionSoftwareComponentInstanceRef=OxSnsrHeatrRatly, EcucPartitionSoftwareComponentInstanceRef=FiveVoltAuxAdcInpSwc, EcucPartitionSoftwareComponentInstanceRef=EngOilLvlEstimr, EcucPartitionSoftwareComponentInstanceRef=CPT_EpmHCaS_SigEval, EcucPartitionSoftwareComponentInstanceRef=CPT_UEGO_ModCtrl, EcucPartitionSoftwareComponentInstanceRef=LoPFuSnsrAdcInpSwc, EcucPartitionSoftwareComponentInstanceRef=TrsmOilTEstimr, EcucPartitionSoftwareComponentInstanceRef=ASnsrRatly, EcucPartitionSoftwareComponentInstanceRef=VehOdomEstimr, EcucPartitionSoftwareComponentInstanceRef=CPT_UEGO_UPmp, EcucPartitionSoftwareComponentInstanceRef=ElecThHeatrCtrl, EcucPartitionSoftwareComponentInstanceRef=CmprOutlTSnsr, EcucPartitionSoftwareComponentInstanceRef=WgRatly, EcucPartitionSoftwareComponentInstanceRef=EgrTSnsr, EcucPartitionSoftwareComponentInstanceRef=CylPmepEstimr, EcucPartitionSoftwareComponentInstanceRef=FuRailHeatrCtrl, EcucPartitionSoftwareComponentInstanceRef=EngOilTSnsr, EcucPartitionSoftwareComponentInstanceRef=FuAgeEstimr, EcucPartitionSoftwareComponentInstanceRef=CPT_EpmHAgClk_Gen, EcucPartitionSoftwareComponentInstanceRef=PwrSplyDiagc, EcucPartitionSoftwareComponentInstanceRef=CPT_UEGO_IPmpRef, EcucPartitionSoftwareComponentInstanceRef=OptmPrpnSysRatDetrmn, EcucPartitionSoftwareComponentInstanceRef=VarSpdFuPmpRatly, EcucPartitionSoftwareComponentInstanceRef=CPT_UEGO_IPmpPck, EcucPartitionSoftwareComponentInstanceRef=StrtrMotRlyRatly, EcucPartitionSoftwareComponentInstanceRef=VehSpdSnsrRatly, EcucPartitionSoftwareComponentInstanceRef=CooltElecPmpCtrl, EcucPartitionSoftwareComponentInstanceRef=LoTRadrCooltTSnsr, EcucPartitionSoftwareComponentInstanceRef=LoTRadrCooltTEstimr, EcucPartitionSoftwareComponentInstanceRef=EthnlConcEstimr, EcucPartitionSoftwareComponentInstanceRef=CmprInletTempAdcInp, EcucPartitionSoftwareComponentInstanceRef=VarGeomTrbFb, EcucPartitionSoftwareComponentInstanceRef=SurgeVlvRatly, EcucPartitionSoftwareComponentInstanceRef=DrvModDetermn, EcucPartitionSoftwareComponentInstanceRef=ReAxleTempSnsrAdcInp, EcucPartitionSoftwareComponentInstanceRef=HiPFuPmpRatly, EcucPartitionSoftwareComponentInstanceRef=BoostTemp2AdcInpSwc, EcucPartitionSoftwareComponentInstanceRef=ThrIntkGasTAdcInpSwc, EcucPartitionSoftwareComponentInstanceRef=TSnsrRatly, EcucPartitionSoftwareComponentInstanceRef=EngSpdConstr, EcucPartitionSoftwareComponentInstanceRef=GdiFuRailP2AdcInpSwc, EcucPartitionSoftwareComponentInstanceRef=EngOilTSnsrDiagc, EcucPartitionSoftwareComponentInstanceRef=ClsdLoopFuCtrlEnaTiRatly, EcucPartitionSoftwareComponentInstanceRef=ThrIntkPAdcInpSwc, EcucPartitionSoftwareComponentInstanceRef=SysU12VoltAdcInpSwc, EcucPartitionSoftwareComponentInstanceRef=ColdStrtCamRatly, EcucPartitionSoftwareComponentInstanceRef=EngCooltTSnsr, EcucPartitionSoftwareComponentInstanceRef=LubCtrlSysCoorr, EcucPartitionSoftwareComponentInstanceRef=CPT_rba_OsArSchedExtn_mcop, EcucPartitionSoftwareComponentInstanceRef=CrksftSpdLimn, EcucPartitionSoftwareComponentInstanceRef=CPT_EGSHeatr_Acttn, EcucPartitionSoftwareComponentInstanceRef=ThrActrCtrlDiag, EcucPartitionSoftwareComponentInstanceRef=FuTankPSnsrAdcInpSwc, EcucPartitionSoftwareComponentInstanceRef=ShutDwnTmrRatly, EcucPartitionSoftwareComponentInstanceRef=CPT_UEGO_RCmp, EcucPartitionSoftwareComponentInstanceRef=C3WVRatly, EcucPartitionSoftwareComponentInstanceRef=CPT_UEGO_TCeramic, EcucPartitionSoftwareComponentInstanceRef=FuTankPEstimr
        EcucPartition_OsApp_2_A_1: EcucPartitionSoftwareComponentInstanceRef=CPT_rba_OsArSchedExtn_mcop
        EcucPartition_OsApp_3_A_1: EcucPartitionSoftwareComponentInstanceRef=CPT_rba_OsArSchedExtn_mcop
