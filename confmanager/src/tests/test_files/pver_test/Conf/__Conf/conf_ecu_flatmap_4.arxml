AUTOSAR XML (schema 00049)
package /RB/PT/PCT_MDG1_FlatMap/FlatMaps
  flat map MDG1_FlatMap
    flat instance descriptor FiM_InhLim_OxSnsrRefVoltCircLoFlt_calibarr: ecu-extract-reference=BSWIB_FiM.FiM_InhLim_OxSnsrRefVoltCircLoFlt_calibarr
