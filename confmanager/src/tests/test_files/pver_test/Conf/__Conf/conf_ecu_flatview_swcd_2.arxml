AUTOSAR XML (schema 00049)
package /RB/PT/PCT_MDG1_FlatView/SwComponentTypes
  composition sw component type MDG1_FlatView
