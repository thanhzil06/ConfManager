AUTOSAR XML (schema 00049)
package /RB/PT/PCT_MDG1_FlatMap/FlatMaps
  flat map MDG1_FlatMap
    flat instance descriptor ESC_dataSyncS0MaxTskLoad: ecu-extract-reference=CPT_MDG1_FlatView.CPT_esc_tasklink.ESC_dataSyncS0MaxTskLoad, variation-point={short-label=ESC_SWTSYNRTMEASMT_SC_EQ_1, sw-syscond=( ( /RB/PT/Common/SwSystemconsts/Adjustables/ESC_SWTSYNRTMEASMT_SC ==1) )}
