AUTOSAR XML (schema 4-2-2)
package /RB/UBK/Project/EcucModuleConfigurationValuess
  module config EcuC
    EcucPartitionCollection
      TestA (EcucPartition): EcucPartitionBswModuleExecution=false, PartitionCanBeRestarted=false
