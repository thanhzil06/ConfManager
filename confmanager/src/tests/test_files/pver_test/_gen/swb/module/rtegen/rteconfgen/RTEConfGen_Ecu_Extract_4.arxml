AUTOSAR XML (schema 00049)
package /RB/PT/PCFG_ECU
  system MDG1_EXTR: category=ECU_EXTRACT
    system mapping SYSMPG_MDG1: sender-receiver-to-signal-group-mapping{data-element=CPT_MDG1_FlatView.Lvl2DataTxSignals.Lvl2SftyComTX_AXLE_TORQUE_FD_1_FD14_Pkt, signal-group=SystemSignalGroup_COM_Tx_AXLE_TORQUE_FD_1_FD14_Pkt, type-mapping=sender-rec-record-type-mapping=record-element-mappings=[{implementation-record-element=CRC_AXLE_TORQUE_FD_1, system-signal=SystemSignal_COM_Tx_CRC_AXLE_TORQUE_FD_1_FD14}, {implementation-record-element=MessageCounter_AXLE_TORQUE_FD_1, system-signal=SystemSignal_COM_Tx_MessageCounter_AXLE_TORQUE_FD_1_FD14}, {implementation-record-element=Rear_Axle_Regen_Capacity, system-signal=SystemSignal_COM_Tx_Rear_Axle_Regen_Capacity_FD14}]}
      sw-impl-mappings:
        swc to impl mapping SwcToImplMapping_AVS_Std: component-implementation=Imp_AVS_Std, component=CPT_MDG1_FlatView.CPT_AVS_Std
