AUTOSAR XML (schema 00049)
package /RB/PT/PCT_MDG1_FlatView/SwComponentTypes
  composition sw component type MDG1_FlatView
    component CPT_ATS_Std: type=ATS_Std
    connect CPT_ESC_OsTskActvnHndlr.PP_ESC_OsTskActvnHndlr_AgEveE0_TRIGSRC -> CPT_rba_OsArSchedExtn_mcop.RP_ESC_OsTskActvnHndlr_AgEveE0_TRIGSRC
