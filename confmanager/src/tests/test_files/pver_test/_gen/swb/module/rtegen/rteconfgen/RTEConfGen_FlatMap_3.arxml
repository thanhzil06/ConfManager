AUTOSAR XML (schema 00049)
package /RB/PT/PCT_MDG1_FlatMap/FlatMaps
  flat map MDG1_FlatMap
    flat instance descriptor AC_CluRlyDigOutp: upstream-reference=RootProject.TopLvlComposition.CPT_IoSigDioOutp_SwSStellantisCmpstn.AC_CluRlyDigOutp, ecu-extract-reference=CPT_MDG1_FlatView.AC_CluRlyDigOutp
    flat instance descriptor FiM_InhLim_OxSnsrHtrUsBnk2CircLoFlt_calibarr: ecu-extract-reference=BSWIB_FiM.FiM_InhLim_OxSnsrHtrUsBnk2CircLoFlt_calibarr
