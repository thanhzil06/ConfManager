AUTOSAR XML (schema 4-3-0)
package /RB/PT/PCT_MDG1_FlatView/SwComponentTypes
  composition sw component type MDG1_FlatView
    component CPT_ATS_Std: type=ATS_Std
    component CPT_AVS_Std: type=AVS_Std
    component CPT_BGTHDEV: type=BGTHDEV
    connect CPT_ESC_OsTskActvnHndlr.PP_ESC_OsTskActvnHndlr_AgEveE0_TRIGSRC -> CPT_SWAdp.RP_ESC_OsTskActvnHndlr_AgEveE0_TRIGSRC
    connect CPT_ESC_OsTskActvnHndlr.PP_ESC_OsTskActvnHndlr_AgEveE0_TRIGSRC -> CPT_rba_OsArSchedExtn_mcop.RP_ESC_OsTskActvnHndlr_AgEveE0_TRIGSRC
