AUTOSAR XML (schema 4-3-0)
package /RB/PT/PCFG_ECU
  system MDG1_EXTR: category=ECU_EXTRACT
    system mapping SYSMPG_MDG1
      sw-mappings:
        swc to ecu mapping SwcToEcuMapping_0: component=CPT_MDG1_FlatView.AMTR, ecu-instance=MDG1
