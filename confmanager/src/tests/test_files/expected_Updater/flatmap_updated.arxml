AUTOSAR XML (schema 4-3-0)
package /RB/PT/PCT_MDG1_FlatMap/FlatMaps
  flat map MDG1_FlatMap
    flat instance descriptor FiM_InhLim_OxSnsrRefVoltCircLoFlt_calibarr: ecu-extract-reference=BSWIB_FiM.FiM_InhLim_OxSnsrRefVoltCircLoFlt_calibarr
    flat instance descriptor ESC_agEveE0TskStrt:
      upstream-reference=RootProject.TopLvlComposition.CPT_esc_stack.PP_ESC_agEveE0TskStrt.ESC_agEveE0TskStrt
      ecu-extract-reference=CPT_MDG1_FlatView.CPT_esc_stack.PP_ESC_agEveE0TskStrt.ESC_agEveE0TskStrt
      variation-point={short-label=ESC_NRAGEVEWCYC_SC_NEQ_0_AND_ESC_NRTSKAGEVE_SC_NEQ_0, sw-syscond=( (( /RB/PT/Common/SwSystemconsts/Adjustables/ESC_NRAGEVEWCYC_SC !=0) && ( /RB/PT/Common/SwSystemconsts/Adjustables/ESC_NRTSKAGEVE_SC !=0)) )}
