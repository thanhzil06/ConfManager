AUTOSAR XML (schema 4-3-0)
package /RB/PT/PCFG_ECU
  system MDG1_EXTR: category=ECU_EXTRACT
    system mapping SYSMPG_MDG1: sender-receiver-to-signal-group-mapping{data-element=CPT_MDG1_FlatView.Lvl2DataTxSignals.Lvl2SftyComTX_ENGINE_FD_2_FD14_Pkt, signal-group=SystemSignalGroup_COM_Tx_ENGINE_FD_2_FD14_Pkt, type-mapping=sender-rec-record-type-mapping=record-element-mappings=[{implementation-record-element=EngineSpeed_W, system-signal=SystemSignal_COM_Tx_EngineSpeed_W_FD14}, {implementation-record-element=EngineSts_W, system-signal=SystemSignal_COM_Tx_EngineSts_W_FD14}, {implementation-record-element=GasPedalPosition_W, system-signal=SystemSignal_COM_Tx_GasPedalPosition_W_FD14}]}
      sw-impl-mappings:
        swc to impl mapping SwcToImplMapping_ATS_Std: component-implementation=Imp_ATS_Std, component=CPT_MDG1_FlatView.CPT_ATS_Std
        swc to impl mapping SwcToImplMapping_AVS_Std: component-implementation=Imp_AVS_Std, component=CPT_MDG1_FlatView.CPT_AVS_Std
      sw-mappings:
        swc to ecu mapping SwcToEcuMapping_0: component=CPT_MDG1_FlatView.AMTR, ecu-instance=MDG1
