AUTOSAR XML (schema 4-3-0)
package /RB/PT/PCFG_ECU
  system MDG1_EXTR: category=ECU_EXTRACT
    system mapping SYSMPG_MDG1: sender-receiver-to-signal-mapping{data-element=CPT_MDG1_FlatView.PP_COM_Tx_ENGINE_FD_6_FD16.VD_COM_Tx_CRC_ENGINE6_FD16, system-signal=SystemSignal_COM_Tx_CRC_ENGINE6_FD16}
