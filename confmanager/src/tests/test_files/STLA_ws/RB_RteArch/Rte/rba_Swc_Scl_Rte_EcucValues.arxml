AUTOSAR XML (schema 4-2-2)
package /RB/PT/Project/EcucModuleConfigurationValuess
  module config Rte
    4 x RteSwComponentInstance:
      CPT_ComScl_EngLin_Scl: RteSoftwareComponentInstanceRef=CPT_ComScl_EngLin_Scl
        TE_ComScl_EngLin_Scl_ComScl_Appl_Tx_Proc_10ms (RteEventToTaskMapping):
          RteBswActivationOffset = 0.0
          RteImmediateRestart = false
          RtePositionInTask = 1201
          RteEventRef = TE_ComScl_EngLin_Scl_ComScl_Appl_Tx_Proc_10ms
          RteMappedToTaskRef = OS_1Q1_10ms_Task
        TE_ComScl_EngLin_Scl_ComScl_Appl_Rx_Proc_10ms (RteEventToTaskMapping):
          RteBswActivationOffset = 0.0
          RteImmediateRestart = false
          RtePositionInTask = 1202
          RteEventRef = TE_ComScl_EngLin_Scl_ComScl_Appl_Rx_Proc_10ms
          RteMappedToTaskRef = OS_1Q1_10ms_Task
      CPT_ComScl_NetMtrx_Scl: RteSoftwareComponentInstanceRef=CPT_ComScl_NetMtrx_Scl
        TE_ComScl_NetMtrx_Scl_ComScl_Appl_Tx_Proc_5ms (RteEventToTaskMapping):
          RteBswActivationOffset = 0.0
          RteImmediateRestart = false
          RtePositionInTask = 1203
          RteEventRef = TE_ComScl_NetMtrx_Scl_ComScl_Appl_Tx_Proc_5ms
          RteMappedToTaskRef = OS_0Q1_5ms_Task
        TE_ComScl_NetMtrx_Scl_ComScl_Appl_Rx_Proc_5ms (RteEventToTaskMapping):
          RteBswActivationOffset = 0.0
          RteImmediateRestart = false
          RtePositionInTask = 1204
          RteEventRef = TE_ComScl_NetMtrx_Scl_ComScl_Appl_Rx_Proc_5ms
          RteMappedToTaskRef = OS_0Q1_5ms_Task
      CPT_ComScl_NetMtrx2_Scl: RteSoftwareComponentInstanceRef=CPT_ComScl_NetMtrx2_Scl
        TE_ComScl_NetMtrx2_Scl_ComScl_Appl_Tx_Proc_5ms (RteEventToTaskMapping):
          RteBswActivationOffset = 0.0
          RteImmediateRestart = false
          RtePositionInTask = 1205
          RteEventRef = TE_ComScl_NetMtrx2_Scl_ComScl_Appl_Tx_Proc_5ms
          RteMappedToTaskRef = OS_0Q1_5ms_Task
        TE_ComScl_NetMtrx2_Scl_ComScl_Appl_Rx_Proc_5ms (RteEventToTaskMapping):
          RteBswActivationOffset = 0.0
          RteImmediateRestart = false
          RtePositionInTask = 1206
          RteEventRef = TE_ComScl_NetMtrx2_Scl_ComScl_Appl_Rx_Proc_5ms
          RteMappedToTaskRef = OS_0Q1_5ms_Task
      CPT_ComScl_NetMtrx3_Scl: RteSoftwareComponentInstanceRef=CPT_ComScl_NetMtrx3_Scl
        TE_ComScl_NetMtrx3_Scl_ComScl_Appl_Tx_Proc_5ms (RteEventToTaskMapping):
          RteBswActivationOffset = 0.0
          RteImmediateRestart = false
          RtePositionInTask = 1207
          RteEventRef = TE_ComScl_NetMtrx3_Scl_ComScl_Appl_Tx_Proc_5ms
          RteMappedToTaskRef = OS_0Q1_5ms_Task
        TE_ComScl_NetMtrx3_Scl_ComScl_Appl_Rx_Proc_5ms (RteEventToTaskMapping):
          RteBswActivationOffset = 0.0
          RteImmediateRestart = false
          RtePositionInTask = 1208
          RteEventRef = TE_ComScl_NetMtrx3_Scl_ComScl_Appl_Rx_Proc_5ms
          RteMappedToTaskRef = OS_0Q1_5ms_Task
