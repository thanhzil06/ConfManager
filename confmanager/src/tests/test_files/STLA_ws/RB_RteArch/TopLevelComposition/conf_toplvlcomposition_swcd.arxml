[part 3 of 3]
AUTOSAR XML (schema 4-0-3)
package /RB/PT/PCT_TopLvlComposition/SwComponentTypes  (continued)
  composition sw component type TopLvlComposition  (continued)
    delegate CPT_ComVeh.VeCANR_b_TurtleModeSts_PT_FD3TO <-> outer port VeCANR_b_TurtleModeSts_PT_FD3TO
    delegate CPT_ComVeh.SendCANR_EngLoad_OBD_ePT_FD3Vld <-> outer port SendCANR_EngLoad_OBD_ePT_FD3Vld
    delegate CPT_ComVeh.VeCANR_b_HVBatteryMILReq_FD3 <-> outer port VeCANR_b_HVBatteryMILReq_FD3
    delegate CPT_ComVeh.VeCANR_b_DriveReady_PT_FD3 <-> outer port VeCANR_b_DriveReady_PT_FD3
    delegate CPT_ComVeh.SendCANR_RACE_CLDWN_DEA_TIMEFD3 <-> outer port SendCANR_RACE_CLDWN_DEA_TIMEFD3
    delegate CPT_ComVeh.VeCANR_b_APCM_Rq_PT_FD3TO <-> outer port VeCANR_b_APCM_Rq_PT_FD3TO
    delegate CPT_ComVeh.SendCANR_Selector_SysFailStsFD3Vld <-> outer port SendCANR_Selector_SysFailStsFD3Vld
    delegate CPT_ComVeh.SendCANR_EngCltTmp_FD16Vld <-> outer port SendCANR_EngCltTmp_FD16Vld
    delegate CPT_ComVeh.VeCANR_M_TotalAxle_Rq_BSM_FD3 <-> outer port VeCANR_M_TotalAxle_Rq_BSM_FD3
    delegate CPT_ComVeh.SendCANR_TransWarmUpMin_RPM_FD3 <-> outer port SendCANR_TransWarmUpMin_RPM_FD3
    delegate CPT_ComVeh.VeCANR_y_MC_Hyb_Therm_Cmd_FD16 <-> outer port VeCANR_y_MC_Hyb_Therm_Cmd_FD16
    delegate CPT_ComVeh.SendCANR_TransWarmUpReq_FD16 <-> outer port SendCANR_TransWarmUpReq_FD16
    delegate CPT_ComVeh.SendCANR_EngineOFFTime_FD3 <-> outer port SendCANR_EngineOFFTime_FD3
    delegate CPT_ComVeh.SendCANR_SpStIndRq_FD3 <-> outer port SendCANR_SpStIndRq_FD3
    delegate CPT_ComVeh.SendCANR_EngTqCpbtRefEngSpd_FD3Vld <-> outer port SendCANR_EngTqCpbtRefEngSpd_FD3Vld
    delegate CPT_ComVeh.VeCANR_y_CRC_DRIVETRAIN3_FD3 <-> outer port VeCANR_y_CRC_DRIVETRAIN3_FD3
    delegate CPT_ComVeh.SendCANR_PTO_ENGD_RQ_FD3Vld <-> outer port SendCANR_PTO_ENGD_RQ_FD3Vld
    delegate CPT_ComVeh.SendCANR_ECM_WARN_FD3 <-> outer port SendCANR_ECM_WARN_FD3
    delegate CPT_ComVeh.SendCANR_CRC_ENGINE7_FD16 <-> outer port SendCANR_CRC_ENGINE7_FD16
    delegate CPT_ComVeh.SendCANR_IgnCntrTrue_FD16 <-> outer port SendCANR_IgnCntrTrue_FD16
    delegate CPT_ComVeh.SendCANR_StrPrctnInhibit_FD3 <-> outer port SendCANR_StrPrctnInhibit_FD3
    delegate CPT_ComVeh.SendCANR_MinEngSpdCap_FD16 <-> outer port SendCANR_MinEngSpdCap_FD16
    delegate CPT_ComVeh.VeCANR_f_Blower_Speed_FD3 <-> outer port VeCANR_f_Blower_Speed_FD3
    delegate CPT_ComVeh.SendCANR_EngTqCpbtFrmCntrFD16 <-> outer port SendCANR_EngTqCpbtFrmCntrFD16
    delegate CPT_ComVeh.SendCANR_EngineOFFTime_FD3Vld <-> outer port SendCANR_EngineOFFTime_FD3Vld
    delegate CPT_ComVeh.SendCANR_SelectorSysFailStsFD16Vld <-> outer port SendCANR_SelectorSysFailStsFD16Vld
    delegate CPT_ComVeh.SendCANR_OAT_PT_Est_FD3Vld <-> outer port SendCANR_OAT_PT_Est_FD3Vld
    delegate CPT_ComVeh.SendCANR_ETCFailSts_FD3Vld <-> outer port SendCANR_ETCFailSts_FD3Vld
    delegate CPT_ComVeh.SendCANR_BarPrsAbs_FD3 <-> outer port SendCANR_BarPrsAbs_FD3
    delegate CPT_ComVeh.SendCANR_CldStrtDenominator_FD3Vld <-> outer port SendCANR_CldStrtDenominator_FD3Vld
    delegate CPT_ComVeh.SendCANR_EngineWaterTemp_FD16Vld <-> outer port SendCANR_EngineWaterTemp_FD16Vld
    delegate CPT_ComVeh.SendCANR_MdsAct_FD16Vld <-> outer port SendCANR_MdsAct_FD16Vld
    delegate CPT_ComVeh.SendCANR_EngTqCpbtFrmCntr_FD3Vld <-> outer port SendCANR_EngTqCpbtFrmCntr_FD3Vld
    delegate CPT_ComVeh.SendCANR_AtmrcPressure_W_FD16Vld <-> outer port SendCANR_AtmrcPressure_W_FD16Vld
    delegate CPT_ComVeh.VeCANR_U_ExtrnlTempADVoltageFD3 <-> outer port VeCANR_U_ExtrnlTempADVoltageFD3
    delegate CPT_ComVeh.SendCANR_EB_Stat3_FD3 <-> outer port SendCANR_EB_Stat3_FD3
    delegate CPT_ComVeh.SendCANR_FuelMM_Sts_FD3 <-> outer port SendCANR_FuelMM_Sts_FD3
    delegate CPT_ComVeh.SendCANR_IdleShutDwnApply_FD3 <-> outer port SendCANR_IdleShutDwnApply_FD3
    delegate CPT_ComVeh.SendCANR_PTO_Target_Gear_FD3Vld <-> outer port SendCANR_PTO_Target_Gear_FD3Vld
    delegate CPT_ComVeh.SendCANR_PTO_Target_Gear_FD3 <-> outer port SendCANR_PTO_Target_Gear_FD3
    delegate CPT_ComVeh.SendCANR_PTORemoteRPMMethod_FD3 <-> outer port SendCANR_PTORemoteRPMMethod_FD3
    delegate CPT_ComVeh.SendCANR_LeakTestRequest_FD3Vld <-> outer port SendCANR_LeakTestRequest_FD3Vld
    delegate CPT_ComVeh.VeCANR_b_FOTA_Install_Type_FD3TO <-> outer port VeCANR_b_FOTA_Install_Type_FD3TO
    delegate CPT_ComVeh.SendCANR_CRC_ENGINE8_FD16Vld <-> outer port SendCANR_CRC_ENGINE8_FD16Vld
    delegate CPT_ComVeh.VeCANR_U_RR_Lvl_RawAD_Src_FD3 <-> outer port VeCANR_U_RR_Lvl_RawAD_Src_FD3
    delegate CPT_ComVeh.VeCANR_b_CrankEnable_PT_FD3TO <-> outer port VeCANR_b_CrankEnable_PT_FD3TO
    delegate CPT_ComVeh.SendCANR_PerfShftRq_HUD_FD3Vld <-> outer port SendCANR_PerfShftRq_HUD_FD3Vld
    delegate CPT_ComVeh.VeCANR_T_GPF_T1_TEMP_FD3 <-> outer port VeCANR_T_GPF_T1_TEMP_FD3
    delegate CPT_ComVeh.VeCANR_b_PE_CoolTempOut_FD3TO <-> outer port VeCANR_b_PE_CoolTempOut_FD3TO
    delegate CPT_ComVeh.VeCANR_b_DriveReady_PT_FD3TO <-> outer port VeCANR_b_DriveReady_PT_FD3TO
    delegate CPT_ComVeh.SendCANR_EngCltTmpV_FD3Vld <-> outer port SendCANR_EngCltTmpV_FD3Vld
    delegate CPT_ComVeh.SendCANR_CRC_ENGINE3_FD3 <-> outer port SendCANR_CRC_ENGINE3_FD3
    delegate CPT_ComVeh.SendCANR_PFW_Stat_FD3 <-> outer port SendCANR_PFW_Stat_FD3
    delegate CPT_ComVeh.SendCANR_EngCltTmpV_FD3 <-> outer port SendCANR_EngCltTmpV_FD3
    delegate CPT_ComVeh.SendCANR_CruiseControlSts_FD16 <-> outer port SendCANR_CruiseControlSts_FD16
    delegate CPT_ComVeh.VeCANR_b_FR_Lvl_RawAD_Src_FD3TO <-> outer port VeCANR_b_FR_Lvl_RawAD_Src_FD3TO
    delegate CPT_ComVeh.VeCANR_b_EVCU2_THA_Resp_FD3TO <-> outer port VeCANR_b_EVCU2_THA_Resp_FD3TO
    delegate CPT_ComVeh.SendCANR_CRC_OBDCNTNFRAMEFD16 <-> outer port SendCANR_CRC_OBDCNTNFRAMEFD16
    delegate CPT_ComVeh.SendCANR_SRV_CCV_FLTR_FD3 <-> outer port SendCANR_SRV_CCV_FLTR_FD3
    delegate CPT_ComVeh.SendCANR_FANStatus_FD3Vld <-> outer port SendCANR_FANStatus_FD3Vld
    delegate CPT_ComVeh.SendCANR_RefuelIndication_FD3 <-> outer port SendCANR_RefuelIndication_FD3
    delegate CPT_ComVeh.SendCANR_EngTqCpbtMinRunTqFD16Vld <-> outer port SendCANR_EngTqCpbtMinRunTqFD16Vld
    delegate CPT_ComVeh.VeCANR_b_CRC_Hyb_Therm_Cmd_FD16TO <-> outer port VeCANR_b_CRC_Hyb_Therm_Cmd_FD16TO
    delegate CPT_ComVeh.SendCANR_MC_ENG7_FD16Vld <-> outer port SendCANR_MC_ENG7_FD16Vld
    delegate CPT_ComVeh.SendCANR_PSI_Gr3_RPM_FD3 <-> outer port SendCANR_PSI_Gr3_RPM_FD3
    delegate CPT_ComVeh.VeCANR_b_IMPACTThreshold_FD3TO <-> outer port VeCANR_b_IMPACTThreshold_FD3TO
    delegate CPT_ComVeh.SendCANR_AxleInAir_Stat_FD3 <-> outer port SendCANR_AxleInAir_Stat_FD3
    delegate CPT_ComVeh.SendCANR_Override_FD3 <-> outer port SendCANR_Override_FD3
    delegate CPT_ComVeh.VeCANR_b_WorksitInverterActvFD3TO <-> outer port VeCANR_b_WorksitInverterActvFD3TO
    delegate CPT_ComVeh.VeCANR_b_IMPACTThreshold_FD3 <-> outer port VeCANR_b_IMPACTThreshold_FD3
    delegate CPT_ComVeh.VeCANR_b_VoltBattFailStatus_FD3 <-> outer port VeCANR_b_VoltBattFailStatus_FD3
    delegate CPT_ComVeh.VeCANR_b_Speed_Unit_FD3TO <-> outer port VeCANR_b_Speed_Unit_FD3TO
    delegate CPT_ComVeh.SendCANR_EngineOilLevel_FD3Vld <-> outer port SendCANR_EngineOilLevel_FD3Vld
    delegate CPT_ComVeh.VeCANR_e_TurtleModeSts_PT_FD3 <-> outer port VeCANR_e_TurtleModeSts_PT_FD3
    delegate CPT_ComVeh.SendCANR_PTO_Md_FD3 <-> outer port SendCANR_PTO_Md_FD3
    delegate CPT_ComVeh.SendCANR_CARB_PERM_FD16Vld <-> outer port SendCANR_CARB_PERM_FD16Vld
    delegate CPT_ComVeh.SendCANR_AfterRunReq_FD3Vld <-> outer port SendCANR_AfterRunReq_FD3Vld
    delegate CPT_ComVeh.VeCANR_b_R_CLDWN_ON_OFF_REQFD3TO <-> outer port VeCANR_b_R_CLDWN_ON_OFF_REQFD3TO
    delegate CPT_ComVeh.VeCANR_b_IBS3_SOC_Accuracy_FD3 <-> outer port VeCANR_b_IBS3_SOC_Accuracy_FD3
    delegate CPT_ComVeh.SendCANR_EngTqCpbtyMaxOffTqFD3 <-> outer port SendCANR_EngTqCpbtyMaxOffTqFD3
    delegate CPT_ComVeh.VeCANR_b_DrvAway_Inhibit_PT_FD3 <-> outer port VeCANR_b_DrvAway_Inhibit_PT_FD3
    delegate CPT_ComVeh.SendCANR_PTO_High_Idle_RPM_FD3 <-> outer port SendCANR_PTO_High_Idle_RPM_FD3
    delegate CPT_ComVeh.SendCANR_PTO_AutoRsm_FD3 <-> outer port SendCANR_PTO_AutoRsm_FD3
    delegate CPT_ComVeh.VeCANR_b_Traffic_Sign_Info_FD3TO <-> outer port VeCANR_b_Traffic_Sign_Info_FD3TO
    delegate CPT_ComVeh.VeCANR_e_Right_Button_BCM_FD3 <-> outer port VeCANR_e_Right_Button_BCM_FD3
    delegate CPT_ComVeh.VeCANR_b_FL_Z_Accel_Stat_SrcFD3TO <-> outer port VeCANR_b_FL_Z_Accel_Stat_SrcFD3TO
    delegate CPT_ComVeh.VeCANR_I_AcOutputCurrentSts_FD3 <-> outer port VeCANR_I_AcOutputCurrentSts_FD3
    delegate CPT_ComVeh.SendCANR_StartRlyECMFbFaultFD16 <-> outer port SendCANR_StartRlyECMFbFaultFD16
    delegate CPT_ComVeh.SendCANR_ECM_MSG_RQ_FD3Vld <-> outer port SendCANR_ECM_MSG_RQ_FD3Vld
    delegate CPT_ComVeh.VeCANR_e_PowerShot_BCM_FD3 <-> outer port VeCANR_e_PowerShot_BCM_FD3
    delegate CPT_ComVeh.SendCANR_PSI_Gr4_RPM_FD3 <-> outer port SendCANR_PSI_Gr4_RPM_FD3
    delegate CPT_ComVeh.VeCANR_y_MsgCtr_PT_SYS_FD_1_FD3 <-> outer port VeCANR_y_MsgCtr_PT_SYS_FD_1_FD3
    delegate CPT_ComVeh.VeCANR_b_ChkFuelLevelSts_FD3TO <-> outer port VeCANR_b_ChkFuelLevelSts_FD3TO
    delegate CPT_ComVeh.SendCANR_CruiseCntrlLampStsFD3 <-> outer port SendCANR_CruiseCntrlLampStsFD3
    delegate CPT_ComVeh.SendCANR_BrkSw1Stat_FD3 <-> outer port SendCANR_BrkSw1Stat_FD3
    delegate CPT_ComVeh.SendCANR_Override_FD3Vld <-> outer port SendCANR_Override_FD3Vld
    delegate CPT_ComVeh.VeCANR_b_WTS_LmpRqOn_FD3 <-> outer port VeCANR_b_WTS_LmpRqOn_FD3
    delegate CPT_ComVeh.VeCANR_Pct_HVBatterySOC_FD3 <-> outer port VeCANR_Pct_HVBatterySOC_FD3
    delegate CPT_ComVeh.VeCANR_e_TransWarnings_PT_FD3 <-> outer port VeCANR_e_TransWarnings_PT_FD3
    delegate CPT_ComVeh.VeCANR_b_HybridMILRequest_FD3TO <-> outer port VeCANR_b_HybridMILRequest_FD3TO
    delegate CPT_ComVeh.SendCANR_OAT_PT_EstV_FD16Vld <-> outer port SendCANR_OAT_PT_EstV_FD16Vld
    delegate CPT_ComVeh.VeCANR_l_TotalOdometer_FD3 <-> outer port VeCANR_l_TotalOdometer_FD3
    delegate CPT_ComVeh.VeCANR_T_HeaterCoreInletTempFD3 <-> outer port VeCANR_T_HeaterCoreInletTempFD3
    delegate CPT_ComVeh.VeCANR_e_ITBM_TrlrStat_FD3 <-> outer port VeCANR_e_ITBM_TrlrStat_FD3
    delegate CPT_ComVeh.SendCANR_ServiceHybSys_FD3Vld <-> outer port SendCANR_ServiceHybSys_FD3Vld
    delegate CPT_ComVeh.SendCANR_CompressorSts_FD3Vld <-> outer port SendCANR_CompressorSts_FD3Vld
    delegate CPT_ComVeh.SendCANR_GPFServiceSts_FD3 <-> outer port SendCANR_GPFServiceSts_FD3
    delegate CPT_ComVeh.SendCANR_CRC_ENGINE3_FD3Vld <-> outer port SendCANR_CRC_ENGINE3_FD3Vld
    delegate CPT_ComVeh.VeCANR_b_Hour1_TLM_FD3TO <-> outer port VeCANR_b_Hour1_TLM_FD3TO
    delegate CPT_ComVeh.VeCANR_y_CRC_BCM4_FD3 <-> outer port VeCANR_y_CRC_BCM4_FD3
    delegate CPT_ComVeh.SendCANR_FuelFltrLeft_FD3 <-> outer port SendCANR_FuelFltrLeft_FD3
    delegate CPT_ComVeh.SendCANR_EngTqCapbltyMaxTq_FD3 <-> outer port SendCANR_EngTqCapbltyMaxTq_FD3
    delegate CPT_ComVeh.VeCANR_b_GearEngdForDispPT_FD3TO <-> outer port VeCANR_b_GearEngdForDispPT_FD3TO
    delegate CPT_ComVeh.VeCANR_b_A2D_DRV_TEMP_DR_POSFD3TO <-> outer port VeCANR_b_A2D_DRV_TEMP_DR_POSFD3TO
    delegate CPT_ComVeh.VeCANR_P_HVBatChargePwrLong <-> outer port VeCANR_P_HVBatChargePwrLong
    delegate CPT_ComVeh.VeCANR_e_HVAC_CLNT_FLW_MIN_FD3 <-> outer port VeCANR_e_HVAC_CLNT_FLW_MIN_FD3
    delegate CPT_ComVeh.SendCANR_RawTPS2_FD3Vld <-> outer port SendCANR_RawTPS2_FD3Vld
    delegate CPT_ComVeh.VeCANR_b_CurrBattFailStatus_FD3 <-> outer port VeCANR_b_CurrBattFailStatus_FD3
    delegate CPT_ComVeh.SendCANR_CatTempMaint_FD3 <-> outer port SendCANR_CatTempMaint_FD3
    delegate CPT_ComVeh.SendCANR_OilLifeSts_FD3 <-> outer port SendCANR_OilLifeSts_FD3
    delegate CPT_ComVeh.SendCANR_DefFuelEcon_FD3Vld <-> outer port SendCANR_DefFuelEcon_FD3Vld
    delegate CPT_ComVeh.SendCANR_SEIU_RPM_FD3Vld <-> outer port SendCANR_SEIU_RPM_FD3Vld
    delegate CPT_ComVeh.SendCANR_LeakTestSts_FD3Vld <-> outer port SendCANR_LeakTestSts_FD3Vld
    delegate CPT_ComVeh.SendCANR_EngTqCpbtEngOpMdFD16Vld <-> outer port SendCANR_EngTqCpbtEngOpMdFD16Vld
    delegate CPT_ComVeh.SendCANR_EngineWaterTemp_FD16 <-> outer port SendCANR_EngineWaterTemp_FD16
    delegate CPT_ComVeh.SendCANR_EngCltTmp_FD16 <-> outer port SendCANR_EngCltTmp_FD16
    delegate CPT_ComVeh.VeCANR_b_CRC_PT_SYSTEM_FD_1_FD3TO <-> outer port VeCANR_b_CRC_PT_SYSTEM_FD_1_FD3TO
    delegate CPT_ComVeh.SendCANR_ACPressureFailSts_FD3 <-> outer port SendCANR_ACPressureFailSts_FD3
    delegate CPT_ComVeh.VeCANR_b_Minute1_TLM_FD3TO <-> outer port VeCANR_b_Minute1_TLM_FD3TO
    delegate CPT_ComVeh.SendCANR_PTO_Ramp_Rate_FD3Vld <-> outer port SendCANR_PTO_Ramp_Rate_FD3Vld
    delegate CPT_ComVeh.SendCANR_SEIU_Enbl_FD3 <-> outer port SendCANR_SEIU_Enbl_FD3
    delegate CPT_ComVeh.VeCANR_b_IBS3_SOF_V_Acrcy_FD3TO <-> outer port VeCANR_b_IBS3_SOF_V_Acrcy_FD3TO
    delegate CPT_ComVeh.SendCANR_FuelFltrAck_FD3Vld <-> outer port SendCANR_FuelFltrAck_FD3Vld
    delegate CPT_ComVeh.VeCANR_e_AM_ECM_Trace_FD3 <-> outer port VeCANR_e_AM_ECM_Trace_FD3
    delegate CPT_ComVeh.VeCANR_b_FR_Lvl_Stat_Src_FD3TO <-> outer port VeCANR_b_FR_Lvl_Stat_Src_FD3TO
    delegate CPT_ComVeh.SendCANR_PSI_Gr1_RPM_FD3 <-> outer port SendCANR_PSI_Gr1_RPM_FD3
    delegate CPT_ComVeh.SendCANR_AGS2Posn_FD3 <-> outer port SendCANR_AGS2Posn_FD3
    delegate CPT_ComVeh.SendCANR_CRC_ENGINE1_FD16 <-> outer port SendCANR_CRC_ENGINE1_FD16
    delegate CPT_ComVeh.VeCANR_b_VoltageMax_FD3TO <-> outer port VeCANR_b_VoltageMax_FD3TO
    delegate CPT_ComVeh.SendCANR_ThrottlePosition_FD3Vld <-> outer port SendCANR_ThrottlePosition_FD3Vld
    delegate CPT_ComVeh.VeCANR_y_Minute2_TLM_FD3 <-> outer port VeCANR_y_Minute2_TLM_FD3
    delegate CPT_ComVeh.VeCANR_b_IMMO_SOP_REQUEST_FD3 <-> outer port VeCANR_b_IMMO_SOP_REQUEST_FD3
    delegate CPT_ComVeh.SendCANR_CountDown_FD3 <-> outer port SendCANR_CountDown_FD3
    delegate CPT_ComVeh.VeCANR_b_FL_Lvl_Stat_Src_FD3TO <-> outer port VeCANR_b_FL_Lvl_Stat_Src_FD3TO
    delegate CPT_ComVeh.SendCANR_COOLING_REQ_STATUS_FD3 <-> outer port SendCANR_COOLING_REQ_STATUS_FD3
    delegate CPT_ComVeh.SendCANR_RACE_CLDWN_BAT_STATFD3Vld <-> outer port SendCANR_RACE_CLDWN_BAT_STATFD3Vld
    delegate CPT_ComVeh.VeCANR_b_REPRGDPFCCLR_BPCM_FD3 <-> outer port VeCANR_b_REPRGDPFCCLR_BPCM_FD3
    delegate CPT_ComVeh.VeCANR_b_BCMSAMFailSts_FD3TO <-> outer port VeCANR_b_BCMSAMFailSts_FD3TO
    delegate CPT_ComVeh.SendCANR_ServiceHybSys_FD3 <-> outer port SendCANR_ServiceHybSys_FD3
    delegate CPT_ComVeh.VeCANR_e_FR_Lvl_Stat_Src_FD3 <-> outer port VeCANR_e_FR_Lvl_Stat_Src_FD3
    delegate CPT_ComVeh.SendCANR_WtrFuelIndLmpOnRq_FD3Vld <-> outer port SendCANR_WtrFuelIndLmpOnRq_FD3Vld
    delegate CPT_ComVeh.SendCANR_ENGINE_RESET_FD3 <-> outer port SendCANR_ENGINE_RESET_FD3
    delegate CPT_ComVeh.SendCANR_InpICCFuelEng_Fail_FD3 <-> outer port SendCANR_InpICCFuelEng_Fail_FD3
    delegate CPT_ComVeh.SendCANR_HP_MODE_STS_FD3Vld <-> outer port SendCANR_HP_MODE_STS_FD3Vld
    delegate CPT_ComVeh.SendCANR_SEIU_Sts_FD3Vld <-> outer port SendCANR_SEIU_Sts_FD3Vld
    delegate CPT_ComVeh.SendCANR_AxleInAir_Stat_FD3Vld <-> outer port SendCANR_AxleInAir_Stat_FD3Vld
    delegate CPT_ComVeh.SendCANR_LTR_PumpSpeedAct_FD3 <-> outer port SendCANR_LTR_PumpSpeedAct_FD3
    delegate CPT_ComVeh.VeCANR_U_Battery_Volt_2_FD3 <-> outer port VeCANR_U_Battery_Volt_2_FD3
    delegate CPT_ComVeh.VeCANR_e_New_Spd_Zone_Ind_FD3 <-> outer port VeCANR_e_New_Spd_Zone_Ind_FD3
    delegate CPT_ComVeh.VeCANR_b_WTS_LmpRqOn_FD3TO <-> outer port VeCANR_b_WTS_LmpRqOn_FD3TO
    delegate CPT_ComVeh.VeCANR_b_REPRGDPFCCLR_IDCM_FD3TO <-> outer port VeCANR_b_REPRGDPFCCLR_IDCM_FD3TO
    delegate CPT_ComVeh.SendCANR_EngIntAirTmp_FD3 <-> outer port SendCANR_EngIntAirTmp_FD3
    delegate CPT_ComVeh.VeCANR_b_IBS3_SOF_V_Acrcy_FD3 <-> outer port VeCANR_b_IBS3_SOF_V_Acrcy_FD3
    delegate CPT_ComVeh.SendCANR_PSI_Gr2_RPM_FD3 <-> outer port SendCANR_PSI_Gr2_RPM_FD3
    delegate CPT_ComVeh.VeCANR_I_HVBatteryCurrent_FD3 <-> outer port VeCANR_I_HVBatteryCurrent_FD3
    delegate CPT_ComVeh.VeCANR_b_PSI_Rq_FD3TO <-> outer port VeCANR_b_PSI_Rq_FD3TO
    delegate CPT_ComVeh.VeCANR_e_Trns_DrvMdReq_BCM_FD3 <-> outer port VeCANR_e_Trns_DrvMdReq_BCM_FD3
    delegate CPT_ComVeh.VeCANR_U_VoltageMax_FD3 <-> outer port VeCANR_U_VoltageMax_FD3
    delegate CPT_ComVeh.SendCANR_StrtRlyECMFdbckFltFD3 <-> outer port SendCANR_StrtRlyECMFdbckFltFD3
    delegate CPT_ComVeh.VeCANR_b_IBS3_FLAG_DISCONNCTFD3 <-> outer port VeCANR_b_IBS3_FLAG_DISCONNCTFD3
    delegate CPT_ComVeh.SendCANR_CRC_ENGINE6_FD16 <-> outer port SendCANR_CRC_ENGINE6_FD16
    delegate CPT_ComVeh.SendCANR_PTOHighIdleEnable_FD3 <-> outer port SendCANR_PTOHighIdleEnable_FD3
    delegate CPT_ComVeh.SendCANR_SpStSwStat_FD16Vld <-> outer port SendCANR_SpStSwStat_FD16Vld
    delegate CPT_ComVeh.SendCANR_EngOilTempFD16 <-> outer port SendCANR_EngOilTempFD16
    delegate CPT_ComVeh.SendCANR_EngineMntnSts_FD3Vld <-> outer port SendCANR_EngineMntnSts_FD3Vld
    delegate CPT_ComVeh.VeCANR_b_RsErrIBS3_FD3TO <-> outer port VeCANR_b_RsErrIBS3_FD3TO
    delegate CPT_ComVeh.SendCANR_EngMaxRPM_W_FD16Vld <-> outer port SendCANR_EngMaxRPM_W_FD16Vld
    delegate CPT_ComVeh.SendCANR_ExhaustTemperature_FD3Vld <-> outer port SendCANR_ExhaustTemperature_FD3Vld
    delegate CPT_ComVeh.VeCANR_d_Z_Aclrn_FL_Src_FD3 <-> outer port VeCANR_d_Z_Aclrn_FL_Src_FD3
    delegate CPT_ComVeh.SendCANR_FuelFltrAck_FD3 <-> outer port SendCANR_FuelFltrAck_FD3
    delegate CPT_ComVeh.SendCANR_PreHtlmpEVICOnRq_FD3 <-> outer port SendCANR_PreHtlmpEVICOnRq_FD3
    delegate CPT_ComVeh.SendCANR_PF_RgnActv_FD3 <-> outer port SendCANR_PF_RgnActv_FD3
    delegate CPT_ComVeh.VeCANR_e_RR_Lvl_Stat_Src_FD3 <-> outer port VeCANR_e_RR_Lvl_Stat_Src_FD3
    delegate CPT_ComVeh.SendCANR_SpStSwStat_FD3Vld <-> outer port SendCANR_SpStSwStat_FD3Vld
    delegate CPT_ComVeh.VeCANR_q_IBS3_SOH_Q_FD3 <-> outer port VeCANR_q_IBS3_SOH_Q_FD3
    delegate CPT_ComVeh.SendCANR_InpICCFuelEng_Fail_FD3Vld <-> outer port SendCANR_InpICCFuelEng_Fail_FD3Vld
    delegate CPT_ComVeh.VeCANR_I_IBS3_Ibatt_FD3 <-> outer port VeCANR_I_IBS3_Ibatt_FD3
    delegate CPT_ComVeh.VeCANR_b_AcOutputCurrentSts_FD3TO <-> outer port VeCANR_b_AcOutputCurrentSts_FD3TO
    delegate CPT_ComVeh.VeCANR_y_Year2_TLM_FD3 <-> outer port VeCANR_y_Year2_TLM_FD3
    delegate CPT_ComVeh.SendCANR_RawTPS1_FD3Vld <-> outer port SendCANR_RawTPS1_FD3Vld
    delegate CPT_ComVeh.SendCANR_HighPresrFuelSysFlrFD3 <-> outer port SendCANR_HighPresrFuelSysFlrFD3
    delegate CPT_ComVeh.VeCANR_b_DrvrRqdAxTrqBSM_FD3TO <-> outer port VeCANR_b_DrvrRqdAxTrqBSM_FD3TO
    delegate CPT_ComVeh.SendCANR_Adblue_Stat_FD3 <-> outer port SendCANR_Adblue_Stat_FD3
    delegate CPT_ComVeh.SendCANR_PSI_Gr1_RPM_FD3Vld <-> outer port SendCANR_PSI_Gr1_RPM_FD3Vld
    delegate CPT_ComVeh.VeCANR_Pct_RadiatorFanSts_FD3 <-> outer port VeCANR_Pct_RadiatorFanSts_FD3
    delegate CPT_ComVeh.VeCANR_b_HAS_SoH_PT_FD3 <-> outer port VeCANR_b_HAS_SoH_PT_FD3
    delegate CPT_ComVeh.VeCANR_e_TargetGear_PT_FD3 <-> outer port VeCANR_e_TargetGear_PT_FD3
    delegate CPT_ComVeh.SendCANR_EngineMntnSts_FD3 <-> outer port SendCANR_EngineMntnSts_FD3
    delegate CPT_ComVeh.VeCANR_U_FR_Lvl_RawAD_Src_FD3 <-> outer port VeCANR_U_FR_Lvl_RawAD_Src_FD3
    delegate CPT_ComVeh.SendCANR_EngOffTmPT_FD16 <-> outer port SendCANR_EngOffTmPT_FD16
    delegate CPT_ComVeh.SendCANR_EngineOFFTime_FD16Vld <-> outer port SendCANR_EngineOFFTime_FD16Vld
    delegate CPT_ComVeh.SendCANR_ETCFailSts_FD3 <-> outer port SendCANR_ETCFailSts_FD3
    delegate CPT_ComVeh.SendCANR_PTO_MaxVehSpd_FD3Vld <-> outer port SendCANR_PTO_MaxVehSpd_FD3Vld
    delegate CPT_ComVeh.SendCANR_OilLifeLeft_FD3 <-> outer port SendCANR_OilLifeLeft_FD3
    delegate CPT_ComVeh.VeCANR_b_ParkingSts_PT_FD3TO <-> outer port VeCANR_b_ParkingSts_PT_FD3TO
    delegate CPT_ComVeh.SendCANR_CldStrtDenominator_FD3 <-> outer port SendCANR_CldStrtDenominator_FD3
    delegate CPT_ComVeh.SendCANR_TerrainModeStat_ECMFD3Vld <-> outer port SendCANR_TerrainModeStat_ECMFD3Vld
    delegate CPT_ComVeh.VeCANR_b_FUEL_VOLT2_FD3TO <-> outer port VeCANR_b_FUEL_VOLT2_FD3TO
    delegate CPT_ComVeh.SendCANR_LgsDiagCldStrCndMetFD3Vld <-> outer port SendCANR_LgsDiagCldStrCndMetFD3Vld
    delegate CPT_ComVeh.SendCANR_SAMInfo_FD3Vld <-> outer port SendCANR_SAMInfo_FD3Vld
    delegate CPT_ComVeh.SendCANR_PTO_TYPES_FD3Vld <-> outer port SendCANR_PTO_TYPES_FD3Vld
    delegate CPT_ComVeh.VeCANR_e_IgnPosSts_FD3 <-> outer port VeCANR_e_IgnPosSts_FD3
    delegate CPT_ComVeh.VeCANR_b_GearIndcnSts_PT_FD3TO <-> outer port VeCANR_b_GearIndcnSts_PT_FD3TO
    delegate CPT_ComVeh.SendCANR_LgsDiagStdCdFltPrs_FD3Vld <-> outer port SendCANR_LgsDiagStdCdFltPrs_FD3Vld
    delegate CPT_ComVeh.SendCANR_PSI_Gr3_RPM_FD3Vld <-> outer port SendCANR_PSI_Gr3_RPM_FD3Vld
    delegate CPT_ComVeh.VeCANR_b_PSI_RPM_Reset_FD3TO <-> outer port VeCANR_b_PSI_RPM_Reset_FD3TO
    delegate CPT_ComVeh.VeCANR_b_HVBatteryMILReq_FD3TO <-> outer port VeCANR_b_HVBatteryMILReq_FD3TO
    delegate CPT_ComVeh.SendCANR_BoostVacGauge_FD3 <-> outer port SendCANR_BoostVacGauge_FD3
    delegate CPT_ComVeh.SendCANR_CRC_ENGINE1_FD16Vld <-> outer port SendCANR_CRC_ENGINE1_FD16Vld
    delegate CPT_ComVeh.VeCANR_b_Trns_DrvMdReq_BCM_FD3TO <-> outer port VeCANR_b_Trns_DrvMdReq_BCM_FD3TO
    delegate CPT_ComVeh.VeCANR_b_BlowerDiagnosticsFD3TO <-> outer port VeCANR_b_BlowerDiagnosticsFD3TO
    delegate CPT_ComVeh.SendCANR_PTO_Active_FD3 <-> outer port SendCANR_PTO_Active_FD3
    delegate CPT_ComVeh.SendCANR_ThrmlMngmtActvW_FD3 <-> outer port SendCANR_ThrmlMngmtActvW_FD3
    delegate CPT_ComVeh.SendCANR_VehicleSetSpeed_W_FD16 <-> outer port SendCANR_VehicleSetSpeed_W_FD16
    delegate CPT_ComVeh.VeCANR_b_PSI_Gr2_RPM_SET_FD3TO <-> outer port VeCANR_b_PSI_Gr2_RPM_SET_FD3TO
    delegate CPT_ComVeh.VeCANR_b_REPRGDPFCCLR_IDCM_FD3 <-> outer port VeCANR_b_REPRGDPFCCLR_IDCM_FD3
    delegate CPT_ComVeh.SendCANR_MC_ENGINE3_FD16 <-> outer port SendCANR_MC_ENGINE3_FD16
    delegate CPT_ComVeh.SendCANR_EngTqCpbtyMinRunTqFD3Vld <-> outer port SendCANR_EngTqCpbtyMinRunTqFD3Vld
    delegate CPT_ComVeh.SendCANR_EngineWaterTemp_FD3Vld <-> outer port SendCANR_EngineWaterTemp_FD3Vld
    delegate CPT_ComVeh.SendCANR_PTO_RPM2_FD3 <-> outer port SendCANR_PTO_RPM2_FD3
    delegate CPT_ComVeh.SendCANR_EngTqCapbltyMinTqFD16Vld <-> outer port SendCANR_EngTqCapbltyMinTqFD16Vld
    delegate CPT_ComVeh.SendCANR_CarbWarmUp_FD16 <-> outer port SendCANR_CarbWarmUp_FD16
    delegate CPT_ComVeh.VeCANR_b_TransFailSts_PT_FD3TO <-> outer port VeCANR_b_TransFailSts_PT_FD3TO
    delegate CPT_ComVeh.SendCANR_EstCatCnvTmp_FD3Vld <-> outer port SendCANR_EstCatCnvTmp_FD3Vld
    delegate CPT_ComVeh.SendCANR_TrnModeStat_ECMFD16Vld <-> outer port SendCANR_TrnModeStat_ECMFD16Vld
    delegate CPT_ComVeh.SendCANR_SEIU_Sts_FD3 <-> outer port SendCANR_SEIU_Sts_FD3
    delegate CPT_ComVeh.SendCANR_OIL_PRESS_FD3Vld <-> outer port SendCANR_OIL_PRESS_FD3Vld
    delegate CPT_ComVeh.SendCANR_LTR_PumpSpeedAct_FD3Vld <-> outer port SendCANR_LTR_PumpSpeedAct_FD3Vld
    delegate CPT_ComVeh.SendCANR_MsgCtr_ENGINE6_FD16Vld <-> outer port SendCANR_MsgCtr_ENGINE6_FD16Vld
    delegate CPT_ComVeh.SendCANR_MC_ENG7_FD16 <-> outer port SendCANR_MC_ENG7_FD16
    delegate CPT_ComVeh.VeCANR_P_ElecCoolantHtrPwr_FD3 <-> outer port VeCANR_P_ElecCoolantHtrPwr_FD3
    delegate CPT_ComVeh.SendCANR_AGSposn_FD3 <-> outer port SendCANR_AGSposn_FD3
    delegate CPT_ComVeh.SendCANR_SAMInfo_FD3 <-> outer port SendCANR_SAMInfo_FD3
    delegate CPT_ComVeh.VeCANR_b_HVBatteryCurrent_FD3TO <-> outer port VeCANR_b_HVBatteryCurrent_FD3TO
    delegate CPT_ComVeh.VeCANR_b_HAS_SoH_PT_FD3TO <-> outer port VeCANR_b_HAS_SoH_PT_FD3TO
    delegate CPT_ComVeh.VeCANR_n_PSI_Gr4_RPM_SET_FD3 <-> outer port VeCANR_n_PSI_Gr4_RPM_SET_FD3
    delegate CPT_ComVeh.VeCANR_U_FUEL_VOLT_FD3 <-> outer port VeCANR_U_FUEL_VOLT_FD3
    delegate CPT_ComVeh.SendCANR_EngTqACCCapabilityFD3Vld <-> outer port SendCANR_EngTqACCCapabilityFD3Vld
    delegate CPT_ComVeh.SendCANR_ECM_TRSC_Resp_FD3 <-> outer port SendCANR_ECM_TRSC_Resp_FD3
    delegate CPT_ComVeh.VeCANR_b_ESS_RqShftPark_PT_FD3TO <-> outer port VeCANR_b_ESS_RqShftPark_PT_FD3TO
    delegate CPT_ComVeh.VeCANR_b_HVBatterySOCV_FD3TO <-> outer port VeCANR_b_HVBatterySOCV_FD3TO
    delegate CPT_ComVeh.VeCANR_n_J1939_RPM_RQ_FD3 <-> outer port VeCANR_n_J1939_RPM_RQ_FD3
    delegate CPT_ComVeh.VeCANR_b_HVBatDischargePwrLongV_TO <-> outer port VeCANR_b_HVBatDischargePwrLongV_TO
    delegate CPT_ComVeh.VeCANR_b_FOTA_Status_FD3TO <-> outer port VeCANR_b_FOTA_Status_FD3TO
    delegate CPT_ComVeh.SendCANR_RefuelEvent_FD3 <-> outer port SendCANR_RefuelEvent_FD3
    delegate CPT_ComVeh.VeCANR_e_PSI_Rq_FD3 <-> outer port VeCANR_e_PSI_Rq_FD3
    delegate CPT_ComVeh.VeCANR_n_PSI_Gr5_RPM_SET_FD3 <-> outer port VeCANR_n_PSI_Gr5_RPM_SET_FD3
    delegate CPT_ComVeh.SendCANR_PTO_Incab_FD3Vld <-> outer port SendCANR_PTO_Incab_FD3Vld
    delegate CPT_ComVeh.SendCANR_MinEngSpdCap_FD16Vld <-> outer port SendCANR_MinEngSpdCap_FD16Vld
    delegate CPT_ComVeh.SendCANR_OAT_PT_EstV_FD16 <-> outer port SendCANR_OAT_PT_EstV_FD16
    delegate CPT_ComVeh.SendCANR_EngCltTmpV_FD16Vld <-> outer port SendCANR_EngCltTmpV_FD16Vld
    delegate CPT_ComVeh.VeCANR_b_PTO_IdleSpd2_FD3 <-> outer port VeCANR_b_PTO_IdleSpd2_FD3
    delegate CPT_ComVeh.SendCANR_ECM_THA_Resp_FD3Vld <-> outer port SendCANR_ECM_THA_Resp_FD3Vld
    delegate CPT_ComVeh.VeCANR_e_LaunchRPM_Sel_Sett2FD3 <-> outer port VeCANR_e_LaunchRPM_Sel_Sett2FD3
    delegate CPT_ComVeh.VeCANR_b_Z_Aclrn_RC_Src_FD3TO <-> outer port VeCANR_b_Z_Aclrn_RC_Src_FD3TO
    delegate CPT_ComVeh.SendCANR_Trns_DrvMdReq_ECM_FD16 <-> outer port SendCANR_Trns_DrvMdReq_ECM_FD16
    delegate CPT_ComVeh.VeCANR_e_SPMControlSts_FD3 <-> outer port VeCANR_e_SPMControlSts_FD3
    delegate CPT_ComVeh.SendCANR_EngOffTmPTV_FD16Vld <-> outer port SendCANR_EngOffTmPTV_FD16Vld
    delegate CPT_ComVeh.SendCANR_ECM_HMI_Timer_RQ_FD3Vld <-> outer port SendCANR_ECM_HMI_Timer_RQ_FD3Vld
    delegate CPT_ComVeh.VeCANR_e_ASCM_Stat_FD3 <-> outer port VeCANR_e_ASCM_Stat_FD3
    delegate CPT_ComVeh.VeCANR_b_RadiatorFanSts_FD3TO <-> outer port VeCANR_b_RadiatorFanSts_FD3TO
    delegate CPT_ComVeh.SendCANR_EngTqCpbtyMaxOffTqFD3Vld <-> outer port SendCANR_EngTqCpbtyMaxOffTqFD3Vld
    delegate CPT_ComVeh.VeCANR_b_Launch_SftBtnstatusFD3TO <-> outer port VeCANR_b_Launch_SftBtnstatusFD3TO
    delegate CPT_ComVeh.SendCANR_ECM_THA_Resp_FD3 <-> outer port SendCANR_ECM_THA_Resp_FD3
    delegate CPT_ComVeh.VeCANR_b_LwsAngle_SCCM_FD3TO <-> outer port VeCANR_b_LwsAngle_SCCM_FD3TO
    delegate CPT_ComVeh.SendCANR_KNK_MG_TRIGGER_FD3Vld <-> outer port SendCANR_KNK_MG_TRIGGER_FD3Vld
    delegate CPT_ComVeh.SendCANR_Adblue_Stat_FD3Vld <-> outer port SendCANR_Adblue_Stat_FD3Vld
    delegate CPT_ComVeh.VeCANR_e_FL_Z_Accel_Stat_SrcFD3 <-> outer port VeCANR_e_FL_Z_Accel_Stat_SrcFD3
    delegate CPT_ComVeh.SendCANR_LoadOBD_FD16 <-> outer port SendCANR_LoadOBD_FD16
    delegate CPT_ComVeh.VeCANR_y_Year1_TLM_FD3 <-> outer port VeCANR_y_Year1_TLM_FD3
    delegate CPT_ComVeh.SendCANR_TransWarmUpReq_FD3 <-> outer port SendCANR_TransWarmUpReq_FD3
    delegate CPT_ComVeh.VeCANR_n_PSI_Gr3_RPM_SET_FD3 <-> outer port VeCANR_n_PSI_Gr3_RPM_SET_FD3
    delegate CPT_ComVeh.SendCANR_LeakCheckTimerValueFD3Vld <-> outer port SendCANR_LeakCheckTimerValueFD3Vld
    delegate CPT_ComVeh.VeCANR_b_GPF_T1_TEMP_FD3TO <-> outer port VeCANR_b_GPF_T1_TEMP_FD3TO
    delegate CPT_ComVeh.VeCANR_b_HTShtOffVlvReq_FD3TO <-> outer port VeCANR_b_HTShtOffVlvReq_FD3TO
    delegate CPT_ComVeh.SendCANR_BrkSw1Stat_FD3Vld <-> outer port SendCANR_BrkSw1Stat_FD3Vld
    delegate CPT_ComVeh.VeCANR_U_IBS3_SOF_VC_FD3 <-> outer port VeCANR_U_IBS3_SOF_VC_FD3
    delegate CPT_ComVeh.VeCANR_b_IBS3_SOC_Accuracy_FD3TO <-> outer port VeCANR_b_IBS3_SOC_Accuracy_FD3TO
    delegate CPT_ComVeh.VeCANR_b_BCMSAMFailSts_FD3 <-> outer port VeCANR_b_BCMSAMFailSts_FD3
    delegate CPT_ComVeh.SendCANR_GPFServiceSts_FD3Vld <-> outer port SendCANR_GPFServiceSts_FD3Vld
    delegate CPT_ComVeh.VeCANR_P_DriverPowerReq_PT_FD3 <-> outer port VeCANR_P_DriverPowerReq_PT_FD3
    delegate CPT_ComVeh.SendCANR_MC_ENG8_FD16 <-> outer port SendCANR_MC_ENG8_FD16
    delegate CPT_ComVeh.VeCANR_y_MessageCounter_BCM4FD3 <-> outer port VeCANR_y_MessageCounter_BCM4FD3
    delegate CPT_ComVeh.VeCANR_b_PSI_Gr5_RPM_SET_FD3TO <-> outer port VeCANR_b_PSI_Gr5_RPM_SET_FD3TO
    delegate CPT_ComVeh.SendCANR_ACPressureFailSts_FD3Vld <-> outer port SendCANR_ACPressureFailSts_FD3Vld
    delegate CPT_ComVeh.VeCANR_Pct_PECP2_PumpSpdAct_FD3 <-> outer port VeCANR_Pct_PECP2_PumpSpdAct_FD3
    delegate CPT_ComVeh.SendCANR_ECM_HoodAjar_FD3 <-> outer port SendCANR_ECM_HoodAjar_FD3
    delegate CPT_ComVeh.SendCANR_CruiseControlSts_FD3Vld <-> outer port SendCANR_CruiseControlSts_FD3Vld
    delegate CPT_ComVeh.SendCANR_PSI_Max_RPM_FD3 <-> outer port SendCANR_PSI_Max_RPM_FD3
    delegate CPT_ComVeh.SendCANR_EngOffTmPT_FD3Vld <-> outer port SendCANR_EngOffTmPT_FD3Vld
    delegate CPT_ComVeh.VeCANR_b_RL_Lvl_Stat_Src_FD3TO <-> outer port VeCANR_b_RL_Lvl_Stat_Src_FD3TO
    delegate CPT_ComVeh.SendCANR_PTO_SingleRPM_FD3Vld <-> outer port SendCANR_PTO_SingleRPM_FD3Vld
    delegate CPT_ComVeh.SendCANR_Inp_ICC_Fail_FD16 <-> outer port SendCANR_Inp_ICC_Fail_FD16
    delegate CPT_ComVeh.SendCANR_EngTqCapbltyMinTq_FD3Vld <-> outer port SendCANR_EngTqCapbltyMinTq_FD3Vld
    delegate CPT_ComVeh.VeCANR_b_FuelFltrRst_FD3 <-> outer port VeCANR_b_FuelFltrRst_FD3
    delegate CPT_ComVeh.SendCANR_PTO_Active_FD3Vld <-> outer port SendCANR_PTO_Active_FD3Vld
    delegate CPT_ComVeh.SendCANR_PTO_High_Idle_RPM_FD3Vld <-> outer port SendCANR_PTO_High_Idle_RPM_FD3Vld
    delegate CPT_ComVeh.SendCANR_EngTqCapbltyMaxTqFD16 <-> outer port SendCANR_EngTqCapbltyMaxTqFD16
    delegate CPT_ComVeh.SendCANR_DrvAway_Inhibit_FD3 <-> outer port SendCANR_DrvAway_Inhibit_FD3
    delegate CPT_ComVeh.SendCANR_MC_OBDCONTENTFRAMEFD16 <-> outer port SendCANR_MC_OBDCONTENTFRAMEFD16
    delegate CPT_ComVeh.SendCANR_SpStIndRq_FD3Vld <-> outer port SendCANR_SpStIndRq_FD3Vld
    delegate CPT_ComVeh.SendCANR_DistOilLifeRst_FD3Vld <-> outer port SendCANR_DistOilLifeRst_FD3Vld
    delegate CPT_ComVeh.SendCANR_PreHtIndLmp_On_Rq <-> outer port SendCANR_PreHtIndLmp_On_Rq
    delegate CPT_ComVeh.SendCANR_LeakTestSts_FD3 <-> outer port SendCANR_LeakTestSts_FD3
    delegate CPT_ComVeh.SendCANR_LeakTestRequest_FD3 <-> outer port SendCANR_LeakTestRequest_FD3
    delegate CPT_ComVeh.VeCANR_b_Battery_Volt_1_FD3TO <-> outer port VeCANR_b_Battery_Volt_1_FD3TO
    delegate CPT_ComVeh.SendCANR_EngTqCapbltyMaxTq_FD3Vld <-> outer port SendCANR_EngTqCapbltyMaxTq_FD3Vld
    delegate CPT_ComVeh.VeCANR_e_APCM_Rq_PT_FD3 <-> outer port VeCANR_e_APCM_Rq_PT_FD3
    delegate CPT_ComVeh.SendCANR_EB_Pwr_FD3Vld <-> outer port SendCANR_EB_Pwr_FD3Vld
    delegate CPT_ComVeh.VeCANR_b_PTO_IdleSpd2_FD3TO <-> outer port VeCANR_b_PTO_IdleSpd2_FD3TO
    delegate CPT_ComVeh.VeCANR_e_Not_OK_To_Race_FD3 <-> outer port VeCANR_e_Not_OK_To_Race_FD3
    delegate CPT_ComVeh.VeCANR_b_IBS3_SOH_Q_FD3TO <-> outer port VeCANR_b_IBS3_SOH_Q_FD3TO
    delegate CPT_ComVeh.VeCANR_b_PtPrplsnActv_PT_FD3 <-> outer port VeCANR_b_PtPrplsnActv_PT_FD3
    delegate CPT_ComVeh.SendCANR_ServiceHybSys_FD16Vld <-> outer port SendCANR_ServiceHybSys_FD16Vld
    delegate CPT_ComVeh.SendCANR_RACE_CLDWN_BAT_STATFD3 <-> outer port SendCANR_RACE_CLDWN_BAT_STATFD3
    delegate CPT_ComVeh.SendCANR_EngTqCpbtEngOpMdFD16 <-> outer port SendCANR_EngTqCpbtEngOpMdFD16
    delegate CPT_ComVeh.SendCANR_DrvAway_Alert_FD3Vld <-> outer port SendCANR_DrvAway_Alert_FD3Vld
    delegate CPT_ComVeh.VeCANR_b_DrvAway_Inhibit_PT_FD3TO <-> outer port VeCANR_b_DrvAway_Inhibit_PT_FD3TO
    delegate CPT_ComVeh.VeCANR_Pct_AirflowRequest_FD3 <-> outer port VeCANR_Pct_AirflowRequest_FD3
    delegate CPT_ComVeh.VeCANR_b_Hour2_TLM_FD3TO <-> outer port VeCANR_b_Hour2_TLM_FD3TO
    delegate CPT_ComVeh.SendCANR_TransWarmUpMin_RPMFD16 <-> outer port SendCANR_TransWarmUpMin_RPMFD16
    delegate CPT_ComVeh.VeCANR_e_TCASERANGESTATUS_FD3 <-> outer port VeCANR_e_TCASERANGESTATUS_FD3
    delegate CPT_ComVeh.VeCANR_y_Year3_TLM_FD3 <-> outer port VeCANR_y_Year3_TLM_FD3
    delegate CPT_ComVeh.SendCANR_ECM_FOTA_Conflict_FD3Vld <-> outer port SendCANR_ECM_FOTA_Conflict_FD3Vld
    delegate CPT_ComVeh.SendCANR_EngLoad_OBD_ePT_FD3 <-> outer port SendCANR_EngLoad_OBD_ePT_FD3
    delegate CPT_ComVeh.SendCANR_EngIntAirTmp_FD3Vld <-> outer port SendCANR_EngIntAirTmp_FD3Vld
    delegate CPT_ComVeh.SendCANR_PTO_RPM2_FD3Vld <-> outer port SendCANR_PTO_RPM2_FD3Vld
    delegate CPT_ComVeh.VeCANR_b_MC_Hyb_Therm_Cmd_FD16TO <-> outer port VeCANR_b_MC_Hyb_Therm_Cmd_FD16TO
    delegate CPT_ComVeh.SendCANR_PSI_Gr5_RPM_FD3 <-> outer port SendCANR_PSI_Gr5_RPM_FD3
    delegate CPT_ComVeh.VeCANR_b_IgnPosSts_FD3TO <-> outer port VeCANR_b_IgnPosSts_FD3TO
    delegate CPT_ComVeh.VeCANR_b_ParkingFailSts_PT_FD3TO <-> outer port VeCANR_b_ParkingFailSts_PT_FD3TO
    delegate CPT_ComVeh.VeCANR_b_IMPACTCommand_FD3TO <-> outer port VeCANR_b_IMPACTCommand_FD3TO
    delegate CPT_ComVeh.SendCANR_PSI_Gr4_RPM_FD3Vld <-> outer port SendCANR_PSI_Gr4_RPM_FD3Vld
    delegate CPT_ComVeh.SendCANR_ESP_TrqRqEnabl_FD3Vld <-> outer port SendCANR_ESP_TrqRqEnabl_FD3Vld
    delegate CPT_ComVeh.SendCANR_PerfShftRq_HUD_FD3 <-> outer port SendCANR_PerfShftRq_HUD_FD3
    delegate CPT_ComVeh.SendCANR_MC_ENG_HYBD_FD_3FD16Vld <-> outer port SendCANR_MC_ENG_HYBD_FD_3FD16Vld
    delegate CPT_ComVeh.SendCANR_Lv1CrsCtrlOff_FD3 <-> outer port SendCANR_Lv1CrsCtrlOff_FD3
    delegate CPT_ComVeh.SendCANR_DPF_Man_Stat_FD3 <-> outer port SendCANR_DPF_Man_Stat_FD3
    delegate CPT_ComVeh.VeCANR_b_HybridMILRequest_FD3 <-> outer port VeCANR_b_HybridMILRequest_FD3
    delegate CPT_ComVeh.VeCANR_b_PARK_BRK_EGD_FD3 <-> outer port VeCANR_b_PARK_BRK_EGD_FD3
    delegate CPT_ComVeh.VeCANR_e_GearEngaged_PT_FD3 <-> outer port VeCANR_e_GearEngaged_PT_FD3
    delegate CPT_ComVeh.SendCANR_OIL_IND_LMP_FLSH_FD3 <-> outer port SendCANR_OIL_IND_LMP_FLSH_FD3
    delegate CPT_ComVeh.VeCANR_e_ITBM_DSP_RQ_FD3 <-> outer port VeCANR_e_ITBM_DSP_RQ_FD3
    delegate CPT_ComVeh.VeCANR_b_ChkFuelLevelSts2_FD3TO <-> outer port VeCANR_b_ChkFuelLevelSts2_FD3TO
    delegate CPT_ComVeh.SendCANR_IdleShutDwnAppl_FD3 <-> outer port SendCANR_IdleShutDwnAppl_FD3
    delegate CPT_ComVeh.SendCANR_DrvAway_Inhibit_FD3Vld <-> outer port SendCANR_DrvAway_Inhibit_FD3Vld
    delegate CPT_ComVeh.SendCANR_Terrain_HMI_Rq_ECM_FD3Vld <-> outer port SendCANR_Terrain_HMI_Rq_ECM_FD3Vld
    delegate CPT_ComVeh.SendCANR_AdblueRemainDist_FD3Vld <-> outer port SendCANR_AdblueRemainDist_FD3Vld
    delegate CPT_ComVeh.VeCANR_Pct_BlowerDiagnosticsFD3 <-> outer port VeCANR_Pct_BlowerDiagnosticsFD3
    delegate CPT_ComVeh.VeCANR_b_J1939_RPM_RQ_FD3TO <-> outer port VeCANR_b_J1939_RPM_RQ_FD3TO
    delegate CPT_ComVeh.VeCANR_b_HVBattRealTimeClkVFD3TO <-> outer port VeCANR_b_HVBattRealTimeClkVFD3TO
    delegate CPT_ComVeh.SendCANR_OIL_TEMP_CHM_RQ_FD3Vld <-> outer port SendCANR_OIL_TEMP_CHM_RQ_FD3Vld
    delegate CPT_ComVeh.VeCANR_P_PowerDraw_FD3 <-> outer port VeCANR_P_PowerDraw_FD3
    delegate CPT_ComVeh.SendCANR_StrPrctnInhibit_FD3Vld <-> outer port SendCANR_StrPrctnInhibit_FD3Vld
    delegate CPT_ComVeh.SendCANR_EngTqCpbtFrmCntr_FD3 <-> outer port SendCANR_EngTqCpbtFrmCntr_FD3
    delegate CPT_ComVeh.VeCANR_b_DrvAway_Alert_PT_FD3TO <-> outer port VeCANR_b_DrvAway_Alert_PT_FD3TO
    delegate CPT_ComVeh.VeCANR_b_R_SHFT_LOCK_PT_FD3TO <-> outer port VeCANR_b_R_SHFT_LOCK_PT_FD3TO
    delegate CPT_ComVeh.SendCANR_TerModeDesiredStatFD16 <-> outer port SendCANR_TerModeDesiredStatFD16
    delegate CPT_ComVeh.SendCANR_TerrainHMIRq_ECM_FD16Vld <-> outer port SendCANR_TerrainHMIRq_ECM_FD16Vld
    delegate CPT_ComVeh.VeCANR_b_PECP_PumpSpdAct_FD3TO <-> outer port VeCANR_b_PECP_PumpSpdAct_FD3TO
    delegate CPT_ComVeh.SendCANR_IgnCntrTrue_FD16Vld <-> outer port SendCANR_IgnCntrTrue_FD16Vld
    delegate CPT_ComVeh.VeCANR_b_ElecCoolantHtrPwr_FD3TO <-> outer port VeCANR_b_ElecCoolantHtrPwr_FD3TO
    delegate CPT_ComVeh.VeCANR_b_FR_Z_Accel_Stat_SrcFD3TO <-> outer port VeCANR_b_FR_Z_Accel_Stat_SrcFD3TO
    delegate CPT_ComVeh.SendCANR_OAT_PT_Est_FD3 <-> outer port SendCANR_OAT_PT_Est_FD3
    delegate CPT_ComVeh.VeCANR_y_MsgCtr_BRAKE_FD_6_FD3 <-> outer port VeCANR_y_MsgCtr_BRAKE_FD_6_FD3
    delegate CPT_ComVeh.VeCANR_b_Year4_TLM_FD3TO <-> outer port VeCANR_b_Year4_TLM_FD3TO
    delegate CPT_ComVeh.VeCANR_b_PosEngdSwStat_FD3 <-> outer port VeCANR_b_PosEngdSwStat_FD3
    delegate CPT_ComVeh.VeCANR_t_HVBatteryRealTimClkFD3 <-> outer port VeCANR_t_HVBatteryRealTimClkFD3
    delegate CPT_ComVeh.VeCANR_e_CmdIgnSts_FD3 <-> outer port VeCANR_e_CmdIgnSts_FD3
    delegate CPT_ComVeh.VeCANR_b_TargetGear_PT_FD3TO <-> outer port VeCANR_b_TargetGear_PT_FD3TO
    delegate CPT_ComVeh.SendCANR_CRC_ENG_HYBD_FD_4FD16Vld <-> outer port SendCANR_CRC_ENG_HYBD_FD_4FD16Vld
    delegate CPT_ComVeh.VeCANR_e_FR_Z_Accel_Stat_SrcFD3 <-> outer port VeCANR_e_FR_Z_Accel_Stat_SrcFD3
    delegate CPT_ComVeh.VeCANR_e_ChkFuelLevelSts_FD3 <-> outer port VeCANR_e_ChkFuelLevelSts_FD3
    delegate CPT_ComVeh.VeCANR_e_RC_Z_Accel_Stat_SrcFD3 <-> outer port VeCANR_e_RC_Z_Accel_Stat_SrcFD3
    delegate CPT_ComVeh.VeCANR_b_IBS3_FLAG_DISCONNCTFD3TO <-> outer port VeCANR_b_IBS3_FLAG_DISCONNCTFD3TO
    delegate CPT_ComVeh.SendCANR_GF_Charge_FD3Vld <-> outer port SendCANR_GF_Charge_FD3Vld
    delegate CPT_ComVeh.SendCANR_EngMaxRPM_W_FD16 <-> outer port SendCANR_EngMaxRPM_W_FD16
    delegate CPT_ComVeh.VeCANR_e_DisplayedSpdLimSts_FD3 <-> outer port VeCANR_e_DisplayedSpdLimSts_FD3
    delegate CPT_ComVeh.SendCANR_PTOParkBrkRequired_FD3 <-> outer port SendCANR_PTOParkBrkRequired_FD3
    delegate CPT_ComVeh.VeCANR_b_Dist_Unit_FD3TO <-> outer port VeCANR_b_Dist_Unit_FD3TO
    delegate CPT_ComVeh.VeCANR_b_IBS3_SOH_Q_Acrcy_FD3 <-> outer port VeCANR_b_IBS3_SOH_Q_Acrcy_FD3
    delegate CPT_ComVeh.VeCANR_b_MC_IBS3DATA1_FD3TO <-> outer port VeCANR_b_MC_IBS3DATA1_FD3TO
    delegate CPT_ComVeh.VeCANR_b_LwsSpeed_SCCM_FD3TO <-> outer port VeCANR_b_LwsSpeed_SCCM_FD3TO
    delegate CPT_ComVeh.VeCANR_b_GasPdlPsnFailStsPT_FD3 <-> outer port VeCANR_b_GasPdlPsnFailStsPT_FD3
    delegate CPT_ComVeh.VeCANR_y_CRC_ADAS_FD_HMI_FD3 <-> outer port VeCANR_y_CRC_ADAS_FD_HMI_FD3
    delegate CPT_ComVeh.VeCANR_b_Tow_Request_FD3TO <-> outer port VeCANR_b_Tow_Request_FD3TO
    delegate CPT_ComVeh.SendCANR_CRC_ENGINE1_FD3 <-> outer port SendCANR_CRC_ENGINE1_FD3
    delegate CPT_ComVeh.SendCANR_CRC_ENGINE_HYB_FD_3FD3 <-> outer port SendCANR_CRC_ENGINE_HYB_FD_3FD3
    delegate CPT_ComVeh.SendCANR_MdsAct_FD16 <-> outer port SendCANR_MdsAct_FD16
    delegate CPT_ComVeh.SendCANR_AM_ECM_Prsnt_FD3 <-> outer port SendCANR_AM_ECM_Prsnt_FD3
    delegate CPT_ComVeh.VeCANR_b_Year1_TLM_FD3TO <-> outer port VeCANR_b_Year1_TLM_FD3TO
    delegate CPT_ComVeh.SendCANR_EngOilTempFD16Vld <-> outer port SendCANR_EngOilTempFD16Vld
    delegate CPT_ComVeh.VeCANR_b_RR_Lvl_Stat_Src_FD3TO <-> outer port VeCANR_b_RR_Lvl_Stat_Src_FD3TO
    delegate CPT_ComVeh.VeCANR_e_StopStartClimateInfFD3 <-> outer port VeCANR_e_StopStartClimateInfFD3
    delegate CPT_ComVeh.VeCANR_Pct_LTR_PumpFlowReq_FD3 <-> outer port VeCANR_Pct_LTR_PumpFlowReq_FD3
    delegate CPT_ComVeh.VeCANR_b_PosEngdSwStat_FD3TO <-> outer port VeCANR_b_PosEngdSwStat_FD3TO
    delegate CPT_ComVeh.VeCANR_b_GearIndcnSts_PT_FD3 <-> outer port VeCANR_b_GearIndcnSts_PT_FD3
    delegate CPT_ComVeh.SendCANR_CountDown_FD3Vld <-> outer port SendCANR_CountDown_FD3Vld
    delegate CPT_ComVeh.SendCANR_LoadOBD_FD16Vld <-> outer port SendCANR_LoadOBD_FD16Vld
    delegate CPT_ComVeh.SendCANR_CRC_OBDCONTENTFRAMEFD3 <-> outer port SendCANR_CRC_OBDCONTENTFRAMEFD3
    delegate CPT_ComVeh.SendCANR_OIL_IND_LMP_FLSH_FD3Vld <-> outer port SendCANR_OIL_IND_LMP_FLSH_FD3Vld
    delegate CPT_ComVeh.VeCANR_b_PTO_IdleSpd3_FD3 <-> outer port VeCANR_b_PTO_IdleSpd3_FD3
    delegate CPT_ComVeh.SendCANR_PECP_PumpFlowReq_FD3 <-> outer port SendCANR_PECP_PumpFlowReq_FD3
    delegate CPT_ComVeh.SendCANR_FuelFltrLeft_FD3Vld <-> outer port SendCANR_FuelFltrLeft_FD3Vld
    delegate CPT_ComVeh.VeCANR_b_ExternalTempC_FD3TO <-> outer port VeCANR_b_ExternalTempC_FD3TO
    delegate CPT_ComVeh.VeCANR_b_CurrBattFailStatus_FD3TO <-> outer port VeCANR_b_CurrBattFailStatus_FD3TO
    delegate CPT_ComVeh.VeCANR_b_HVBatDischargePwrLongV <-> outer port VeCANR_b_HVBatDischargePwrLongV
    delegate CPT_ComVeh.SendCANR_BarPrsAbsV_FD3 <-> outer port SendCANR_BarPrsAbsV_FD3
    delegate CPT_ComVeh.SendCANR_ISASts_FD3Vld <-> outer port SendCANR_ISASts_FD3Vld
    delegate CPT_ComVeh.SendCANR_FuelFltrRq_FD3Vld <-> outer port SendCANR_FuelFltrRq_FD3Vld
    delegate CPT_ComVeh.SendCANR_TransWarmUpReq_FD16Vld <-> outer port SendCANR_TransWarmUpReq_FD16Vld
    delegate CPT_ComVeh.VeCANR_e_RL_Lvl_Stat_Src_FD3 <-> outer port VeCANR_e_RL_Lvl_Stat_Src_FD3
    delegate CPT_ComVeh.SendCANR_RawPVS2_FD3 <-> outer port SendCANR_RawPVS2_FD3
    delegate CPT_ComVeh.VeCANR_b_AlternatorFail_PT_FD3TO <-> outer port VeCANR_b_AlternatorFail_PT_FD3TO
    delegate CPT_ComVeh.VeCANR_e_GlobDrvMdRq_BCM_FD3 <-> outer port VeCANR_e_GlobDrvMdRq_BCM_FD3
    delegate CPT_ComVeh.SendCANR_AtmrcPrsrFailSts_WFD16 <-> outer port SendCANR_AtmrcPrsrFailSts_WFD16
    delegate CPT_ComVeh.SendCANR_PSI_Gr5_RPM_FD3Vld <-> outer port SendCANR_PSI_Gr5_RPM_FD3Vld
    delegate CPT_ComVeh.SendCANR_EngOffTmPT_FD16Vld <-> outer port SendCANR_EngOffTmPT_FD16Vld
    delegate CPT_ComVeh.VeCANR_b_R_CLDWN_ON_OFF_REQFD3 <-> outer port VeCANR_b_R_CLDWN_ON_OFF_REQFD3
    delegate CPT_ComVeh.SendCANR_ISASts_FD3 <-> outer port SendCANR_ISASts_FD3
    delegate CPT_ComVeh.VeCANR_b_IBS3_Ibatt_FD3TO <-> outer port VeCANR_b_IBS3_Ibatt_FD3TO
    delegate CPT_ComVeh.VeCANR_b_HTShtOffVlvReq_FD3 <-> outer port VeCANR_b_HTShtOffVlvReq_FD3
    delegate CPT_ComVeh.SendCANR_Inp_ICC_Fail_FD3 <-> outer port SendCANR_Inp_ICC_Fail_FD3
    delegate CPT_ComVeh.SendCANR_PTO_Sts_FD3Vld <-> outer port SendCANR_PTO_Sts_FD3Vld
    delegate CPT_ComVeh.VeCANR_n_HTAuxPmpRPMAct_FD3 <-> outer port VeCANR_n_HTAuxPmpRPMAct_FD3
    delegate CPT_ComVeh.VeCANR_b_ParkingFailSts_PT_FD3 <-> outer port VeCANR_b_ParkingFailSts_PT_FD3
    delegate CPT_ComVeh.SendCANR_AftrRnClntPmpFaiStsFD3 <-> outer port SendCANR_AftrRnClntPmpFaiStsFD3
    delegate CPT_ComVeh.VeCANR_e_Parallel_PrkAstPad1FD3 <-> outer port VeCANR_e_Parallel_PrkAstPad1FD3
    delegate CPT_ComVeh.SendCANR_RACE_CLDWN_DEA_TIMEFD3Vld <-> outer port SendCANR_RACE_CLDWN_DEA_TIMEFD3Vld
    delegate CPT_ComVeh.VeCANR_b_IBS3_SOC_FD3TO <-> outer port VeCANR_b_IBS3_SOC_FD3TO
    delegate CPT_ComVeh.VeCANR_b_CODE_CLR_IDCM_FD3TO <-> outer port VeCANR_b_CODE_CLR_IDCM_FD3TO
    delegate CPT_ComVeh.VeCANR_b_RC_Z_Accel_Stat_SrcFD3TO <-> outer port VeCANR_b_RC_Z_Accel_Stat_SrcFD3TO
    delegate CPT_ComVeh.SendCANR_LgsDiagStndCondMet_FD3Vld <-> outer port SendCANR_LgsDiagStndCondMet_FD3Vld
    delegate CPT_ComVeh.VeCANR_e_FOTA_Install_Type_FD3 <-> outer port VeCANR_e_FOTA_Install_Type_FD3
    delegate CPT_ComVeh.VeCANR_b_PSI_RPM_Reset_FD3 <-> outer port VeCANR_b_PSI_RPM_Reset_FD3
    delegate CPT_ComVeh.SendCANR_SpStDispstat_FD3 <-> outer port SendCANR_SpStDispstat_FD3
    delegate CPT_ComVeh.VeCANR_b_Traffic_Sign_Info_FD3 <-> outer port VeCANR_b_Traffic_Sign_Info_FD3
    delegate CPT_ComVeh.SendCANR_CruiseControlSts_FD3 <-> outer port SendCANR_CruiseControlSts_FD3
    delegate CPT_ComVeh.VeCANR_b_HAS_OnOffSts_FD3 <-> outer port VeCANR_b_HAS_OnOffSts_FD3
    delegate CPT_ComVeh.SendCANR_CC_SetSpdDspl_MPH_FD3 <-> outer port SendCANR_CC_SetSpdDspl_MPH_FD3
    delegate CPT_ComVeh.VeCANR_P_HVBatChargePwrShort <-> outer port VeCANR_P_HVBatChargePwrShort
    delegate CPT_ComVeh.SendCANR_SRV_AIR_FLTR_FD3Vld <-> outer port SendCANR_SRV_AIR_FLTR_FD3Vld
    delegate CPT_ComVeh.VeCANR_e_GlobDrvMdRq_FD3 <-> outer port VeCANR_e_GlobDrvMdRq_FD3
    delegate CPT_ComVeh.SendCANR_IgnCntrFuelEngTrue_FD3Vld <-> outer port SendCANR_IgnCntrFuelEngTrue_FD3Vld
    delegate CPT_ComVeh.SendCANR_AtmPressure_W_FD3Vld <-> outer port SendCANR_AtmPressure_W_FD3Vld
    delegate CPT_ComVeh.VeCANR_b_ShiftLeverPosn_PT_FD3TO <-> outer port VeCANR_b_ShiftLeverPosn_PT_FD3TO
    delegate CPT_ComVeh.VeCANR_b_GPF_T2_Status_FD3TO <-> outer port VeCANR_b_GPF_T2_Status_FD3TO
    delegate CPT_ComVeh.VeCANR_b_DrvrRqAxTrqEnbdBSM_FD3TO <-> outer port VeCANR_b_DrvrRqAxTrqEnbdBSM_FD3TO
    delegate CPT_ComVeh.SendCANR_PTO_HornRq_FD3 <-> outer port SendCANR_PTO_HornRq_FD3
    delegate CPT_ComVeh.SendCANR_SRV_AIR_FLTR_FD3 <-> outer port SendCANR_SRV_AIR_FLTR_FD3
    delegate CPT_ComVeh.SendCANR_EngOutofFuel_FD3Vld <-> outer port SendCANR_EngOutofFuel_FD3Vld
    delegate CPT_ComVeh.SendCANR_FANStatus_FD3 <-> outer port SendCANR_FANStatus_FD3
    delegate CPT_ComVeh.VeCANR_b_PARK_BRK_EGD_FD3TO <-> outer port VeCANR_b_PARK_BRK_EGD_FD3TO
    delegate CPT_ComVeh.SendCANR_SYSTEM_STATUS_FD3Vld <-> outer port SendCANR_SYSTEM_STATUS_FD3Vld
    delegate CPT_ComVeh.VeCANR_y_Hour1_TLM_FD3 <-> outer port VeCANR_y_Hour1_TLM_FD3
    delegate CPT_ComVeh.VeCANR_y_Day2_TLM_FD3 <-> outer port VeCANR_y_Day2_TLM_FD3
    delegate CPT_ComVeh.VeCANR_b_GPF_T1_Status_FD3TO <-> outer port VeCANR_b_GPF_T1_Status_FD3TO
    delegate CPT_ComVeh.SendCANR_CC_SetSpdDspl_MPH_FD3Vld <-> outer port SendCANR_CC_SetSpdDspl_MPH_FD3Vld
    delegate CPT_ComVeh.SendCANR_EngHalfCylSpdMinLimFD3Vld <-> outer port SendCANR_EngHalfCylSpdMinLimFD3Vld
    delegate CPT_ComVeh.VeCANR_b_IBS3_SOF_VC_FD3TO <-> outer port VeCANR_b_IBS3_SOF_VC_FD3TO
    delegate CPT_ComVeh.VeCANR_U_RawPVS2_PT_FD3 <-> outer port VeCANR_U_RawPVS2_PT_FD3
    delegate CPT_ComVeh.SendCANR_FuelFltrRq_FD3 <-> outer port SendCANR_FuelFltrRq_FD3
    delegate CPT_ComVeh.VeCANR_e_Command_15Sts_FD3 <-> outer port VeCANR_e_Command_15Sts_FD3
    delegate CPT_ComVeh.VeCANR_b_Set_Speed_KPH_FD3TO <-> outer port VeCANR_b_Set_Speed_KPH_FD3TO
    delegate CPT_ComVeh.VeCANR_b_TotalAxleMinRq_BSM_FD3TO <-> outer port VeCANR_b_TotalAxleMinRq_BSM_FD3TO
    delegate CPT_ComVeh.VeCANR_b_CRC_BRAKE_FD_6_FD3TO <-> outer port VeCANR_b_CRC_BRAKE_FD_6_FD3TO
    delegate CPT_ComVeh.VeCANR_b_PE_CoolTempIn_FD3TO <-> outer port VeCANR_b_PE_CoolTempIn_FD3TO
    delegate CPT_ComVeh.VeCANR_b_TCASERANGESTATUS_FD3TO <-> outer port VeCANR_b_TCASERANGESTATUS_FD3TO
    delegate CPT_ComVeh.SendCANR_InputsGDFail_FD16 <-> outer port SendCANR_InputsGDFail_FD16
    delegate CPT_ComVeh.VeCANR_b_HVBatChargePwrLongTO <-> outer port VeCANR_b_HVBatChargePwrLongTO
    delegate CPT_ComVeh.SendCANR_MC_ENG1FD16Vld <-> outer port SendCANR_MC_ENG1FD16Vld
    delegate CPT_ComVeh.SendCANR_CARB_PERM_FD16 <-> outer port SendCANR_CARB_PERM_FD16
    delegate CPT_ComVeh.VeCANR_b_FL_Lvl_RawAD_Src_FD3TO <-> outer port VeCANR_b_FL_Lvl_RawAD_Src_FD3TO
    delegate CPT_ComVeh.SendCANR_SEIU_RPM_FD3 <-> outer port SendCANR_SEIU_RPM_FD3
    delegate CPT_ComVeh.SendCANR_EngSpd_FD16 <-> outer port SendCANR_EngSpd_FD16
    delegate CPT_ComVeh.VeCANR_b_PtPrplsnActv_PT_FD3TO <-> outer port VeCANR_b_PtPrplsnActv_PT_FD3TO
    delegate CPT_ComVeh.SendCANR_SpStSwStat_FD3 <-> outer port SendCANR_SpStSwStat_FD3
    delegate CPT_ComVeh.SendCANR_TerModeDesiredStat_FD3 <-> outer port SendCANR_TerModeDesiredStat_FD3
    delegate CPT_ComVeh.VeCANR_b_AlternatorFail_PT_FD3 <-> outer port VeCANR_b_AlternatorFail_PT_FD3
    delegate CPT_ComVeh.SendCANR_PTOHighIdleEnable_FD3Vld <-> outer port SendCANR_PTOHighIdleEnable_FD3Vld
    delegate CPT_ComVeh.SendCANR_RACE_CLDWN_SEL_FD3Vld <-> outer port SendCANR_RACE_CLDWN_SEL_FD3Vld
    delegate CPT_ComVeh.SendCANR_TerModIntrfcBtnECM_FD3 <-> outer port SendCANR_TerModIntrfcBtnECM_FD3
    delegate CPT_ComVeh.SendCANR_PFW_Stat_FD3Vld <-> outer port SendCANR_PFW_Stat_FD3Vld
    delegate CPT_ComVeh.SendCANR_LgsDiagCldStrCndMetFD3 <-> outer port SendCANR_LgsDiagCldStrCndMetFD3
    delegate CPT_ComVeh.VeCANR_e_FL_Lvl_Stat_Src_FD3 <-> outer port VeCANR_e_FL_Lvl_Stat_Src_FD3
    delegate CPT_ComVeh.VeCANR_e_AWD_Status_PT_FD3 <-> outer port VeCANR_e_AWD_Status_PT_FD3
    delegate CPT_ComVeh.VeCANR_b_Battery_Volt_2_FD3TO <-> outer port VeCANR_b_Battery_Volt_2_FD3TO
    delegate CPT_ComVeh.SendCANR_MsgCtr_ENGINE6_FD16 <-> outer port SendCANR_MsgCtr_ENGINE6_FD16
    delegate CPT_ComVeh.SendCANR_ESP_TrqRqEnabl_FD3 <-> outer port SendCANR_ESP_TrqRqEnabl_FD3
    delegate CPT_ComVeh.SendCANR_ACPressure_FD3 <-> outer port SendCANR_ACPressure_FD3
    delegate CPT_ComVeh.SendCANR_RevOilLifeRst_FD3 <-> outer port SendCANR_RevOilLifeRst_FD3
    delegate CPT_ComVeh.SendCANR_AFTER_RUN_STATUS_FD3 <-> outer port SendCANR_AFTER_RUN_STATUS_FD3
    delegate CPT_ComVeh.VeCANR_U_A2D_DRV_TEMP_DR_POSFD3 <-> outer port VeCANR_U_A2D_DRV_TEMP_DR_POSFD3
    delegate CPT_ComVeh.SendCANR_AccelPdlPosn_OBD_FD3 <-> outer port SendCANR_AccelPdlPosn_OBD_FD3
    delegate CPT_ComVeh.SendCANR_SYSTEM_STATUS_FD3 <-> outer port SendCANR_SYSTEM_STATUS_FD3
    delegate CPT_ComVeh.SendCANR_PSI_EnableSts_FD3 <-> outer port SendCANR_PSI_EnableSts_FD3
    delegate CPT_ComVeh.VeCANR_b_Warn_BTO_PT_FD3 <-> outer port VeCANR_b_Warn_BTO_PT_FD3
    delegate CPT_ComVeh.VeCANR_e_Sport_Request_FD3 <-> outer port VeCANR_e_Sport_Request_FD3
    delegate CPT_ComVeh.VeCANR_b_PSI_Gr1_RPM_SET_FD3TO <-> outer port VeCANR_b_PSI_Gr1_RPM_SET_FD3TO
    delegate CPT_ComVeh.SendCANR_OIL_TEMP_IND_RQ_FD3Vld <-> outer port SendCANR_OIL_TEMP_IND_RQ_FD3Vld
    delegate CPT_ComVeh.SendCANR_RACE_CLDWN_SEL_FD3 <-> outer port SendCANR_RACE_CLDWN_SEL_FD3
    delegate CPT_ComVeh.VeCANR_b_DrvAway_Alert_PT_FD3 <-> outer port VeCANR_b_DrvAway_Alert_PT_FD3
    delegate CPT_ComVeh.SendCANR_CoolLo_FD3 <-> outer port SendCANR_CoolLo_FD3
    delegate CPT_ComVeh.SendCANR_RawPVS2_FD3Vld <-> outer port SendCANR_RawPVS2_FD3Vld
    delegate CPT_ComVeh.VeCANR_b_VoltageMin_FD3TO <-> outer port VeCANR_b_VoltageMin_FD3TO
    delegate CPT_ComVeh.SendCANR_GenDenominator_FD3 <-> outer port SendCANR_GenDenominator_FD3
    delegate CPT_ComVeh.VeCANR_b_IBS3_T_BATT_FD3TO <-> outer port VeCANR_b_IBS3_T_BATT_FD3TO
    delegate CPT_ComVeh.VeCANR_b_Parallel_PrkAstPad1FD3TO <-> outer port VeCANR_b_Parallel_PrkAstPad1FD3TO
    delegate CPT_ComVeh.VeCANR_b_AirflowRequest_FD3TO <-> outer port VeCANR_b_AirflowRequest_FD3TO
    delegate CPT_ComVeh.VeCANR_U_VoltageMin_FD3 <-> outer port VeCANR_U_VoltageMin_FD3
    delegate CPT_ComVeh.VeCANR_b_IgnitionOnCounter_FD3TO <-> outer port VeCANR_b_IgnitionOnCounter_FD3TO
    delegate CPT_ComVeh.SendCANR_AFTER_RUN_STATUS_FD3Vld <-> outer port SendCANR_AFTER_RUN_STATUS_FD3Vld
    delegate CPT_ComVeh.SendCANR_RemainDistUnt_FD3 <-> outer port SendCANR_RemainDistUnt_FD3
    delegate CPT_ComVeh.SendCANR_CRC_ENGINE3_FD16Vld <-> outer port SendCANR_CRC_ENGINE3_FD16Vld
    delegate CPT_ComVeh.SendCANR_EngIntAirTmpV_FD3 <-> outer port SendCANR_EngIntAirTmpV_FD3
    delegate CPT_ComVeh.SendCANR_PSI_Gr2_RPM_FD3Vld <-> outer port SendCANR_PSI_Gr2_RPM_FD3Vld
    delegate CPT_ComVeh.SendCANR_LeakCheckTimerValueFD3 <-> outer port SendCANR_LeakCheckTimerValueFD3
    delegate CPT_ComVeh.SendCANR_DefFuelEcon_FD3 <-> outer port SendCANR_DefFuelEcon_FD3
    delegate CPT_ComVeh.VeCANR_b_HVBatChargePwrInstantTO <-> outer port VeCANR_b_HVBatChargePwrInstantTO
    delegate CPT_ComVeh.VeCANR_b_RR_Lvl_RawAD_Src_FD3TO <-> outer port VeCANR_b_RR_Lvl_RawAD_Src_FD3TO
    delegate CPT_ComVeh.SendCANR_AccelPdlPosn_OBD_FD16 <-> outer port SendCANR_AccelPdlPosn_OBD_FD16
    delegate CPT_ComVeh.VeCANR_d_Z_Aclrn_FR_Src_FD3 <-> outer port VeCANR_d_Z_Aclrn_FR_Src_FD3
    delegate CPT_ComVeh.VeCANR_b_Month1_TLM_FD3TO <-> outer port VeCANR_b_Month1_TLM_FD3TO
    delegate CPT_ComVeh.VeCANR_e_Left_Button_BCM_FD3 <-> outer port VeCANR_e_Left_Button_BCM_FD3
    delegate CPT_ComVeh.VeCANR_b_RL_Lvl_RawAD_Src_FD3TO <-> outer port VeCANR_b_RL_Lvl_RawAD_Src_FD3TO
    delegate CPT_ComVeh.SendCANR_PCPM_PumpSpeedAct_FD3Vld <-> outer port SendCANR_PCPM_PumpSpeedAct_FD3Vld
    delegate CPT_ComVeh.SendCANR_CompressorSts_FD3 <-> outer port SendCANR_CompressorSts_FD3
    delegate CPT_ComVeh.SendCANR_SpStDispstat_FD16 <-> outer port SendCANR_SpStDispstat_FD16
    delegate CPT_ComVeh.VeCANR_b_CmdIgnSts_FD3TO <-> outer port VeCANR_b_CmdIgnSts_FD3TO
    delegate CPT_ComVeh.VeCANR_T_PE_CoolTempOut_FD3 <-> outer port VeCANR_T_PE_CoolTempOut_FD3
    delegate CPT_ComVeh.SendCANR_PTWkSiteInvtrStsECMFD3 <-> outer port SendCANR_PTWkSiteInvtrStsECMFD3
    delegate CPT_ComVeh.VeCANR_y_Minute1_TLM_FD3 <-> outer port VeCANR_y_Minute1_TLM_FD3
    delegate CPT_ComVeh.SendCANR_TransWarmUpMin_RPM_FD3Vld <-> outer port SendCANR_TransWarmUpMin_RPM_FD3Vld
    delegate CPT_ComVeh.SendCANR_PTWkSiteInvtrCapECMFD3 <-> outer port SendCANR_PTWkSiteInvtrCapECMFD3
    delegate CPT_ComVeh.SendCANR_KNK_MG_TRIGGER_FD3 <-> outer port SendCANR_KNK_MG_TRIGGER_FD3
    delegate CPT_ComVeh.VeCANR_d_Z_Aclrn_RC_Src_FD3 <-> outer port VeCANR_d_Z_Aclrn_RC_Src_FD3
    delegate CPT_ComVeh.SendCANR_EngSpd_FD16Vld <-> outer port SendCANR_EngSpd_FD16Vld
    delegate CPT_ComVeh.SendCANR_PTWkSiteInvtrCapECMFD3Vld <-> outer port SendCANR_PTWkSiteInvtrCapECMFD3Vld
    delegate CPT_ComVeh.SendCANR_PTO_ENGD_RQ_FD3 <-> outer port SendCANR_PTO_ENGD_RQ_FD3
    delegate CPT_ComVeh.SendCANR_OIL_PRESS_FD3 <-> outer port SendCANR_OIL_PRESS_FD3
    delegate CPT_ComVeh.SendCANR_EngBrkStat_FD3Vld <-> outer port SendCANR_EngBrkStat_FD3Vld
    delegate CPT_ComVeh.VeCANR_T_IBS3_T_BATT_FD3 <-> outer port VeCANR_T_IBS3_T_BATT_FD3
    delegate CPT_ComVeh.SendCANR_MC_ENGINE3_FD16Vld <-> outer port SendCANR_MC_ENGINE3_FD16Vld
    delegate CPT_ComVeh.SendCANR_EngTqACCCapabilityFD3 <-> outer port SendCANR_EngTqACCCapabilityFD3
    delegate CPT_ComVeh.SendCANR_TrnsDrvMdCfgStsECMFD3Vld <-> outer port SendCANR_TrnsDrvMdCfgStsECMFD3Vld
    delegate CPT_ComVeh.VeCANR_U_IBS3_Vbatt_FD3 <-> outer port VeCANR_U_IBS3_Vbatt_FD3
    delegate CPT_ComVeh.SendCANR_CRC_ENGINE3_FD16 <-> outer port SendCANR_CRC_ENGINE3_FD16
    delegate CPT_ComVeh.VeCANR_b_ITBM_DSP_RQ_FD3TO <-> outer port VeCANR_b_ITBM_DSP_RQ_FD3TO
    delegate CPT_ComVeh.VeCANR_e_Tow_Request_FD3 <-> outer port VeCANR_e_Tow_Request_FD3
    delegate CPT_ComVeh.VeCANR_b_HVBatChargePwrLongV <-> outer port VeCANR_b_HVBatChargePwrLongV
    delegate CPT_ComVeh.SendCANR_VehicleSetSpeed_W_FD3Vld <-> outer port SendCANR_VehicleSetSpeed_W_FD3Vld
    delegate CPT_ComVeh.SendCANR_StrtRlyECMFdbckFltFD3Vld <-> outer port SendCANR_StrtRlyECMFdbckFltFD3Vld
    delegate CPT_ComVeh.SendCANR_PF_RgnActv_FD3Vld <-> outer port SendCANR_PF_RgnActv_FD3Vld
    delegate CPT_ComVeh.SendCANR_CRC_ENGINE1_FD3Vld <-> outer port SendCANR_CRC_ENGINE1_FD3Vld
    delegate CPT_ComVeh.VeCANR_b_LaunchRPM_Sel_Sett2FD3TO <-> outer port VeCANR_b_LaunchRPM_Sel_Sett2FD3TO
    delegate CPT_ComVeh.SendCANR_ExhaustTemperature_FD3 <-> outer port SendCANR_ExhaustTemperature_FD3
    delegate CPT_ComVeh.SendCANR_CRC_ENGINE_HYB_FD_4FD3 <-> outer port SendCANR_CRC_ENGINE_HYB_FD_4FD3
    delegate CPT_ComVeh.SendCANR_CRC_ENGINE_HYB_FD_3FD3Vld <-> outer port SendCANR_CRC_ENGINE_HYB_FD_3FD3Vld
    delegate CPT_ComVeh.SendCANR_ACPressure_FD3Vld <-> outer port SendCANR_ACPressure_FD3Vld
    delegate CPT_ComVeh.SendCANR_GenDenominator_FD16Vld <-> outer port SendCANR_GenDenominator_FD16Vld
    delegate CPT_ComVeh.VeCANR_b_CODE_CLR_IDCM_FD3 <-> outer port VeCANR_b_CODE_CLR_IDCM_FD3
    delegate CPT_ComVeh.VeCANR_b_CompressorACReqSts_FD3TO <-> outer port VeCANR_b_CompressorACReqSts_FD3TO
    delegate CPT_ComVeh.VeCANR_b_Z_Aclrn_FL_Src_FD3TO <-> outer port VeCANR_b_Z_Aclrn_FL_Src_FD3TO
    delegate CPT_ComVeh.VeCANR_Pct_PdlPosActual_PT_FD3 <-> outer port VeCANR_Pct_PdlPosActual_PT_FD3
    delegate CPT_ComVeh.SendCANR_AftrRnClntPmpFaiStsFD3Vld <-> outer port SendCANR_AftrRnClntPmpFaiStsFD3Vld
    delegate CPT_ComVeh.SendCANR_EngHalfCylSpdMaxLimFD3Vld <-> outer port SendCANR_EngHalfCylSpdMaxLimFD3Vld
    delegate CPT_ComVeh.SendCANR_Adblue_FL_LVL_FD3Vld <-> outer port SendCANR_Adblue_FL_LVL_FD3Vld
    delegate CPT_ComVeh.VeCANR_e_DrvrRqAxTrqEnbdBSM_FD3 <-> outer port VeCANR_e_DrvrRqAxTrqEnbdBSM_FD3
    delegate CPT_ComVeh.SendCANR_StrerPrctnTime_FD3Vld <-> outer port SendCANR_StrerPrctnTime_FD3Vld
    delegate CPT_ComVeh.VeCANR_d_IgnitionOnCounter_FD3 <-> outer port VeCANR_d_IgnitionOnCounter_FD3
    delegate CPT_ComVeh.SendCANR_CarbWarmUp_FD3Vld <-> outer port SendCANR_CarbWarmUp_FD3Vld
    delegate CPT_ComVeh.VeCANR_b_SpSt_Pad1_FD3TO <-> outer port VeCANR_b_SpSt_Pad1_FD3TO
    delegate CPT_ComVeh.VeCANR_e_GPF_T1_Status_FD3 <-> outer port VeCANR_e_GPF_T1_Status_FD3
    delegate CPT_ComVeh.SendCANR_OAT_PT_EstV_FD3 <-> outer port SendCANR_OAT_PT_EstV_FD3
    delegate CPT_ComVeh.SendCANR_CARB_PERM_FD3 <-> outer port SendCANR_CARB_PERM_FD3
    delegate CPT_ComVeh.VeCANR_b_HTAuxPmpRPMAct_FD3TO <-> outer port VeCANR_b_HTAuxPmpRPMAct_FD3TO
    delegate CPT_ComVeh.VeCANR_b_Dist_Unit_FD3 <-> outer port VeCANR_b_Dist_Unit_FD3
    delegate CPT_ComVeh.SendCANR_EngineOilCritical_FD3 <-> outer port SendCANR_EngineOilCritical_FD3
    delegate CPT_ComVeh.SendCANR_EngChmRq_FD3Vld <-> outer port SendCANR_EngChmRq_FD3Vld
    delegate CPT_ComVeh.SendCANR_PTO_TYPES_FD3 <-> outer port SendCANR_PTO_TYPES_FD3
    delegate CPT_ComVeh.VeCANR_y_CRC_BRAKE_FD_6_FD3 <-> outer port VeCANR_y_CRC_BRAKE_FD_6_FD3
    delegate CPT_ComVeh.SendCANR_SpStDispstat_FD3Vld <-> outer port SendCANR_SpStDispstat_FD3Vld
    delegate CPT_ComVeh.SendCANR_EngTqCpbtyMinRunTqFD3 <-> outer port SendCANR_EngTqCpbtyMinRunTqFD3
    delegate CPT_ComVeh.SendCANR_AtmrcPrsrFailSts_WFD16Vld <-> outer port SendCANR_AtmrcPrsrFailSts_WFD16Vld
    delegate CPT_ComVeh.SendCANR_EngOutofFuel_FD3 <-> outer port SendCANR_EngOutofFuel_FD3
    delegate CPT_ComVeh.VeCANR_b_PTO_IdleSpd3_FD3TO <-> outer port VeCANR_b_PTO_IdleSpd3_FD3TO
    delegate CPT_ComVeh.VeCANR_b_MC_DRIVETRAIN3_FD3TO <-> outer port VeCANR_b_MC_DRIVETRAIN3_FD3TO
    delegate CPT_ComVeh.VeCANR_b_IBS3_Error_InternalFD3TO <-> outer port VeCANR_b_IBS3_Error_InternalFD3TO
    delegate CPT_ComVeh.SendCANR_DPF_Man_Stat_FD3Vld <-> outer port SendCANR_DPF_Man_Stat_FD3Vld
    delegate CPT_ComVeh.SendCANR_GenDenominator_FD16 <-> outer port SendCANR_GenDenominator_FD16
    delegate CPT_ComVeh.SendCANR_EstCatCnvTmp_FD3 <-> outer port SendCANR_EstCatCnvTmp_FD3
    delegate CPT_ComVeh.SendCANR_EngineOilMin_FD3 <-> outer port SendCANR_EngineOilMin_FD3
    delegate CPT_ComVeh.VeCANR_b_REPRGDPFCCLR_BPCM_FD3TO <-> outer port VeCANR_b_REPRGDPFCCLR_BPCM_FD3TO
    delegate CPT_ComVeh.SendCANR_CruiseCtrlLampSts_FD16 <-> outer port SendCANR_CruiseCtrlLampSts_FD16
    delegate CPT_ComVeh.SendCANR_MC_ENG8_FD16Vld <-> outer port SendCANR_MC_ENG8_FD16Vld
    delegate CPT_ComVeh.SendCANR_CRC_ENGINE6_FD16Vld <-> outer port SendCANR_CRC_ENGINE6_FD16Vld
    delegate CPT_ComVeh.VeCANR_b_IBS3_SOH_Q_Acrcy_FD3TO <-> outer port VeCANR_b_IBS3_SOH_Q_Acrcy_FD3TO
    delegate CPT_ComVeh.VeCANR_e_HTAuxPmpMontrngRPM_FD3 <-> outer port VeCANR_e_HTAuxPmpMontrngRPM_FD3
    delegate CPT_ComVeh.SendCANR_LTR_TARGET_TEMP_FD3Vld <-> outer port SendCANR_LTR_TARGET_TEMP_FD3Vld
    delegate CPT_ComVeh.VeCANR_b_HVBatteryRealTimClkFD3TO <-> outer port VeCANR_b_HVBatteryRealTimClkFD3TO
    delegate CPT_ComVeh.SendCANR_OilLifeLeft_FD3Vld <-> outer port SendCANR_OilLifeLeft_FD3Vld
    delegate CPT_ComVeh.SendCANR_SpStDispstat_FD16Vld <-> outer port SendCANR_SpStDispstat_FD16Vld
    delegate CPT_ComVeh.SendCANR_PTO_MaxVehSpd_FD3 <-> outer port SendCANR_PTO_MaxVehSpd_FD3
    delegate CPT_ComVeh.VeCANR_y_Month2_TLM_FD3 <-> outer port VeCANR_y_Month2_TLM_FD3
    delegate CPT_ComVeh.VeCANR_e_ShiftLeverPosn_PT_FD3 <-> outer port VeCANR_e_ShiftLeverPosn_PT_FD3
    delegate CPT_ComVeh.SendCANR_MC_ENG_HYBD_FD_4FD16Vld <-> outer port SendCANR_MC_ENG_HYBD_FD_4FD16Vld
    delegate CPT_ComVeh.VeCANR_b_PECP2_PumpSpdAct_FD3TO <-> outer port VeCANR_b_PECP2_PumpSpdAct_FD3TO
    delegate CPT_ComVeh.SendCANR_ECM_WARN_BTO_FD3 <-> outer port SendCANR_ECM_WARN_BTO_FD3
    delegate CPT_ComVeh.SendCANR_CruiseCtrlLampSts_FD16Vld <-> outer port SendCANR_CruiseCtrlLampSts_FD16Vld
    delegate CPT_ComVeh.SendCANR_EngineOFFTime_FD16 <-> outer port SendCANR_EngineOFFTime_FD16
    delegate CPT_ComVeh.VeCANR_b_OilChgRst_FD3 <-> outer port VeCANR_b_OilChgRst_FD3
    delegate CPT_ComVeh.VeCANR_b_ASCM_Stat_FD3TO <-> outer port VeCANR_b_ASCM_Stat_FD3TO
    delegate CPT_ComVeh.SendCANR_DrvAway_Alert_FD3 <-> outer port SendCANR_DrvAway_Alert_FD3
    delegate CPT_ComVeh.SendCANR_BrkSw2Stat_FD3 <-> outer port SendCANR_BrkSw2Stat_FD3
    delegate CPT_ComVeh.VeCANR_U_FL_Lvl_RawAD_Src_FD3 <-> outer port VeCANR_U_FL_Lvl_RawAD_Src_FD3
    delegate CPT_ComVeh.SendCANR_PreHtIndLmp_On_RqVld <-> outer port SendCANR_PreHtIndLmp_On_RqVld
    delegate CPT_ComVeh.VeCANR_e_GearEngdForDispPT_FD3 <-> outer port VeCANR_e_GearEngdForDispPT_FD3
    delegate CPT_ComVeh.VeCANR_b_FUEL_VOLT_FD3TO <-> outer port VeCANR_b_FUEL_VOLT_FD3TO
    delegate CPT_ComVeh.SendCANR_PTO_RPM1_FD3 <-> outer port SendCANR_PTO_RPM1_FD3
    delegate CPT_ComVeh.VeCANR_b_Speed_Unit_FD3 <-> outer port VeCANR_b_Speed_Unit_FD3
    delegate CPT_ComVeh.VeCANR_T_PE_CoolTempIn_FD3 <-> outer port VeCANR_T_PE_CoolTempIn_FD3
    delegate CPT_ComVeh.VeCANR_Pct_PECP_PumpSpdAct_FD3 <-> outer port VeCANR_Pct_PECP_PumpSpdAct_FD3
    delegate CPT_ComVeh.SendCANR_RapidCbnWrmupStat_FD3Vld <-> outer port SendCANR_RapidCbnWrmupStat_FD3Vld
    delegate CPT_ComVeh.SendCANR_IdleShutDwnApply_FD3Vld <-> outer port SendCANR_IdleShutDwnApply_FD3Vld
    delegate CPT_ComVeh.SendCANR_ServiceHybSys_FD16 <-> outer port SendCANR_ServiceHybSys_FD16
    delegate CPT_ComVeh.SendCANR_GearShiftIndicationFD3Vld <-> outer port SendCANR_GearShiftIndicationFD3Vld
    delegate CPT_ComVeh.VeCANR_p_AtmPressure_PT_FD3 <-> outer port VeCANR_p_AtmPressure_PT_FD3
    delegate CPT_ComVeh.SendCANR_GenDenominator_FD3Vld <-> outer port SendCANR_GenDenominator_FD3Vld
    delegate CPT_ComVeh.VeCANR_y_Day1_TLM_FD3 <-> outer port VeCANR_y_Day1_TLM_FD3
    delegate CPT_ComVeh.VeCANR_b_TerrainMdInfcBtnBCMFD3TO <-> outer port VeCANR_b_TerrainMdInfcBtnBCMFD3TO
    delegate CPT_ComVeh.VeCANR_dphi_LwsSpeed_SCCM_FD3 <-> outer port VeCANR_dphi_LwsSpeed_SCCM_FD3
    delegate CPT_ComVeh.VeCANR_b_MC_ADAS_FD_HMI_FD3TO <-> outer port VeCANR_b_MC_ADAS_FD_HMI_FD3TO
    delegate CPT_ComVeh.SendCANR_IdleShutDwnAppl_FD3Vld <-> outer port SendCANR_IdleShutDwnAppl_FD3Vld
    delegate CPT_ComVeh.VeCANR_b_PowerDraw_FD3TO <-> outer port VeCANR_b_PowerDraw_FD3TO
    delegate CPT_ComVeh.SendCANR_EngineOilCritical_FD3Vld <-> outer port SendCANR_EngineOilCritical_FD3Vld
    delegate CPT_ComVeh.SendCANR_SelectorSysFailStsFD16 <-> outer port SendCANR_SelectorSysFailStsFD16
    delegate CPT_ComVeh.VeCANR_b_IMMO_SOP_REQUEST_FD3TO <-> outer port VeCANR_b_IMMO_SOP_REQUEST_FD3TO
    delegate CPT_ComVeh.VeCANR_b_TerrainSwStat_FD3TO <-> outer port VeCANR_b_TerrainSwStat_FD3TO
    delegate CPT_ComVeh.SendCANR_HOOD_AJAR_STATUS_FD3Vld <-> outer port SendCANR_HOOD_AJAR_STATUS_FD3Vld
    delegate CPT_ComVeh.SendCANR_EngTqCapbltyMinTq_FD3 <-> outer port SendCANR_EngTqCapbltyMinTq_FD3
    delegate CPT_ComVeh.SendCANR_EngChmRq_FD3 <-> outer port SendCANR_EngChmRq_FD3
    delegate CPT_ComVeh.VeCANR_U_RawPVS1_PT_FD3 <-> outer port VeCANR_U_RawPVS1_PT_FD3
    delegate CPT_ComVeh.SendCANR_InputsGDFail_FD3Vld <-> outer port SendCANR_InputsGDFail_FD3Vld
    delegate CPT_ComVeh.VeCANR_b_IBS3_TempFailStatusFD3 <-> outer port VeCANR_b_IBS3_TempFailStatusFD3
    delegate CPT_ComVeh.SendCANR_EngTqCpbtRefEngSpd_FD3 <-> outer port SendCANR_EngTqCpbtRefEngSpd_FD3
    delegate CPT_ComVeh.VeCANR_b_Z_Aclrn_FR_Src_FD3TO <-> outer port VeCANR_b_Z_Aclrn_FR_Src_FD3TO
    delegate CPT_ComVeh.SendCANR_Selector_SysFailStsFD3 <-> outer port SendCANR_Selector_SysFailStsFD3
    delegate CPT_ComVeh.SendCANR_AdblueRemainDist_FD3 <-> outer port SendCANR_AdblueRemainDist_FD3
    delegate CPT_ComVeh.VeCANR_y_MessageCounter_IPC1FD3 <-> outer port VeCANR_y_MessageCounter_IPC1FD3
    delegate CPT_ComVeh.SendCANR_CRC_ENGINE_HYB_FD_4FD3Vld <-> outer port SendCANR_CRC_ENGINE_HYB_FD_4FD3Vld
    delegate CPT_ComVeh.VeCANR_y_Month1_TLM_FD3 <-> outer port VeCANR_y_Month1_TLM_FD3
    delegate CPT_ComVeh.SendCANR_OAT_PT_Est_FD16Vld <-> outer port SendCANR_OAT_PT_Est_FD16Vld
    delegate CPT_ComVeh.SendCANR_EngTqCapbltyMinTqFD16 <-> outer port SendCANR_EngTqCapbltyMinTqFD16
    delegate CPT_ComVeh.VeCANR_b_IBS3_TempFailStatusFD3TO <-> outer port VeCANR_b_IBS3_TempFailStatusFD3TO
    delegate CPT_ComVeh.VeCANR_b_Left_Button_BCM_FD3TO <-> outer port VeCANR_b_Left_Button_BCM_FD3TO
    delegate CPT_ComVeh.SendCANR_CruiseCntrlLampStsFD3Vld <-> outer port SendCANR_CruiseCntrlLampStsFD3Vld
    delegate CPT_ComVeh.VeCANR_b_GasPdlPsnFailStsPT_FD3TO <-> outer port VeCANR_b_GasPdlPsnFailStsPT_FD3TO
    delegate CPT_ComVeh.SendCANR_PCPM_PumpSpeedAct_FD3 <-> outer port SendCANR_PCPM_PumpSpeedAct_FD3
    delegate CPT_ComVeh.SendCANR_RawPVS1_FD3Vld <-> outer port SendCANR_RawPVS1_FD3Vld
    delegate CPT_ComVeh.SendCANR_AccelPdlPosn_OBD_FD16Vld <-> outer port SendCANR_AccelPdlPosn_OBD_FD16Vld
    delegate CPT_ComVeh.SendCANR_Trns_DrvMdReq_ECM_FD16Vld <-> outer port SendCANR_Trns_DrvMdReq_ECM_FD16Vld
    delegate CPT_ComVeh.VeCANR_b_HVBatChargePwrShortTO <-> outer port VeCANR_b_HVBatChargePwrShortTO
    delegate CPT_ComVeh.VeCANR_b_TotalAxleMinRq_BSM_FD3 <-> outer port VeCANR_b_TotalAxleMinRq_BSM_FD3
    delegate CPT_ComVeh.VeCANR_b_Year2_TLM_FD3TO <-> outer port VeCANR_b_Year2_TLM_FD3TO
    delegate CPT_ComVeh.VeCANR_b_IBS3_Vbatt_FD3TO <-> outer port VeCANR_b_IBS3_Vbatt_FD3TO
    delegate CPT_ComVeh.SendCANR_EngineOilMin_FD3Vld <-> outer port SendCANR_EngineOilMin_FD3Vld
    delegate CPT_ComVeh.VeCANR_b_CompressorACReqSts_FD3 <-> outer port VeCANR_b_CompressorACReqSts_FD3
    delegate CPT_ComVeh.SendCANR_SEIU_Enbl_FD3Vld <-> outer port SendCANR_SEIU_Enbl_FD3Vld
    delegate CPT_ComVeh.SendCANR_EngTqACCCapabilityFD16 <-> outer port SendCANR_EngTqACCCapabilityFD16
    delegate CPT_ComVeh.SendCANR_MaxEngSpdCap_FD16Vld <-> outer port SendCANR_MaxEngSpdCap_FD16Vld
    delegate CPT_ComVeh.SendCANR_EngineOilTempFD3 <-> outer port SendCANR_EngineOilTempFD3
    delegate CPT_ComVeh.SendCANR_PTO_Ramp_Rate_FD3 <-> outer port SendCANR_PTO_Ramp_Rate_FD3
    delegate CPT_ComVeh.SendCANR_CatTempMaint_FD3Vld <-> outer port SendCANR_CatTempMaint_FD3Vld
    delegate CPT_ComVeh.SendCANR_PTO_SingleRPM_FD3 <-> outer port SendCANR_PTO_SingleRPM_FD3
    delegate CPT_ComVeh.SendCANR_OAT_PT_Est_FD16 <-> outer port SendCANR_OAT_PT_Est_FD16
    delegate CPT_ComVeh.SendCANR_DEF_LOW_FD3Vld <-> outer port SendCANR_DEF_LOW_FD3Vld
    delegate CPT_ComVeh.SendCANR_EngineOilTempFD3Vld <-> outer port SendCANR_EngineOilTempFD3Vld
    delegate CPT_ComVeh.SendCANR_PTO_RPM3_FD3 <-> outer port SendCANR_PTO_RPM3_FD3
    delegate CPT_ComVeh.SendCANR_FuelConsumption_GAGFD3Vld <-> outer port SendCANR_FuelConsumption_GAGFD3Vld
    delegate CPT_ComVeh.SendCANR_TrnModeStat_ECMFD16 <-> outer port SendCANR_TrnModeStat_ECMFD16
    delegate CPT_ComVeh.SendCANR_CruiseControlSts_FD16Vld <-> outer port SendCANR_CruiseControlSts_FD16Vld
    delegate CPT_ComVeh.VeCANR_b_VoltBattFailStatus_FD3TO <-> outer port VeCANR_b_VoltBattFailStatus_FD3TO
    delegate CPT_ComVeh.SendCANR_ECM_Thrml_AADReq_FD3Vld <-> outer port SendCANR_ECM_Thrml_AADReq_FD3Vld
    delegate CPT_ComVeh.SendCANR_RevOilLifeRst_FD3Vld <-> outer port SendCANR_RevOilLifeRst_FD3Vld
    delegate CPT_ComVeh.VeCANR_b_RsErrIBS3_FD3 <-> outer port VeCANR_b_RsErrIBS3_FD3
    delegate CPT_ComVeh.VeCANR_b_ITBM_TrlrStat_FD3TO <-> outer port VeCANR_b_ITBM_TrlrStat_FD3TO
    delegate CPT_ComCIL_Adapt.VeRxPDU_EPS_FD_1_FD3_E2E_Sts <-> outer port VeRxPDU_EPS_FD_1_FD3_E2E_Sts
    delegate CPT_ComCIL_Adapt.VeRxPDU_TRSCM_FD_1_FD14_E2E_Sts <-> outer port VeRxPDU_TRSCM_FD_1_FD14_E2E_Sts
    delegate CPT_ComCIL_Adapt.VeRxPDU_HYBRID_POWERTRAIN2_FD16_E2E_Sts <-> outer port VeRxPDU_HYBRID_POWERTRAIN2_FD16_E2E_Sts
    delegate CPT_IoSigIfAdapt_SwSStellantisCmpstn.KeCFGR_b_SecdAirPmpEquid <-> outer port KeCFGR_b_SecdAirPmpEquid
    delegate CPT_IoSigIfAdapt_SwSStellantisCmpstn.KeCFGR_e_VehCAN_CfgArch <-> outer port KeCFGR_e_VehCAN_CfgArch
    delegate CPT_rba_SyC_States_Cfg_1_Q_1.MdulPwrMod_1_Q_1 <-> outer port MdulPwrMod_1_Q_1
    delegate CPT_IoSigIfAdapt_SwSStellantisCmpstn.KeCFGR_b_EngOilHtrCoolrEquid <-> outer port KeCFGR_b_EngOilHtrCoolrEquid
    delegate CPT_IoSigIfAdapt_SwSStellantisCmpstn.KeCFGR_b_IBS_3Equid <-> outer port KeCFGR_b_IBS_3Equid
    delegate CPT_ComCIL_Adapt.VeRxPDU_HYBRID_POWERTRAIN1_FD3_E2E_Sts <-> outer port VeRxPDU_HYBRID_POWERTRAIN1_FD3_E2E_Sts
    delegate CPT_IoSigIfAdapt_SwSStellantisCmpstn.BaLRNR_e_VIN_Digt117 <-> outer port BaLRNR_e_VIN_Digt117
    delegate CPT_ComCIL_Adapt.VeRxPDU_HYBRID_POWERTRAIN_1_PduData <-> outer port VeRxPDU_HYBRID_POWERTRAIN_1_PduData
    delegate CPT_ComCIL_Adapt.VeRxPDU_BRAKE_FD_5_PduData <-> outer port VeRxPDU_BRAKE_FD_5_PduData
    delegate CPT_IoSigIfAdapt_SwSStellantisCmpstn.KeCFGR_b_ElectcATX_Equid <-> outer port KeCFGR_b_ElectcATX_Equid
    delegate CPT_ComCIL_Adapt.VeRxPDU_HYBRID_POWERTRAIN_2_PduData <-> outer port VeRxPDU_HYBRID_POWERTRAIN_2_PduData
    delegate CPT_ComCIL_Adapt.VeRxPDU_TRANSM_FD_4_FD16_E2E_Sts <-> outer port VeRxPDU_TRANSM_FD_4_FD16_E2E_Sts
    delegate CPT_ComCIL_Adapt.VeCANR_b_FD16_CurrBusOffSt <-> outer port VeCANR_b_FD16_CurrBusOffSt
    delegate CPT_IoSigIfAdapt_SwSStellantisCmpstn.KeCFGR_b_OxSnsrUsBnk2Equid <-> outer port KeCFGR_b_OxSnsrUsBnk2Equid
    delegate CPT_Cdd_Composition.VeFPCR_b_InjrLrnLimpFlg <-> outer port VeFPCR_b_InjrLrnLimpFlg
    delegate CPT_IoSigIfAdapt_SwSStellantisCmpstn.KeCFGR_b_CNG_Equid <-> outer port KeCFGR_b_CNG_Equid
    delegate CPT_IoSigIfAdapt_SwSStellantisCmpstn.ReDIDF_t_1stDTC_DtctnECU_LifeTi <-> outer port ReDIDF_t_1stDTC_DtctnECU_LifeTi
    delegate CPT_rba_SyC_States_Cfg_0_Q_1.MdulPwrMod_0_Q_1 <-> outer port MdulPwrMod_0_Q_1
    delegate CPT_IoSigIfAdapt_SwSStellantisCmpstn.KeCFGR_b_ImobKeyLock <-> outer port KeCFGR_b_ImobKeyLock
    delegate CPT_IoSigIfAdapt_SwSStellantisCmpstn.KeCFGR_b_BattTempSnsrEquid <-> outer port KeCFGR_b_BattTempSnsrEquid
    delegate CPT_IoSigIfAdapt_SwSStellantisCmpstn.KeCFGR_b_DutyCycPurgVlvEquid <-> outer port KeCFGR_b_DutyCycPurgVlvEquid
    delegate CPT_IoSigIfAdapt_SwSStellantisCmpstn.KeCFGR_b_CylDeactvnEquid <-> outer port KeCFGR_b_CylDeactvnEquid
    delegate CPT_ComCIL_Adapt.VeRxPDU_TRANSM_FD_2_FD16_E2E_Sts <-> outer port VeRxPDU_TRANSM_FD_2_FD16_E2E_Sts
    delegate CPT_rba_SyC_States_Cfg_2_Q_1.MdulPwrMod_2_Q_1 <-> outer port MdulPwrMod_2_Q_1
    delegate CPT_ComCIL_Adapt.VeRxPDU_BRAKE_FD_4_PduData <-> outer port VeRxPDU_BRAKE_FD_4_PduData
    delegate CPT_IoSigIfAdapt_SwSStellantisCmpstn.KeCFGR_b_OxSnsrDsBnk1Equid <-> outer port KeCFGR_b_OxSnsrDsBnk1Equid
    delegate CPT_IoSigIfAdapt_SwSStellantisCmpstn.KeCFGR_b_DualBattEquid <-> outer port KeCFGR_b_DualBattEquid
    delegate CPT_ComCIL_Adapt.VeRxPDU_BRAKE_FD_1_PduData <-> outer port VeRxPDU_BRAKE_FD_1_PduData
    delegate CPT_IoSigIfAdapt_SwSStellantisCmpstn.KeCFGR_b_KnkSnsr1Equid <-> outer port KeCFGR_b_KnkSnsr1Equid
    delegate CPT_ComCIL_Adapt.VeRxPDU_DRIVETRAIN_FD_1_PduData <-> outer port VeRxPDU_DRIVETRAIN_FD_1_PduData
    delegate CPT_ComCIL_Adapt.VeCANR_b_FD14_CurrBusOffSt <-> outer port VeCANR_b_FD14_CurrBusOffSt
    delegate CPT_ComCIL_Adapt.VeRxPDU_BCM_FD_18_FD3_E2E_Sts <-> outer port VeRxPDU_BCM_FD_18_FD3_E2E_Sts
    delegate CPT_ComCIL_Adapt.VeRxPDU_HYBRID_POWERTRAIN2_FD3_E2E_Sts <-> outer port VeRxPDU_HYBRID_POWERTRAIN2_FD3_E2E_Sts
    delegate CPT_IoSigIfAdapt_SwSStellantisCmpstn.KeCFGR_b_HEV_Equid <-> outer port KeCFGR_b_HEV_Equid
    delegate CPT_ComCIL_Adapt.VeRxPDU_BCM_FD_2_FD3_E2E_Sts <-> outer port VeRxPDU_BCM_FD_2_FD3_E2E_Sts
    delegate CPT_IoSigIfAdapt_SwSStellantisCmpstn.KeCFGR_b_ESS_Equid <-> outer port KeCFGR_b_ESS_Equid
    delegate CPT_ComCIL_Adapt.VeCANR_b_FD3_CurrBusOffSt <-> outer port VeCANR_b_FD3_CurrBusOffSt
    delegate CPT_ComCIL_Adapt.VeRxPDU_BRAKE_FD_5_FD14_E2E_Sts <-> outer port VeRxPDU_BRAKE_FD_5_FD14_E2E_Sts
    delegate CPT_IoSigIfAdapt_SwSStellantisCmpstn.VeCANR_e_CmdIgnSts <-> outer port VeCANR_e_CmdIgnSts
    delegate CPT_ComCIL_Adapt.VeRxPDU_DPT_BRAKE_FD_5_PduData <-> outer port VeRxPDU_DPT_BRAKE_FD_5_PduData
    delegate CPT_Cdd_Composition.VeLLKR_U_DiagMeas_SwKnkCh3 <-> outer port VeLLKR_U_DiagMeas_SwKnkCh3
    delegate CPT_ComCIL_Adapt.VeRxPDU_BRAKE_FD_2_FD3_E2E_Sts <-> outer port VeRxPDU_BRAKE_FD_2_FD3_E2E_Sts
    delegate CPT_IoSigIfAdapt_SwSStellantisCmpstn.KeCFGR_e_EngOilPmpEquid <-> outer port KeCFGR_e_EngOilPmpEquid
    delegate CPT_IoSigIfAdapt_SwSStellantisCmpstn.KeCFGR_b_ImobEquid <-> outer port KeCFGR_b_ImobEquid
    delegate CPT_IoSigIfAdapt_SwSStellantisCmpstn.KeCFGR_b_CVT_Equid <-> outer port KeCFGR_b_CVT_Equid
    delegate CPT_IoSigIfAdapt_SwSStellantisCmpstn.KeCFGR_b_VVT_CamIntk1PhsrEquid <-> outer port KeCFGR_b_VVT_CamIntk1PhsrEquid
    delegate CPT_ComCIL_Adapt.VeRxPDU_BRAKE_FD_1_FD3_E2E_Sts <-> outer port VeRxPDU_BRAKE_FD_1_FD3_E2E_Sts
    delegate CPT_IoSigIfAdapt_SwSStellantisCmpstn.KeCFGR_b_HTR_MeclCooltPmpEquid <-> outer port KeCFGR_b_HTR_MeclCooltPmpEquid
    delegate CPT_IoSigIfAdapt_SwSStellantisCmpstn.KeCFGR_b_LnrPurgEquid <-> outer port KeCFGR_b_LnrPurgEquid
    delegate CPT_IoSigIfAdapt_SwSStellantisCmpstn.KeCFGR_b_EngOilPresSnsrAnEquid <-> outer port KeCFGR_b_EngOilPresSnsrAnEquid
    delegate CPT_ComCIL_Adapt.VeRxPDU_HYBRID_POWERTRAIN1_FD16_E2E_Sts <-> outer port VeRxPDU_HYBRID_POWERTRAIN1_FD16_E2E_Sts
    delegate CPT_IoSigIfAdapt_SwSStellantisCmpstn.KeCFGR_b_BltDrvnStrtrGenrEquid <-> outer port KeCFGR_b_BltDrvnStrtrGenrEquid
    delegate CPT_ComCIL_Adapt.VeRxPDU_AGSM_FD_2_FD3_E2E_Sts <-> outer port VeRxPDU_AGSM_FD_2_FD3_E2E_Sts
    delegate CPT_ComCIL_Adapt.VeRxPDU_BRAKE_FD_4_FD3_E2E_Sts <-> outer port VeRxPDU_BRAKE_FD_4_FD3_E2E_Sts
    delegate CPT_ComCIL_Adapt.VeRxPDU_HYBRID_POWERTRAIN_5_PduData <-> outer port VeRxPDU_HYBRID_POWERTRAIN_5_PduData
    delegate CPT_ComCIL_Adapt.VeRxPDU_PT_SYSTEM_FD_1_FD16_E2E_Sts <-> outer port VeRxPDU_PT_SYSTEM_FD_1_FD16_E2E_Sts
    delegate CPT_IoSigIfAdapt_SwSStellantisCmpstn.KeCFGR_b_AC_FixdDplEquid <-> outer port KeCFGR_b_AC_FixdDplEquid
    delegate CPT_IoSigIfAdapt_SwSStellantisCmpstn.KeCFGR_b_MTX_Equid <-> outer port KeCFGR_b_MTX_Equid
    delegate CPT_ComCIL_Adapt.VeRxPDU_TRSCM_FD_1_FD3_E2E_Sts <-> outer port VeRxPDU_TRSCM_FD_1_FD3_E2E_Sts
    delegate CPT_ComCIL_Adapt.VeRxPDU_BRAKE_FD_3_PduData <-> outer port VeRxPDU_BRAKE_FD_3_PduData
    delegate CPT_ComCIL_Adapt.VeRxPDU_BRAKE_FD_2_PduData <-> outer port VeRxPDU_BRAKE_FD_2_PduData
    delegate CPT_IoSigIfAdapt_SwSStellantisCmpstn.KeCFGR_b_ShoRunrVlvEquid <-> outer port KeCFGR_b_ShoRunrVlvEquid
    delegate CPT_ComCIL_Adapt.VeRxPDU_BCM_FD_18_PduData <-> outer port VeRxPDU_BCM_FD_18_PduData
    delegate CPT_IoSigIfAdapt_SwSStellantisCmpstn.KeECFR_Cnt_NrOfCyl <-> outer port KeECFR_Cnt_NrOfCyl
    delegate CPT_rba_SyC_States_Cfg_3_Q_1.MdulPwrMod_3_Q_1 <-> outer port MdulPwrMod_3_Q_1
    delegate CPT_ComCIL_Adapt.VeRxPDU_ORC_FD_3_FD3_E2E_Sts <-> outer port VeRxPDU_ORC_FD_3_FD3_E2E_Sts
    delegate CPT_IoSigIfAdapt_SwSStellantisCmpstn.KeCFGR_b_RvsLockOutPrsnt <-> outer port KeCFGR_b_RvsLockOutPrsnt
    delegate CPT_ComCIL_Adapt.VeRxPDU_BRAKE_FD_2_FD14_E2E_Sts <-> outer port VeRxPDU_BRAKE_FD_2_FD14_E2E_Sts
    delegate CPT_IoSigIfAdapt_SwSStellantisCmpstn.KeCFGR_b_OxSnsrUsBnk1Equid <-> outer port KeCFGR_b_OxSnsrUsBnk1Equid
    delegate CPT_IoSigIfAdapt_SwSStellantisCmpstn.KeCFGR_b_AC_VarDplEquid <-> outer port KeCFGR_b_AC_VarDplEquid
    delegate CPT_ComCIL_Adapt.VeRxPDU_BRAKE_FD_6_FD14_E2E_Sts <-> outer port VeRxPDU_BRAKE_FD_6_FD14_E2E_Sts
    delegate CPT_IoSigIfAdapt_SwSStellantisCmpstn.KeCFGR_b_VVT_CamExh2PhsrEquid <-> outer port KeCFGR_b_VVT_CamExh2PhsrEquid
    delegate CPT_IoSigIfAdapt_SwSStellantisCmpstn.KeCFGR_b_OxSnsrDsBnk2Equid <-> outer port KeCFGR_b_OxSnsrDsBnk2Equid
    delegate CPT_IoSigIfAdapt_SwSStellantisCmpstn.KeCFGR_b_ElecGearShiftEquid <-> outer port KeCFGR_b_ElecGearShiftEquid
    delegate CPT_IoSigIfAdapt_SwSStellantisCmpstn.KeCFGR_b_DirectInjSysEquid <-> outer port KeCFGR_b_DirectInjSysEquid
    delegate CPT_IoSigIfAdapt_SwSStellantisCmpstn.KeCFGR_b_VVA_Equid <-> outer port KeCFGR_b_VVA_Equid
    delegate CPT_Cdd_Composition.GetRPMR_n_EngSpdFastRate <-> outer port GetRPMR_n_EngSpdFastRate
    delegate CPT_IoSigIfAdapt_SwSStellantisCmpstn.KeCFGR_b_VarSpdFuPmpEquid <-> outer port KeCFGR_b_VarSpdFuPmpEquid
    delegate CPT_ComCIL_Adapt.VeRxPDU_ORC_FD_2_FD3_E2E_Sts <-> outer port VeRxPDU_ORC_FD_2_FD3_E2E_Sts
    delegate CPT_rba_SyC_States_Cfg_1_B_1.MdulPwrMod_1_B_1 <-> outer port MdulPwrMod_1_B_1
    delegate CPT_IoSigIfAdapt_SwSStellantisCmpstn.KeCFGR_b_ElecCooltVlvEquid <-> outer port KeCFGR_b_ElecCooltVlvEquid
    delegate CPT_ComCIL_Adapt.VeRxPDU_BCM_FD_9_FD3_E2E_Sts <-> outer port VeRxPDU_BCM_FD_9_FD3_E2E_Sts
    delegate CPT_ComCIL_Adapt.VeRxPDU_PT_SYSTEM_FD_1_FD14_E2E_Sts <-> outer port VeRxPDU_PT_SYSTEM_FD_1_FD14_E2E_Sts
    delegate CPT_IoSigIfAdapt_SwSStellantisCmpstn.KeCFGR_e_FanTypEquid <-> outer port KeCFGR_e_FanTypEquid
    delegate CPT_IoSigIfAdapt_SwSStellantisCmpstn.KeCFGR_b_SkipShiftPrsnt <-> outer port KeCFGR_b_SkipShiftPrsnt
    delegate CPT_ComCIL_Adapt.VeRxPDU_TRANSM_FD_4_PduData <-> outer port VeRxPDU_TRANSM_FD_4_PduData
    delegate CPT_ComCIL_Adapt.VeRxPDU_HYBRID_POWERTRAIN5_FD16_E2E_Sts <-> outer port VeRxPDU_HYBRID_POWERTRAIN5_FD16_E2E_Sts
    delegate CPT_ComCIL_Adapt.VeRxPDU_LV_CHARGER1_FD3_E2E_Sts <-> outer port VeRxPDU_LV_CHARGER1_FD3_E2E_Sts
    delegate CPT_Cdd_Composition.VeLTIR_b_L2_EngSpdFaild <-> outer port VeLTIR_b_L2_EngSpdFaild
    delegate CPT_IoSigIfAdapt_SwSStellantisCmpstn.KeCFGR_b_IntgrdEvapPresSwEquid <-> outer port KeCFGR_b_IntgrdEvapPresSwEquid
    delegate CPT_ComCIL_Adapt.VeRxPDU_TRANSM_FD_1_PduData <-> outer port VeRxPDU_TRANSM_FD_1_PduData
    delegate CPT_Cdd_Composition.VeLISR_h_DigIonSnsRes4 <-> outer port VeLISR_h_DigIonSnsRes4
    delegate CPT_IoSigIfAdapt_SwSStellantisCmpstn.KeCFGR_b_KnkSnsr2Equid <-> outer port KeCFGR_b_KnkSnsr2Equid
    delegate CPT_IoSigIfAdapt_SwSStellantisCmpstn.KeCFGR_b_DualVarSpdFuPmpEquid <-> outer port KeCFGR_b_DualVarSpdFuPmpEquid
    delegate CPT_ComCIL_Adapt.VeRxPDU_TRANSM_FD_2_PduData <-> outer port VeRxPDU_TRANSM_FD_2_PduData
    delegate CPT_IoSigIfAdapt_SwSStellantisCmpstn.KeCFGR_b_OxSnsrUsBnk1WideRng <-> outer port KeCFGR_b_OxSnsrUsBnk1WideRng
    delegate CPT_IoSigIfAdapt_SwSStellantisCmpstn.KeCFGR_b_SupChrgrEquid <-> outer port KeCFGR_b_SupChrgrEquid
    delegate CPT_ComCIL_Adapt.VeRxPDU_ESP_FD_1_PduData <-> outer port VeRxPDU_ESP_FD_1_PduData
    delegate CPT_IoSigIfAdapt_SwSStellantisCmpstn.KeCFGR_b_DualLiftEquid <-> outer port KeCFGR_b_DualLiftEquid
    delegate CPT_IoSigIfAdapt_SwSStellantisCmpstn.KeCFGR_b_FuTankHiPresSnsrEquid <-> outer port KeCFGR_b_FuTankHiPresSnsrEquid
    delegate CPT_IoSigIfAdapt_SwSStellantisCmpstn.KeCFGR_b_ElecVacPmpEquid <-> outer port KeCFGR_b_ElecVacPmpEquid
    delegate CPT_Cdd_Composition.VeLLKR_U_DiagMeas_SwKnkCh2 <-> outer port VeLLKR_U_DiagMeas_SwKnkCh2
    delegate CPT_IoSigIfAdapt_SwSStellantisCmpstn.KeCFGR_b_VVT_CamExh1PhsrEquid <-> outer port KeCFGR_b_VVT_CamExh1PhsrEquid
    delegate CPT_IoSigIfAdapt_SwSStellantisCmpstn.ReDIDF_t_1stDTC_DtctnTiThisCyc <-> outer port ReDIDF_t_1stDTC_DtctnTiThisCyc
    delegate CPT_IoSigIfAdapt_SwSStellantisCmpstn.KeCFGR_b_VVT_Equid <-> outer port KeCFGR_b_VVT_Equid
    delegate CPT_IoSigIfAdapt_SwSStellantisCmpstn.KeCFGR_b_WakeUpEquid <-> outer port KeCFGR_b_WakeUpEquid
    delegate CPT_ComCIL_Adapt.VeRxPDU_TRANSM_FD_1_FD3_E2E_Sts <-> outer port VeRxPDU_TRANSM_FD_1_FD3_E2E_Sts
    delegate CPT_ComCIL_Adapt.VeRxPDU_DRIVETRAIN_FD_1_FD3_E2E_Sts <-> outer port VeRxPDU_DRIVETRAIN_FD_1_FD3_E2E_Sts
    delegate CPT_IoSigIfAdapt_SwSStellantisCmpstn.KeCFGR_b_SolnEGR_VlvEquid <-> outer port KeCFGR_b_SolnEGR_VlvEquid
    delegate CPT_ComCIL_Adapt.VeRxPDU_TRANSM_FD_1_FD16_E2E_Sts <-> outer port VeRxPDU_TRANSM_FD_1_FD16_E2E_Sts
    delegate CPT_ComCIL_Adapt.VeRxPDU_HYBRID_POWERTRAIN5_FD3_E2E_Sts <-> outer port VeRxPDU_HYBRID_POWERTRAIN5_FD3_E2E_Sts
    delegate CPT_ComCIL_Adapt.VeRxPDU_TRANSM_FD_4_FD3_E2E_Sts <-> outer port VeRxPDU_TRANSM_FD_4_FD3_E2E_Sts
    delegate CPT_IoSigIfAdapt_SwSStellantisCmpstn.KeCFGR_b_VVT_CamIntk2PhsrEquid <-> outer port KeCFGR_b_VVT_CamIntk2PhsrEquid
    delegate CPT_IoSigIfAdapt_SwSStellantisCmpstn.KeCFGR_b_OxSnsrUsBnk2WideRng <-> outer port KeCFGR_b_OxSnsrUsBnk2WideRng
    delegate CPT_IoSigIfAdapt_SwSStellantisCmpstn.KeCFGR_b_IBS_Equid <-> outer port KeCFGR_b_IBS_Equid
    delegate CPT_IoSigIfAdapt_SwSStellantisCmpstn.KeCFGR_b_FuTankIsolnVlvEquid <-> outer port KeCFGR_b_FuTankIsolnVlvEquid
    delegate CPT_IoSigIfAdapt_SwSStellantisCmpstn.KeCFGR_b_DrvAwayInhbEquid <-> outer port KeCFGR_b_DrvAwayInhbEquid
    delegate CPT_ComCIL_Adapt.VeRxPDU_TRANSM_FD_2_FD3_E2E_Sts <-> outer port VeRxPDU_TRANSM_FD_2_FD3_E2E_Sts
    delegate CPT_IoSigIfAdapt_SwSStellantisCmpstn.KeCFGR_b_TrboChrgrEquid <-> outer port KeCFGR_b_TrboChrgrEquid
    delegate CPT_Cdd_Composition.VeCLUR_b_UsPID_EnbldBnk1 <-> outer port VeCLUR_b_UsPID_EnbldBnk1
    delegate CPT_Cdd_Composition.VeLISR_h_DigIonSnsRes3 <-> outer port VeLISR_h_DigIonSnsRes3
    delegate CPT_ComCIL_Adapt.VeRxPDU_BRAKE_FD_7_FD3_E2E_Sts <-> outer port VeRxPDU_BRAKE_FD_7_FD3_E2E_Sts
    delegate CPT_ComCIL_Adapt.VeRxPDU_DPT_BRAKE_FD_2_PduData <-> outer port VeRxPDU_DPT_BRAKE_FD_2_PduData
    delegate CPT_ComCIL_Adapt.VeRxPDU_ADAS_FD_INFO_FD14_E2E_Sts <-> outer port VeRxPDU_ADAS_FD_INFO_FD14_E2E_Sts
    delegate CPT_ComCIL_Adapt.VeRxPDU_BRAKE_FD_7_PduData <-> outer port VeRxPDU_BRAKE_FD_7_PduData
    delegate CPT_IoSigIfAdapt_SwSStellantisCmpstn.KeCFGR_b_AC_ElecCmprEquid <-> outer port KeCFGR_b_AC_ElecCmprEquid
    delegate CPT_ComCIL_Adapt.VeRxPDU_BCM_FD_13_FD3_E2E_Sts <-> outer port VeRxPDU_BCM_FD_13_FD3_E2E_Sts
    delegate CPT_IoSigIfAdapt_SwSStellantisCmpstn.KeCFGR_b_DualFuTankEquid <-> outer port KeCFGR_b_DualFuTankEquid
    delegate CPT_IoSigIfAdapt_SwSStellantisCmpstn.KeCFGR_b_ThrInletAirPresEquid <-> outer port KeCFGR_b_ThrInletAirPresEquid
    delegate CPT_IoSigIfAdapt_SwSStellantisCmpstn.KeCFGR_b_FuEthnlConcLrngEquid <-> outer port KeCFGR_b_FuEthnlConcLrngEquid
    delegate CPT_Cdd_Composition.UpdateLLFR_InjrDI <-> outer port UpdateLLFR_InjrDI
    delegate CPT_ComCIL_Adapt.VeRxPDU_BCM_FD_2_PduData <-> outer port VeRxPDU_BCM_FD_2_PduData
    delegate CPT_ComCIL_Adapt.VeRxPDU_BRAKE_FD_3_FD3_E2E_Sts <-> outer port VeRxPDU_BRAKE_FD_3_FD3_E2E_Sts
    delegate CPT_ComCIL_Adapt.VeRxPDU_BRAKE_FD_5_FD3_E2E_Sts <-> outer port VeRxPDU_BRAKE_FD_5_FD3_E2E_Sts
    delegate CPT_ComCIL_Adapt.SendCANR_ImobCodReqVld <-> outer port SendCANR_ImobCodReqVld
    delegate CPT_IoSigAdc_SwSStellantisCmpstn.GetADCR_U_ReAxleTempSnsr <-> outer port GetADCR_U_ReAxleTempSnsr
    delegate CPT_IoSigDioOutp_SwSStellantisCmpstn.SetDIOR_b_DualFuTankEnblRlyOutpSt <-> outer port SetDIOR_b_DualFuTankEnblRlyOutpSt
    delegate CPT_IoSigAdc_SwSStellantisCmpstn.CoolEgrT <-> outer port CoolEgrT
    delegate CPT_SentStack_SwSStellantisCmpstn.KeCFGR_b_GPF_DeltAbsPresSnsr2Equid <-> outer port KeCFGR_b_GPF_DeltAbsPresSnsr2Equid
    delegate CPT_IoSigDioOutp_SwSStellantisCmpstn.VeDIOR_DualFuTankEnblRly_HwDiagCmn <-> outer port VeDIOR_DualFuTankEnblRly_HwDiagCmn
    delegate CPT_IoSigAdc_SwSStellantisCmpstn.VeADCR_U_ReAxleTempSnsr <-> outer port VeADCR_U_ReAxleTempSnsr
    delegate CPT_IoSigDioOutp_SwSStellantisCmpstn.VeDIOR_FuTankIsolnVlvHwDiagCmn <-> outer port VeDIOR_FuTankIsolnVlvHwDiagCmn
    delegate CPT_IoSigIfAdapt_SwSStellantisCmpstn.VeSPLR_b_HwOptnOxHtr <-> outer port VeSPLR_b_HwOptnOxHtr
    delegate CPT_IoSigDioOutp_SwSStellantisCmpstn.KeCFGR_b_ELCM_ChgOvrVlv_ChEquid <-> outer port KeCFGR_b_ELCM_ChgOvrVlv_ChEquid
    delegate CPT_IoSigDioInp_SwSStellantisCmpstn.VeDIOR_b_FuDoorSwDigInpImdtVal <-> outer port VeDIOR_b_FuDoorSwDigInpImdtVal
    delegate CPT_IoSigDioInp_SwSStellantisCmpstn.KeCFGR_b_FuDoorDigInpEquid <-> outer port KeCFGR_b_FuDoorDigInpEquid
    delegate CPT_IoSigDioOutp_SwSStellantisCmpstn.VeDIOR_e_FuDoorIndDiagInfo <-> outer port VeDIOR_e_FuDoorIndDiagInfo
    delegate CPT_IoSigDioOutp_SwSStellantisCmpstn.VeDIOR_FuTankIsolnVlvHwDiagFltOutp <-> outer port VeDIOR_FuTankIsolnVlvHwDiagFltOutp
    delegate CPT_IoSigPwmOutp_SwSStellantisCmpstn.VeDIOR_e_WgSolnIndDiagInfo <-> outer port VeDIOR_e_WgSolnIndDiagInfo
    delegate CPT_IoSigDioOutp_SwSStellantisCmpstn.VeDIOR_SrgSoln2_HwDiagCmn <-> outer port VeDIOR_SrgSoln2_HwDiagCmn
    delegate CPT_IoSigIfAdapt_SwSStellantisCmpstn.VeSPLR_b_HwOptnEepCfg <-> outer port VeSPLR_b_HwOptnEepCfg
    delegate CPT_IoSigPwmOutp_SwSStellantisCmpstn.SetDIOR_e_HTR_TempCtrlVlvSolnOutpOps <-> outer port SetDIOR_e_HTR_TempCtrlVlvSolnOutpOps
    delegate CPT_IoSigPwmOutp_SwSStellantisCmpstn.VeDIOR_HTR_TempCtrlVlvSoln_HwDiagFltCircDtctd <-> outer port VeDIOR_HTR_TempCtrlVlvSoln_HwDiagFltCircDtctd
    delegate CPT_Cdd_Composition.VeMFDR_phi_SprkWinStrtCyl1 <-> outer port VeMFDR_phi_SprkWinStrtCyl1
    delegate CPT_IoSigDioOutp_SwSStellantisCmpstn.VeDIOR_SrgSoln2_HwDiagFltCircDtctd <-> outer port VeDIOR_SrgSoln2_HwDiagFltCircDtctd
    delegate CPT_IoSigPwmOutp_SwSStellantisCmpstn.VeDIOR_FuPmpCtlMdul2Cmd_HwDiagFltCircDtctd <-> outer port VeDIOR_FuPmpCtlMdul2Cmd_HwDiagFltCircDtctd
    delegate CPT_IoSigDioOutp_SwSStellantisCmpstn.VeDIOR_e_ELCM_ChgOvrVlvIndDiagInfo <-> outer port VeDIOR_e_ELCM_ChgOvrVlvIndDiagInfo
    delegate CPT_SentStack_SwSStellantisCmpstn.KeCFGR_b_GPF_DeltAbsPresSnsr1Equid <-> outer port KeCFGR_b_GPF_DeltAbsPresSnsr1Equid
    delegate CPT_IoSigDioOutp_SwSStellantisCmpstn.VeDIOR_e_SrgSoln2IndDiagInfo <-> outer port VeDIOR_e_SrgSoln2IndDiagInfo
    delegate CPT_IoSigDioOutp_SwSStellantisCmpstn.VeDIOR_TOH_HwDiagCmn <-> outer port VeDIOR_TOH_HwDiagCmn
    delegate CPT_IoSigAdc_SwSStellantisCmpstn.VeADCR_U_HTR_OutlTempSnsr <-> outer port VeADCR_U_HTR_OutlTempSnsr
    delegate CPT_IoSigIfAdapt_SwSStellantisCmpstn.VeSPLR_e_HwVersRv <-> outer port VeSPLR_e_HwVersRv
    delegate CPT_IoSigPwmOutp_SwSStellantisCmpstn.KeCFGR_b_WgSoln_ChEquid <-> outer port KeCFGR_b_WgSoln_ChEquid
    delegate CPT_IoSigDioOutp_SwSStellantisCmpstn.KeCFGR_b_FuTankIsolnVlv_ChEquid <-> outer port KeCFGR_b_FuTankIsolnVlv_ChEquid
    delegate CPT_IoSigPwmOutp_SwSStellantisCmpstn.VeDIOR_e_ELCM_VacPmpIndDiagInfo <-> outer port VeDIOR_e_ELCM_VacPmpIndDiagInfo
    delegate CPT_Cdd_Composition.VeLLKR_U_DiagMeas_SwKnkCh1 <-> outer port VeLLKR_U_DiagMeas_SwKnkCh1
    delegate CPT_IoSigPwmOutp_SwSStellantisCmpstn.VeDIOR_HTR_TempCtrlVlvSoln_HwDiagCmn <-> outer port VeDIOR_HTR_TempCtrlVlvSoln_HwDiagCmn
    delegate CPT_IoSigPwmOutp_SwSStellantisCmpstn.VeDIOR_ELCM_VacPmp_HwDiagFltCircDtctd <-> outer port VeDIOR_ELCM_VacPmp_HwDiagFltCircDtctd
    delegate CPT_SentStack_SwSStellantisCmpstn.GetSNTR_e_GPF_DeltAbsPresSnsr2 <-> outer port GetSNTR_e_GPF_DeltAbsPresSnsr2
    delegate CPT_Cdd_Composition.VeMFDR_phi_SprkWinStrtCyl4 <-> outer port VeMFDR_phi_SprkWinStrtCyl4
    delegate CPT_IoSigPwmOutp_SwSStellantisCmpstn.SetDIOR_e_ELCM_VacPmpOutpOps <-> outer port SetDIOR_e_ELCM_VacPmpOutpOps
    delegate CPT_ComCIL_Adapt.SendCANR_ImobCodReq <-> outer port SendCANR_ImobCodReq
    delegate CPT_IoSigDioOutp_SwSStellantisCmpstn.VeDIOR_TOH_HwDiagFltOutp <-> outer port VeDIOR_TOH_HwDiagFltOutp
    delegate CPT_IoSigDioOutp_SwSStellantisCmpstn.VeDIOR_ELCM_ChgOvrVlvHwDiagCmn <-> outer port VeDIOR_ELCM_ChgOvrVlvHwDiagCmn
    delegate CPT_IoSigDioInp_SwSStellantisCmpstn.VeDIOR_t_FuDoorSwDigInpOffTi <-> outer port VeDIOR_t_FuDoorSwDigInpOffTi
    delegate CPT_IoSigPwmOutp_SwSStellantisCmpstn.KeCFGR_b_FuPmpCtlMdul2Cmd_ChEquid <-> outer port KeCFGR_b_FuPmpCtlMdul2Cmd_ChEquid
    delegate CPT_IoSigPwmOutp_SwSStellantisCmpstn.SetDIOR_e_PurgSoln2_OutpOps <-> outer port SetDIOR_e_PurgSoln2_OutpOps
    delegate CPT_Cdd_Composition.GetCAMR_b_Intk1CamInLimpIn <-> outer port GetCAMR_b_Intk1CamInLimpIn
    delegate CPT_IoSigDioOutp_SwSStellantisCmpstn.SetDIOR_b_FuTankIsolnVlvOutpSt <-> outer port SetDIOR_b_FuTankIsolnVlvOutpSt
    delegate CPT_Cdd_Composition.VeMFDR_phi_SprkWinStrtCyl3 <-> outer port VeMFDR_phi_SprkWinStrtCyl3
    delegate CPT_SentStack_SwSStellantisCmpstn.KeCFGR_b_CEGR_PosnSnsChEquid <-> outer port KeCFGR_b_CEGR_PosnSnsChEquid
    delegate CPT_IoSigIfAdapt_SwSStellantisCmpstn.VeSPLR_b_HwOptnOxSnsrCfg <-> outer port VeSPLR_b_HwOptnOxSnsrCfg
    delegate CPT_IoSigAdc_SwSStellantisCmpstn.VeADCR_U_EvapLkChkMonPresSnsr <-> outer port VeADCR_U_EvapLkChkMonPresSnsr
    delegate CPT_IoSigPwmOutp_SwSStellantisCmpstn.SetDIOR_e_WgSolnOutpOps <-> outer port SetDIOR_e_WgSolnOutpOps
    delegate CPT_Cdd_Composition.VsSSKR_h_MIL_Req <-> outer port VsSSKR_h_MIL_Req
    delegate CPT_IoSigAdc_SwSStellantisCmpstn.KeCFGR_b_CmprInletTempAdcInpEquid <-> outer port KeCFGR_b_CmprInletTempAdcInpEquid
    delegate CPT_IoSigPwmOutp_SwSStellantisCmpstn.VeDIOR_PurgSoln2_HwDiagFltCircDtctd <-> outer port VeDIOR_PurgSoln2_HwDiagFltCircDtctd
    delegate CPT_IoSigDioOutp_SwSStellantisCmpstn.VeDIOR_TOH_HwDiagFltCircDtctd <-> outer port VeDIOR_TOH_HwDiagFltCircDtctd
    delegate CPT_IoSigAdc_SwSStellantisCmpstn.KeCFGR_b_BoostTemp1AdcInpEquid <-> outer port KeCFGR_b_BoostTemp1AdcInpEquid
    delegate CPT_IoSigDioOutp_SwSStellantisCmpstn.VeDIOR_DualFuTankEnblRly_HwDiagFltOutp <-> outer port VeDIOR_DualFuTankEnblRly_HwDiagFltOutp
    delegate CPT_IoSigDioOutp_SwSStellantisCmpstn.VeDIOR_ELCM_ChgOvrVlvHwDiagFltCircDtctd <-> outer port VeDIOR_ELCM_ChgOvrVlvHwDiagFltCircDtctd
    delegate CPT_IoSigAdc_SwSStellantisCmpstn.KeCFGR_b_WgPosn2AdcInpEquid <-> outer port KeCFGR_b_WgPosn2AdcInpEquid
    delegate CPT_IoSigAdc_SwSStellantisCmpstn.KeCFGR_b_GdiFuRailP2AdcInpEquid <-> outer port KeCFGR_b_GdiFuRailP2AdcInpEquid
    delegate CPT_IoSigAdc_SwSStellantisCmpstn.VeADCR_U_GDI_FuRail2Pres <-> outer port VeADCR_U_GDI_FuRail2Pres
    delegate CPT_IoSigAdc_SwSStellantisCmpstn.VeADCR_U_BoostTemp2 <-> outer port VeADCR_U_BoostTemp2
    delegate CPT_IoSigPwmOutp_SwSStellantisCmpstn.KeCFGR_b_HTR_TempCtrlVlvSoln_ChEquid <-> outer port KeCFGR_b_HTR_TempCtrlVlvSoln_ChEquid
    delegate CPT_Cdd_Composition.VeLISR_h_DigIonSnsRes2 <-> outer port VeLISR_h_DigIonSnsRes2
    delegate CPT_IoSigDioOutp_SwSStellantisCmpstn.SetDIOR_b_ELCM_ChgOvrVlvOutpSt <-> outer port SetDIOR_b_ELCM_ChgOvrVlvOutpSt
    delegate CPT_IoSigPwmOutp_SwSStellantisCmpstn.VeDIOR_e_HTR_TempCtrlVlvSolnIndDiagInfo <-> outer port VeDIOR_e_HTR_TempCtrlVlvSolnIndDiagInfo
    delegate CPT_IoSigPwmOutp_SwSStellantisCmpstn.VeDIOR_PurgSoln2_HwDiagFltOutp <-> outer port VeDIOR_PurgSoln2_HwDiagFltOutp
    delegate CPT_IoSigIfAdapt_SwSStellantisCmpstn.VeSPLR_b_HwOptnPID_Progd <-> outer port VeSPLR_b_HwOptnPID_Progd
    delegate CPT_SentStack_SwSStellantisCmpstn.KsSNTR_h_CEGR_PosnSns_SENTCfg <-> outer port KsSNTR_h_CEGR_PosnSns_SENTCfg
    delegate CPT_SentStack_SwSStellantisCmpstn.GetSNTR_e_CEGR_PosnSns <-> outer port GetSNTR_e_CEGR_PosnSns
    delegate CPT_IoSigDioOutp_SwSStellantisCmpstn.VeDIOR_FuDoor_HwDiagCmn <-> outer port VeDIOR_FuDoor_HwDiagCmn
    delegate CPT_IoSigDioOutp_SwSStellantisCmpstn.KeCFGR_b_TOH_ChEquid <-> outer port KeCFGR_b_TOH_ChEquid
    delegate CPT_IoSigAdc_SwSStellantisCmpstn.EvapLkChkMonSns <-> outer port EvapLkChkMonSns
    delegate CPT_Cdd_Composition.VeLISR_h_DigIonSnsRes1 <-> outer port VeLISR_h_DigIonSnsRes1
    delegate CPT_IoSigDioOutp_SwSStellantisCmpstn.VeDIOR_e_TOH_ShutOffVlvIndDiagInfo <-> outer port VeDIOR_e_TOH_ShutOffVlvIndDiagInfo
    delegate CPT_IoSigPwmOutp_SwSStellantisCmpstn.VeDIOR_ELCM_VacPmp_HwDiagFltOutp <-> outer port VeDIOR_ELCM_VacPmp_HwDiagFltOutp
    delegate CPT_IoSigDioOutp_SwSStellantisCmpstn.KeCFGR_b_FuDoor_ChEquid <-> outer port KeCFGR_b_FuDoor_ChEquid
    delegate CPT_IoSigPwmOutp_SwSStellantisCmpstn.KeCFGR_b_ELCM_VacPmp_ChEquid <-> outer port KeCFGR_b_ELCM_VacPmp_ChEquid
    delegate CPT_IoSigPwmOutp_SwSStellantisCmpstn.VeDIOR_WgSoln_HwDiagFltOutp <-> outer port VeDIOR_WgSoln_HwDiagFltOutp
    delegate CPT_IoSigIfAdapt_SwSStellantisCmpstn.VeSPLR_e_HwMpgVrnt <-> outer port VeSPLR_e_HwMpgVrnt
    delegate CPT_IoSigDioOutp_SwSStellantisCmpstn.VeDIOR_FuTankIsolnVlvHwDiagFltCircDtctd <-> outer port VeDIOR_FuTankIsolnVlvHwDiagFltCircDtctd
    delegate CPT_IoSigAdc_SwSStellantisCmpstn.KeCFGR_b_ReAxleTempSnsrAdcInpEquid <-> outer port KeCFGR_b_ReAxleTempSnsrAdcInpEquid
    delegate CPT_IoSigPwmOutp_SwSStellantisCmpstn.VeDIOR_WgSoln_HwDiagFltCircDtctd <-> outer port VeDIOR_WgSoln_HwDiagFltCircDtctd
    delegate CPT_IoSigIfAdapt_SwSStellantisCmpstn.VeODMR_l_VehOdo <-> outer port VeODMR_l_VehOdo
    delegate CPT_IoSigIfAdapt_SwSStellantisCmpstn.VeSPLR_b_HwOptnECU_Typ <-> outer port VeSPLR_b_HwOptnECU_Typ
    delegate CPT_IoSigPwmOutp_SwSStellantisCmpstn.VeDIOR_FuPmpCtlMdul2Cmd_HwDiagFltOutp <-> outer port VeDIOR_FuPmpCtlMdul2Cmd_HwDiagFltOutp
    delegate CPT_IoSigAdc_SwSStellantisCmpstn.CmprInletTemp <-> outer port CmprInletTemp
    delegate CPT_Cdd_Composition.VeINJR_e_DI_NrOfPulsesAct <-> outer port VeINJR_e_DI_NrOfPulsesAct
    delegate CPT_IoSigDioOutp_SwSStellantisCmpstn.VeDIOR_SrgSoln2_HwDiagFltOutp <-> outer port VeDIOR_SrgSoln2_HwDiagFltOutp
    delegate CPT_IoSigAdc_SwSStellantisCmpstn.VeADCR_U_BoostTemp1 <-> outer port VeADCR_U_BoostTemp1
    delegate CPT_IoSigIfAdapt_SwSStellantisCmpstn.VeKEYR_e_IgnSwSt <-> outer port VeKEYR_e_IgnSwSt
    delegate CPT_IoSigAdc_SwSStellantisCmpstn.VeADCR_U_CmprInletTemp <-> outer port VeADCR_U_CmprInletTemp
    delegate CPT_IoSigDioOutp_SwSStellantisCmpstn.KeCFGR_b_SrgSoln2_ChEquid <-> outer port KeCFGR_b_SrgSoln2_ChEquid
    delegate CPT_IoSigPwmOutp_SwSStellantisCmpstn.VeDIOR_PurgSoln2_HwDiagCmn <-> outer port VeDIOR_PurgSoln2_HwDiagCmn
    delegate CPT_SentStack_SwSStellantisCmpstn.KsSNTR_h_DeltAbsPresSnsr1_SENTCfg <-> outer port KsSNTR_h_DeltAbsPresSnsr1_SENTCfg
    delegate CPT_IoSigIfAdapt_SwSStellantisCmpstn.VeODMR_l_ECM_Odo <-> outer port VeODMR_l_ECM_Odo
    delegate CPT_Cdd_Composition.VeITKR_cmp_TrapdAirNormdFu <-> outer port VeITKR_cmp_TrapdAirNormdFu
    delegate CPT_IoSigPwmOutp_SwSStellantisCmpstn.VeDIOR_FuPmpCtlMdul2Cmd_HwDiagCmn <-> outer port VeDIOR_FuPmpCtlMdul2Cmd_HwDiagCmn
    delegate CPT_IoSigDioInp_SwSStellantisCmpstn.VeDIOR_b_FuDoorSwDigInpFiltdVal <-> outer port VeDIOR_b_FuDoorSwDigInpFiltdVal
    delegate CPT_IoSigAdc_SwSStellantisCmpstn.VeADCR_U_CoolEGR_Temp <-> outer port VeADCR_U_CoolEGR_Temp
    delegate CPT_IoSigDioOutp_SwSStellantisCmpstn.VeDIOR_e_DualFuTankEnblRlyIndDiagInfo <-> outer port VeDIOR_e_DualFuTankEnblRlyIndDiagInfo
    delegate CPT_IoSigAdc_SwSStellantisCmpstn.KeCFGR_b_BoostTemp2AdcInpEquid <-> outer port KeCFGR_b_BoostTemp2AdcInpEquid
    delegate CPT_IoSigAdc_SwSStellantisCmpstn.KeCFGR_b_CoolEgrTAdcInpEquid <-> outer port KeCFGR_b_CoolEgrTAdcInpEquid
    delegate CPT_IoSigPwmOutp_SwSStellantisCmpstn.VeDIOR_WgSoln_HwDiagCmn <-> outer port VeDIOR_WgSoln_HwDiagCmn
    delegate CPT_IoSigDioOutp_SwSStellantisCmpstn.SetDIOR_b_FuDoorOutpSt <-> outer port SetDIOR_b_FuDoorOutpSt
    delegate CPT_IoSigDioOutp_SwSStellantisCmpstn.VeDIOR_ELCM_ChgOvrVlvHwDiagFltOutp <-> outer port VeDIOR_ELCM_ChgOvrVlvHwDiagFltOutp
    delegate CPT_IoSigAdc_SwSStellantisCmpstn.BoostTemp2 <-> outer port BoostTemp2
    delegate CPT_IoSigIfAdapt_SwSStellantisCmpstn.VeSPLR_y_HwDesignMaxCyl <-> outer port VeSPLR_y_HwDesignMaxCyl
    delegate CPT_IoSigDioOutp_SwSStellantisCmpstn.SetDIOR_b_SrgSoln2OutpSt <-> outer port SetDIOR_b_SrgSoln2OutpSt
    delegate CPT_IoSigAdc_SwSStellantisCmpstn.HiTRadrOutlTSnsr <-> outer port HiTRadrOutlTSnsr
    delegate CPT_SentStack_SwSStellantisCmpstn.GetSNTR_e_GPF_DeltAbsPresSnsr1 <-> outer port GetSNTR_e_GPF_DeltAbsPresSnsr1
    delegate CPT_IoSigPwmOutp_SwSStellantisCmpstn.KeCFGR_b_PurgSoln2_ChEquid <-> outer port KeCFGR_b_PurgSoln2_ChEquid
    delegate CPT_IoSigPwmOutp_SwSStellantisCmpstn.VeDIOR_HTR_TempCtrlVlvSoln_HwDiagFltOutp <-> outer port VeDIOR_HTR_TempCtrlVlvSoln_HwDiagFltOutp
    delegate CPT_IoSigPwmOutp_SwSStellantisCmpstn.VeDIOR_e_FuPmpCtlMdul2CmdIndDiagInfo <-> outer port VeDIOR_e_FuPmpCtlMdul2CmdIndDiagInfo
    delegate CPT_IoSigIfAdapt_SwSStellantisCmpstn.VeSPLR_b_HwOptnIntkOxSnsrIC_Cfg <-> outer port VeSPLR_b_HwOptnIntkOxSnsrIC_Cfg
    delegate CPT_IoSigDioOutp_SwSStellantisCmpstn.VeDIOR_e_FuTankIsolnVlvIndDiagInfo <-> outer port VeDIOR_e_FuTankIsolnVlvIndDiagInfo
    delegate CPT_IoSigDioOutp_SwSStellantisCmpstn.VeDIOR_FuDoor_HwDiagFltCircDtctd <-> outer port VeDIOR_FuDoor_HwDiagFltCircDtctd
    delegate CPT_IoSigAdc_SwSStellantisCmpstn.VeADCR_U_WgPosn2 <-> outer port VeADCR_U_WgPosn2
    delegate CPT_IoSigDioOutp_SwSStellantisCmpstn.VeDIOR_DualFuTankEnblRly_HwDiagFltCircDtctd <-> outer port VeDIOR_DualFuTankEnblRly_HwDiagFltCircDtctd
    delegate CPT_Cdd_Composition.VeMFDR_phi_SprkWinDur <-> outer port VeMFDR_phi_SprkWinDur
    delegate CPT_IoSigDioOutp_SwSStellantisCmpstn.SetDIOR_b_TOH_ShutOffVlvOutpSt <-> outer port SetDIOR_b_TOH_ShutOffVlvOutpSt
    delegate CPT_IoSigAdc_SwSStellantisCmpstn.KeCFGR_b_HiTRadrOutlTSnsrAdcInpEquid <-> outer port KeCFGR_b_HiTRadrOutlTSnsrAdcInpEquid
    delegate CPT_IoSigPwmOutp_SwSStellantisCmpstn.VeDIOR_e_PurgSoln2_IndDiagInfo <-> outer port VeDIOR_e_PurgSoln2_IndDiagInfo
    delegate CPT_IoSigAdc_SwSStellantisCmpstn.GdiFuRailP2 <-> outer port GdiFuRailP2
    delegate CPT_IoSigDioOutp_SwSStellantisCmpstn.KeCFGR_b_DualFuTankEnblRly_ChEquid <-> outer port KeCFGR_b_DualFuTankEnblRly_ChEquid
    delegate CPT_IoSigPwmOutp_SwSStellantisCmpstn.SetDIOR_e_FuPmpCtlMdul2CmdOutpOps <-> outer port SetDIOR_e_FuPmpCtlMdul2CmdOutpOps
    delegate CPT_Cdd_Composition.VeMFDR_phi_SprkWinStrtCyl2 <-> outer port VeMFDR_phi_SprkWinStrtCyl2
    delegate CPT_IoSigAdc_SwSStellantisCmpstn.BoostTemp1 <-> outer port BoostTemp1
    delegate CPT_IoSigDioOutp_SwSStellantisCmpstn.VeDIOR_FuDoor_HwDiagFltOutp <-> outer port VeDIOR_FuDoor_HwDiagFltOutp
    delegate CPT_IoSigPwmOutp_SwSStellantisCmpstn.VeDIOR_ELCM_VacPmp_HwDiagCmn <-> outer port VeDIOR_ELCM_VacPmp_HwDiagCmn
    delegate CPT_IoSigAdc_SwSStellantisCmpstn.WgPosn2 <-> outer port WgPosn2
    delegate CPT_SentStack_SwSStellantisCmpstn.KsSNTR_h_DeltAbsPresSnsr2_SENTCfg <-> outer port KsSNTR_h_DeltAbsPresSnsr2_SENTCfg
    delegate CPT_IoSigIfAdapt_SwSStellantisCmpstn.VeSPLR_b_HwOptnOxSnsrIC_Cfg <-> outer port VeSPLR_b_HwOptnOxSnsrIC_Cfg
    delegate CPT_IoSigAdc_SwSStellantisCmpstn.KeCFGR_b_EvapLkChkMonSnsAdcInpEquid <-> outer port KeCFGR_b_EvapLkChkMonSnsAdcInpEquid
    delegate CPT_IoSigIfAdapt_SwSStellantisCmpstn.KeCFGR_b_AGS_Equid <-> outer port KeCFGR_b_AGS_Equid
    delegate CPT_ComCIL_Adapt.VeRxPDU_DPT_BRAKE_FD_6_PduData <-> outer port VeRxPDU_DPT_BRAKE_FD_6_PduData
    delegate CPT_ComVeh.SendCANR_MC_ENG7_FD14 <-> outer port SendCANR_MC_ENG7_FD14
    delegate CPT_ComVeh.SendCANR_MntncSts_FD3Vld <-> outer port SendCANR_MntncSts_FD3Vld
    delegate CPT_ComVeh.VeCANR_y_CRC_ADAS_FD_HMI_FD14 <-> outer port VeCANR_y_CRC_ADAS_FD_HMI_FD14
    delegate CPT_ComVeh.SendCANR_Override_FD14Vld <-> outer port SendCANR_Override_FD14Vld
    delegate CPT_ComVeh.SendCANR_MdsAct_FD3Vld <-> outer port SendCANR_MdsAct_FD3Vld
    delegate CPT_ComVeh.SendCANR_SpeedLimitSts_FD14 <-> outer port SendCANR_SpeedLimitSts_FD14
    delegate CPT_ComVeh.VeCANR_b_CRC_ADAS_FD_HMI_FD14TO <-> outer port VeCANR_b_CRC_ADAS_FD_HMI_FD14TO
    delegate CPT_ComVeh.SendCANR_MC_ENG7_FD14Vld <-> outer port SendCANR_MC_ENG7_FD14Vld
    delegate CPT_ComVeh.SendCANR_ThrmlMngmtActvW_FD14Vld <-> outer port SendCANR_ThrmlMngmtActvW_FD14Vld
    delegate CPT_ComVeh.SendCANR_DrvAway_IndicationsFD3 <-> outer port SendCANR_DrvAway_IndicationsFD3
    delegate CPT_ComVeh.SendCANR_MdsActforANC_FD3Vld <-> outer port SendCANR_MdsActforANC_FD3Vld
    delegate CPT_ComVeh.SendCANR_MC_ENGINE_HYBD_FD_3FD3 <-> outer port SendCANR_MC_ENGINE_HYBD_FD_3FD3
    delegate CPT_ComVeh.SendCANR_Man_PFW_Stat_FD3 <-> outer port SendCANR_Man_PFW_Stat_FD3
    delegate CPT_ComCIL_Adapt.VeCANR_b_CCAN12_CurrBusOffSt <-> outer port VeCANR_b_CCAN12_CurrBusOffSt
    delegate CPT_ComVeh.SendCANR_ECM_TRSC_Resp_FD14 <-> outer port SendCANR_ECM_TRSC_Resp_FD14
    delegate CPT_ComVeh.SendCANR_CRC_ENGINE1_FD14 <-> outer port SendCANR_CRC_ENGINE1_FD14
    delegate CPT_ComVeh.SendCANR_MdsActforANC_FD3 <-> outer port SendCANR_MdsActforANC_FD3
    delegate CPT_ComVeh.VeCANR_b_PrpnSystemActive_FD14TO <-> outer port VeCANR_b_PrpnSystemActive_FD14TO
    delegate CPT_ComVeh.SendCANR_ECM_THA_Resp_FD14 <-> outer port SendCANR_ECM_THA_Resp_FD14
    delegate CPT_ComVeh.SendCANR_MinEngSpdCap_FD3 <-> outer port SendCANR_MinEngSpdCap_FD3
    delegate CPT_ComVeh.SendCANR_DrvAway_IndicationsFD3Vld <-> outer port SendCANR_DrvAway_IndicationsFD3Vld
    delegate CPT_ComVeh.SendCANR_MdsAct_FD3 <-> outer port SendCANR_MdsAct_FD3
    delegate CPT_ComVeh.SendCANR_MC_ENG8_FD3 <-> outer port SendCANR_MC_ENG8_FD3
    delegate CPT_ComVeh.SendCANR_MC_ENG1_FD3Vld <-> outer port SendCANR_MC_ENG1_FD3Vld
    delegate CPT_ComVeh.SendCANR_MC_ENG1_FD14 <-> outer port SendCANR_MC_ENG1_FD14
    delegate CPT_ComVeh.SendCANR_MAP_4_BAR_FD3Vld <-> outer port SendCANR_MAP_4_BAR_FD3Vld
    delegate CPT_ComVeh.SendCANR_MC_ENGINE_HYBD_FD_4FD3Vld <-> outer port SendCANR_MC_ENGINE_HYBD_FD_4FD3Vld
    delegate CPT_ComVeh.SendCANR_CRC_ENGINE3_FD14 <-> outer port SendCANR_CRC_ENGINE3_FD14
    delegate CPT_ComVeh.SendCANR_MC_ENG1_FD3 <-> outer port SendCANR_MC_ENG1_FD3
    delegate CPT_ComVeh.VeCANR_b_Set_Speed_MPH_TO <-> outer port VeCANR_b_Set_Speed_MPH_TO
    delegate CPT_ComVeh.SendCANR_SpeedLimitSts_FD14Vld <-> outer port SendCANR_SpeedLimitSts_FD14Vld
    delegate CPT_ComVeh.SendCANR_MC_ENG7_FD3 <-> outer port SendCANR_MC_ENG7_FD3
    delegate CPT_ComVeh.SendCANR_MC_ENG6_FD3 <-> outer port SendCANR_MC_ENG6_FD3
    delegate CPT_ComVeh.SendCANR_MC_ENG6_FD3Vld <-> outer port SendCANR_MC_ENG6_FD3Vld
    delegate CPT_ComVeh.VeCANR_v_Set_Speed_KPH_FD14 <-> outer port VeCANR_v_Set_Speed_KPH_FD14
    delegate CPT_ComVeh.SendCANR_ECM_THA_Resp_FD14Vld <-> outer port SendCANR_ECM_THA_Resp_FD14Vld
    delegate CPT_ComVeh.SendCANR_Override_FD14 <-> outer port SendCANR_Override_FD14
    delegate CPT_ComVeh.SendCANR_MC_OBDCONTENTFRAME_FD3 <-> outer port SendCANR_MC_OBDCONTENTFRAME_FD3
    delegate CPT_ComVeh.SendCANR_Man_PFW_Timer_FD3Vld <-> outer port SendCANR_Man_PFW_Timer_FD3Vld
    delegate CPT_ComVeh.SendCANR_ISASts_FD14Vld <-> outer port SendCANR_ISASts_FD14Vld
    delegate CPT_ComVeh.SendCANR_MaxEngSpdCap_FD3 <-> outer port SendCANR_MaxEngSpdCap_FD3
    delegate CPT_ComVeh.SendCANR_MC_OBDCONTENTFRAME_FD3Vld <-> outer port SendCANR_MC_OBDCONTENTFRAME_FD3Vld
    delegate CPT_ComVeh.SendCANR_MC_ENGINE_HYBD_FD_4FD3 <-> outer port SendCANR_MC_ENGINE_HYBD_FD_4FD3
    delegate CPT_ComVeh.SendCANR_MaxEngSpdCap_FD3Vld <-> outer port SendCANR_MaxEngSpdCap_FD3Vld
    delegate CPT_ComVeh.VeCANR_b_Set_Speed_KPH_FD14TO <-> outer port VeCANR_b_Set_Speed_KPH_FD14TO
    delegate CPT_ComVeh.SendCANR_ThrmlMngmtActvW_FD14 <-> outer port SendCANR_ThrmlMngmtActvW_FD14
    delegate CPT_ComVeh.SendCANR_MAP_4_BAR_FD3 <-> outer port SendCANR_MAP_4_BAR_FD3
    delegate CPT_ComVeh.SendCANR_CRC_ENGINE7_FD14 <-> outer port SendCANR_CRC_ENGINE7_FD14
    delegate CPT_ComVeh.SendCANR_MC_ENG3_FD14 <-> outer port SendCANR_MC_ENG3_FD14
    delegate CPT_ComVeh.SendCANR_MC_ENG7_FD3Vld <-> outer port SendCANR_MC_ENG7_FD3Vld
    delegate CPT_ComVeh.SendCANR_MC_ENGINE_HYBD_FD_3FD3Vld <-> outer port SendCANR_MC_ENGINE_HYBD_FD_3FD3Vld
    delegate CPT_ComVeh.VeCANR_b_MsgCtr_ADAS_FD_HMIFD14TO <-> outer port VeCANR_b_MsgCtr_ADAS_FD_HMIFD14TO
    delegate CPT_ComVeh.SendCANR_CRC_ENGINE3_FD14Vld <-> outer port SendCANR_CRC_ENGINE3_FD14Vld
    delegate CPT_IoSigIfAdapt_SwSStellantisCmpstn.VeLLTR_t_EvapSysPSwtTi <-> outer port VeLLTR_t_EvapSysPSwtTi
    delegate CPT_ComVeh.VeCANR_e_SelectSpdSts_FD14 <-> outer port VeCANR_e_SelectSpdSts_FD14
    delegate CPT_ComVeh.VeCANR_b_PrpnSystemActive_FD14 <-> outer port VeCANR_b_PrpnSystemActive_FD14
    delegate CPT_ComVeh.SendCANR_MC_ENG8_FD3Vld <-> outer port SendCANR_MC_ENG8_FD3Vld
    delegate CPT_ComVeh.VeCANR_b_SelectSpdSts_FD14TO <-> outer port VeCANR_b_SelectSpdSts_FD14TO
    delegate CPT_ComVeh.VeCANR_v_Set_Speed_MPH <-> outer port VeCANR_v_Set_Speed_MPH
    delegate CPT_ComVeh.VeCANR_y_MsgCtr_ADAS_FD_HMIFD14 <-> outer port VeCANR_y_MsgCtr_ADAS_FD_HMIFD14
    delegate CPT_ComVeh.SendCANR_MntncSts_FD3 <-> outer port SendCANR_MntncSts_FD3
    delegate CPT_ComVeh.SendCANR_MC_ENG3_FD14Vld <-> outer port SendCANR_MC_ENG3_FD14Vld
    delegate CPT_ComVeh.SendCANR_MC_ENG1_FD14Vld <-> outer port SendCANR_MC_ENG1_FD14Vld
    delegate CPT_ComVeh.SendCANR_Man_PFW_Timer_FD3 <-> outer port SendCANR_Man_PFW_Timer_FD3
    delegate CPT_ComVeh.SendCANR_ECM_TRSC_Resp_FD14Vld <-> outer port SendCANR_ECM_TRSC_Resp_FD14Vld
    delegate CPT_ComVeh.SendCANR_ISASts_FD14 <-> outer port SendCANR_ISASts_FD14
    delegate CPT_ComVeh.SendCANR_CRC_ENGINE7_FD14Vld <-> outer port SendCANR_CRC_ENGINE7_FD14Vld
    delegate CPT_ComVeh.SendCANR_MinEngSpdCap_FD3Vld <-> outer port SendCANR_MinEngSpdCap_FD3Vld
    delegate CPT_ComVeh.SendCANR_CRC_ENGINE1_FD14Vld <-> outer port SendCANR_CRC_ENGINE1_FD14Vld
    delegate CPT_ComVeh.SendCANR_MC_ENG3_FD3 <-> outer port SendCANR_MC_ENG3_FD3
    delegate CPT_ComVeh.SendCANR_Man_PFW_Stat_FD3Vld <-> outer port SendCANR_Man_PFW_Stat_FD3Vld
    delegate CPT_ComVeh.SendCANR_MC_ENG3_FD3Vld <-> outer port SendCANR_MC_ENG3_FD3Vld
    connect CPT_ComDia_Dcm_Rte_Adapter.DataServices_DE124_VeDEMD_y_P0174_EventStatus -> CPT_Dcm.DataServices_DE124_VeDEMD_y_P0174_EventStatus
    connect CPT_ComDia_Dcm_Rte_Adapter.DataServices_DE223_OxSnsrHeatrCoilU -> CPT_Dcm.DataServices_DE223_OxSnsrHeatrCoilU
    connect CPT_ComDia_Dcm_Rte_Adapter.DataServices_DE124_VeDEMD_y_P0300_EventStatus -> CPT_Dcm.DataServices_DE124_VeDEMD_y_P0300_EventStatus
    connect CPT_ComDia_Dcm_Rte_Adapter.DataServices_DE124_VeDEMD_y_P1128_EventStatus -> CPT_Dcm.DataServices_DE124_VeDEMD_y_P1128_EventStatus
    connect CPT_ComDia_Dcm_Rte_Adapter.DataServices_DE124_CrksftPosnSnsr1CircFlt_EnaStsReg -> CPT_Dcm.DataServices_DE124_CrksftPosnSnsr1CircFlt_EnaStsReg
    connect CPT_ComDia_Dcm_Rte_Adapter.DataServices_DE102_VeCAMD_Cnt_P0345_StrtMatrMax -> CPT_Dcm.DataServices_DE102_VeCAMD_Cnt_P0345_StrtMatrMax
    connect CPT_ComDia_Dcm_Rte_Adapter.DataServices_DE113_VeCRKO_b_ETPU_SyncnSts -> CPT_Dcm.DataServices_DE113_VeCRKO_b_ETPU_SyncnSts
    connect CPT_ComDia_Dcm_Rte_Adapter.DataServices_DE102_VeCRKO_Cnt_MaxMissInRunMatrCnt -> CPT_Dcm.DataServices_DE102_VeCRKO_Cnt_MaxMissInRunMatrCnt
    connect CPT_ComDia_Dcm_Rte_Adapter.DataServices_DE124_VeDEMD_y_P0128_EventStatus -> CPT_Dcm.DataServices_DE124_VeDEMD_y_P0128_EventStatus
    connect CPT_ComDia_Dcm_Rte_Adapter.DataServices_DE124_VeDEMD_y_P1E09_EventStatus -> CPT_Dcm.DataServices_DE124_VeDEMD_y_P1E09_EventStatus
    connect CPT_ComDia_Dcm_Rte_Adapter.DataServices_DE102_VeCAMR_Cnt_Intk2MatrCntMaxReachd -> CPT_Dcm.DataServices_DE102_VeCAMR_Cnt_Intk2MatrCntMaxReachd
    connect CPT_ComDia_Dcm_Rte_Adapter.DataServices_DE124_VeDEMD_y_P0160_EventStatus -> CPT_Dcm.DataServices_DE124_VeDEMD_y_P0160_EventStatus
    connect CPT_ComDia_Dcm_Rte_Adapter.DataServices_DE124_VeDEMD_y_P0161_EventStatus -> CPT_Dcm.DataServices_DE124_VeDEMD_y_P0161_EventStatus
    connect CPT_ComDia_Dcm_Rte_Adapter.DataServices_DE111_VeOHTR_R_OxSnsrHtrDsBnk1Raw -> CPT_Dcm.DataServices_DE111_VeOHTR_R_OxSnsrHtrDsBnk1Raw
    connect CPT_ComDia_Dcm_Rte_Adapter.DataServices_DE124_VeDEMD_y_P0461_EventStatus -> CPT_Dcm.DataServices_DE124_VeDEMD_y_P0461_EventStatus
    connect CPT_ComDia_Dcm_Rte_Adapter.DataServices_DE124_VeDEMD_y_P0159_EventStatus -> CPT_Dcm.DataServices_DE124_VeDEMD_y_P0159_EventStatus
    connect CPT_ComDia_Dcm_Rte_Adapter.DataServices_DE124_VeDEMD_y_C10F5_EventStatus -> CPT_Dcm.DataServices_DE124_VeDEMD_y_C10F5_EventStatus
    connect CPT_ComDia_Dcm_Rte_Adapter.DataServices_DE124_VeDEMD_y_P0171_EventStatus -> CPT_Dcm.DataServices_DE124_VeDEMD_y_P0171_EventStatus
    connect CPT_ComDia_Dcm_Rte_Adapter.DataServices_DE102_VeCAMR_Cnt_Intk1MatrCntMaxReachd -> CPT_Dcm.DataServices_DE102_VeCAMR_Cnt_Intk1MatrCntMaxReachd
    connect CPT_ComDia_Dcm_Rte_Adapter.DataServices_DE124_VeDEMD_y_P0335_EventStatus -> CPT_Dcm.DataServices_DE124_VeDEMD_y_P0335_EventStatus
    connect CPT_ComDia_Dcm_Rte_Adapter.DataServices_DE124_VeDEMD_y_P0152_EventStatus -> CPT_Dcm.DataServices_DE124_VeDEMD_y_P0152_EventStatus
    connect CPT_ComDia_Dcm_Rte_Adapter.DataServices_DE124_VeDEMD_y_P0521_EventStatus -> CPT_Dcm.DataServices_DE124_VeDEMD_y_P0521_EventStatus
    connect CPT_ComDia_Dcm_Rte_Adapter.DataServices_DE102_VeCRKO_Cnt_MaxCrksftStrtUpNotSeenTmr -> CPT_Dcm.DataServices_DE102_VeCRKO_Cnt_MaxCrksftStrtUpNotSeenTmr
    connect CPT_ComDia_Dcm_Rte_Adapter.DataServices_DE124_VeDEMD_y_P0304_EventStatus -> CPT_Dcm.DataServices_DE124_VeDEMD_y_P0304_EventStatus
    connect CPT_ComDia_Dcm_Rte_Adapter.DataServices_DE208_CamcrksftDifIsAllNvEdgesLrnd -> CPT_Dcm.DataServices_DE208_CamcrksftDifIsAllNvEdgesLrnd
    connect CPT_ComDia_Dcm_Rte_Adapter.DataServices_DE124_VeDEMD_y_P0850_EventStatus -> CPT_Dcm.DataServices_DE124_VeDEMD_y_P0850_EventStatus
    connect CPT_ComDia_Dcm_Rte_Adapter.DataServices_DE124_VeDEMD_y_P2066_EventStatus -> CPT_Dcm.DataServices_DE124_VeDEMD_y_P2066_EventStatus
    connect CPT_ComDia_Dcm_Rte_Adapter.DataServices_DE124_VeDEMD_y_P1DBD_EventStatus -> CPT_Dcm.DataServices_DE124_VeDEMD_y_P1DBD_EventStatus
    connect CPT_ComDia_Dcm_Rte_Adapter.DataServices_DE124_VeCRKD_y_P0339_EnblSts -> CPT_Dcm.DataServices_DE124_VeCRKD_y_P0339_EnblSts
    connect CPT_ComDia_Dcm_Rte_Adapter.DataServices_DE212_ETPU_IgnFlybackPW0 -> CPT_Dcm.DataServices_DE212_ETPU_IgnFlybackPW0
    connect CPT_ComDia_Dcm_Rte_Adapter.DataServices_DE113_VeLLSO_y_IgnPinStsMimic -> CPT_Dcm.DataServices_DE113_VeLLSO_y_IgnPinStsMimic
    connect CPT_ComDia_Dcm_Rte_Adapter.DataServices_D9E08_VeRPMR_n_EngSpdResl1 -> CPT_Dcm.DataServices_D9E08_VeRPMR_n_EngSpdResl1
    connect CPT_ComDia_Dcm_Rte_Adapter.DataServices_DE124_VeDEMD_y_P2097_EventStatus -> CPT_Dcm.DataServices_DE124_VeDEMD_y_P2097_EventStatus
    connect CPT_ComDia_Dcm_Rte_Adapter.DataServices_DE124_VeDEMD_y_P0155_EventStatus -> CPT_Dcm.DataServices_DE124_VeDEMD_y_P0155_EventStatus
    connect CPT_ComDia_Dcm_Rte_Adapter.DataServices_DE124_VeDEMD_y_C053D_EventStatus -> CPT_Dcm.DataServices_DE124_VeDEMD_y_C053D_EventStatus
    connect CPT_ComDia_Dcm_Rte_Adapter.DataServices_DE124_VeDEMD_y_P1E0A_EventStatus -> CPT_Dcm.DataServices_DE124_VeDEMD_y_P1E0A_EventStatus
    connect CPT_ComDia_Dcm_Rte_Adapter.DataServices_DE212_EngRvsRotMonrSts -> CPT_Dcm.DataServices_DE212_EngRvsRotMonrSts
    connect CPT_ComDia_Dcm_Rte_Adapter.DataServices_DE124_VeDEMD_y_P0303_EventStatus -> CPT_Dcm.DataServices_DE124_VeDEMD_y_P0303_EventStatus
    connect CPT_ComDia_Dcm_Rte_Adapter.DataServices_DE124_VeDEMD_y_P0301_EventStatus -> CPT_Dcm.DataServices_DE124_VeDEMD_y_P0301_EventStatus
    connect CPT_ComDia_Dcm_Rte_Adapter.DataServices_DE124_VeDEMD_y_P0196_EventStatus -> CPT_Dcm.DataServices_DE124_VeDEMD_y_P0196_EventStatus
    connect CPT_ComDia_Dcm_Rte_Adapter.DataServices_DE124_VeDEMD_y_P0308_EventStatus -> CPT_Dcm.DataServices_DE124_VeDEMD_y_P0308_EventStatus
    connect CPT_ComDia_Dcm_Rte_Adapter.DataServices_DE124_VeDEMD_y_P1115_EventStatus -> CPT_Dcm.DataServices_DE124_VeDEMD_y_P1115_EventStatus
    connect CPT_ComDia_Dcm_Rte_Adapter.DataServices_DE124_VeDEMD_y_P0172_EventStatus -> CPT_Dcm.DataServices_DE124_VeDEMD_y_P0172_EventStatus
    connect CPT_ComDia_Dcm_Rte_Adapter.DataServices_DE201_CAM_SYNC_STATUS_EXH_1 -> CPT_Dcm.DataServices_DE201_CAM_SYNC_STATUS_EXH_1
    connect CPT_ComDia_Dcm_Rte_Adapter.DataServices_DE124_VeDEMD_y_P2099_EventStatus -> CPT_Dcm.DataServices_DE124_VeDEMD_y_P2099_EventStatus
    connect CPT_ComDia_Dcm_Rte_Adapter.DataServices_DE124_VeDEMD_y_P0132_EventStatus -> CPT_Dcm.DataServices_DE124_VeDEMD_y_P0132_EventStatus
    connect CPT_ComDia_Dcm_Rte_Adapter.DataServices_DE124_VeDEMD_y_P0151_EventStatus -> CPT_Dcm.DataServices_DE124_VeDEMD_y_P0151_EventStatus
    connect CPT_ComDia_Dcm_Rte_Adapter.DataServices_DE124_VeDEMD_y_P0330_EventStatus -> CPT_Dcm.DataServices_DE124_VeDEMD_y_P0330_EventStatus
    connect CPT_ComDia_Dcm_Rte_Adapter.DataServices_DE111_VeOHTR_R_OxSnsrHtrUsBnk2Raw -> CPT_Dcm.DataServices_DE111_VeOHTR_R_OxSnsrHtrUsBnk2Raw
    connect CPT_ComDia_Dcm_Rte_Adapter.DataServices_DE124_VeDEMD_y_P0131_EventStatus -> CPT_Dcm.DataServices_DE124_VeDEMD_y_P0131_EventStatus
    connect CPT_ComDia_Dcm_Rte_Adapter.DataServices_DE124_VeDEMD_y_P0137_EventStatus -> CPT_Dcm.DataServices_DE124_VeDEMD_y_P0137_EventStatus
    connect CPT_ComDia_Dcm_Rte_Adapter.DataServices_DE201_CAM_SYNC_STATUS_INT_2 -> CPT_Dcm.DataServices_DE201_CAM_SYNC_STATUS_INT_2
    connect CPT_ComDia_Dcm_Rte_Adapter.DataServices_DE102_VeCAMR_phi_Exh2MaxDifReachd -> CPT_Dcm.DataServices_DE102_VeCAMR_phi_Exh2MaxDifReachd
    connect CPT_ComDia_Dcm_Rte_Adapter.DataServices_DE124_VeDEMD_y_P219A_EventStatus -> CPT_Dcm.DataServices_DE124_VeDEMD_y_P219A_EventStatus
    connect CPT_ComDia_Dcm_Rte_Adapter.DataServices_DE102_VeCRKO_Cnt_MaxCrksftUnlckMatrCntr -> CPT_Dcm.DataServices_DE102_VeCRKO_Cnt_MaxCrksftUnlckMatrCntr
    connect CPT_ComDia_Dcm_Rte_Adapter.DataServices_DE124_VeDEMD_y_P1607_EventStatus -> CPT_Dcm.DataServices_DE124_VeDEMD_y_P1607_EventStatus
    connect CPT_ComDia_Dcm_Rte_Adapter.DataServices_DE124_VeDEMD_y_P1129_EventStatus -> CPT_Dcm.DataServices_DE124_VeDEMD_y_P1129_EventStatus
    connect CPT_ComDia_Dcm_Rte_Adapter.DataServices_DE124_VeDEMD_y_P0307_EventStatus -> CPT_Dcm.DataServices_DE124_VeDEMD_y_P0307_EventStatus
    connect CPT_ComDia_Dcm_Rte_Adapter.DataServices_DE124_VeDEMD_y_P1239_EventStatus -> CPT_Dcm.DataServices_DE124_VeDEMD_y_P1239_EventStatus
    connect CPT_ComDia_Dcm_Rte_Adapter.DataServices_DE124_VeDEMD_y_P0306_EventStatus -> CPT_Dcm.DataServices_DE124_VeDEMD_y_P0306_EventStatus
    connect CPT_ComDia_Dcm_Rte_Adapter.DataServices_DE124_VeDEMD_y_P0139_EventStatus -> CPT_Dcm.DataServices_DE124_VeDEMD_y_P0139_EventStatus
    connect CPT_ComDia_Dcm_Rte_Adapter.DataServices_DE124_VeDEMD_y_P0141_EventStatus -> CPT_Dcm.DataServices_DE124_VeDEMD_y_P0141_EventStatus
    connect CPT_ComDia_Dcm_Rte_Adapter.DataServices_DE124_VeDEMD_y_P0506_EventStatus -> CPT_Dcm.DataServices_DE124_VeDEMD_y_P0506_EventStatus
    connect CPT_ComDia_Dcm_Rte_Adapter.DataServices_DE124_VeDEMD_y_P0420_EventStatus -> CPT_Dcm.DataServices_DE124_VeDEMD_y_P0420_EventStatus
    connect CPT_ComDia_Dcm_Rte_Adapter.DataServices_DE124_VeDEMD_y_P0302_EventStatus -> CPT_Dcm.DataServices_DE124_VeDEMD_y_P0302_EventStatus
    connect CPT_ComDia_Dcm_Rte_Adapter.DataServices_DE124_VeDEMD_y_P0501_EventStatus -> CPT_Dcm.DataServices_DE124_VeDEMD_y_P0501_EventStatus
    connect CPT_ComDia_Dcm_Rte_Adapter.DataServices_DE124_VeDEMD_y_P0520_EventStatus -> CPT_Dcm.DataServices_DE124_VeDEMD_y_P0520_EventStatus
    connect CPT_ComDia_Dcm_Rte_Adapter.DataServices_DE124_VeDEMD_y_P258B_EventStatus -> CPT_Dcm.DataServices_DE124_VeDEMD_y_P258B_EventStatus
    connect CPT_ComDia_Dcm_Rte_Adapter.DataServices_DE124_VeDEMD_y_P0071_EventStatus -> CPT_Dcm.DataServices_DE124_VeDEMD_y_P0071_EventStatus
    connect CPT_ComDia_Dcm_Rte_Adapter.DataServices_DE102_VeCAMR_Cnt_Exh1MatrCntMaxReachd -> CPT_Dcm.DataServices_DE102_VeCAMR_Cnt_Exh1MatrCntMaxReachd
    connect CPT_ComDia_Dcm_Rte_Adapter.DataServices_DE124_VeDEMD_y_P0140_EventStatus -> CPT_Dcm.DataServices_DE124_VeDEMD_y_P0140_EventStatus
    connect CPT_ComDia_Dcm_Rte_Adapter.DataServices_DE124_VeDEMD_y_P219B_EventStatus -> CPT_Dcm.DataServices_DE124_VeDEMD_y_P219B_EventStatus
    connect CPT_ComDia_Dcm_Rte_Adapter.DataServices_DE124_VeDEMD_y_P0507_EventStatus -> CPT_Dcm.DataServices_DE124_VeDEMD_y_P0507_EventStatus
    connect CPT_ComDia_Dcm_Rte_Adapter.DataServices_DE124_VeDEMD_y_P0116_EventStatus -> CPT_Dcm.DataServices_DE124_VeDEMD_y_P0116_EventStatus
    connect CPT_ComDia_Dcm_Rte_Adapter.DataServices_DE102_VeCAMR_phi_Exh1MaxDifReachd -> CPT_Dcm.DataServices_DE102_VeCAMR_phi_Exh1MaxDifReachd
    connect CPT_ComDia_Dcm_Rte_Adapter.DataServices_DE124_VeDEMD_y_P000A_EventStatus -> CPT_Dcm.DataServices_DE124_VeDEMD_y_P000A_EventStatus
    connect CPT_ComDia_Dcm_Rte_Adapter.DataServices_DE124_VeDEMD_y_P1524_EventStatus -> CPT_Dcm.DataServices_DE124_VeDEMD_y_P1524_EventStatus
    connect CPT_ComDia_Dcm_Rte_Adapter.DataServices_DE124_VeDEMD_y_P0016_EventStatus -> CPT_Dcm.DataServices_DE124_VeDEMD_y_P0016_EventStatus
    connect CPT_ComDia_Dcm_Rte_Adapter.DataServices_DE124_VeDEMD_y_P0138_EventStatus -> CPT_Dcm.DataServices_DE124_VeDEMD_y_P0138_EventStatus
    connect CPT_ComDia_Dcm_Rte_Adapter.DataServices_DE124_VeDEMD_y_P0175_EventStatus -> CPT_Dcm.DataServices_DE124_VeDEMD_y_P0175_EventStatus
    connect CPT_ComDia_Dcm_Rte_Adapter.DataServices_DE124_VeDEMD_y_P0340_EventStatus -> CPT_Dcm.DataServices_DE124_VeDEMD_y_P0340_EventStatus
    connect CPT_ComDia_Dcm_Rte_Adapter.DataServices_DE113_VeLLFO_g_ETPU_InjrPinStsMimic -> CPT_Dcm.DataServices_DE113_VeLLFO_g_ETPU_InjrPinStsMimic
    connect CPT_ComDia_Dcm_Rte_Adapter.DataServices_DE124_VeDEMD_y_P0339_EventStatus -> CPT_Dcm.DataServices_DE124_VeDEMD_y_P0339_EventStatus
    connect CPT_ComDia_Dcm_Rte_Adapter.DataServices_DE124_VeDEMD_y_P018B_EventStatus -> CPT_Dcm.DataServices_DE124_VeDEMD_y_P018B_EventStatus
    connect CPT_ComDia_Dcm_Rte_Adapter.DataServices_DE124_VeDEMD_y_P0135_EventStatus -> CPT_Dcm.DataServices_DE124_VeDEMD_y_P0135_EventStatus
    connect CPT_ComDia_Dcm_Rte_Adapter.DataServices_DE124_VeDEMD_y_P0133_EventStatus -> CPT_Dcm.DataServices_DE124_VeDEMD_y_P0133_EventStatus
    connect CPT_ComDia_Dcm_Rte_Adapter.DataServices_DE124_VeDEMD_y_P000D_EventStatus -> CPT_Dcm.DataServices_DE124_VeDEMD_y_P000D_EventStatus
    connect CPT_ComDia_Dcm_Rte_Adapter.DataServices_DE124_VeDEMD_y_P2273_EventStatus -> CPT_Dcm.DataServices_DE124_VeDEMD_y_P2273_EventStatus
    connect CPT_ComDia_Dcm_Rte_Adapter.DataServices_DE124_VeDEMD_y_P000C_EventStatus -> CPT_Dcm.DataServices_DE124_VeDEMD_y_P000C_EventStatus
    connect CPT_ComDia_Dcm_Rte_Adapter.DataServices_DE124_VeDEMD_y_P0430_EventStatus -> CPT_Dcm.DataServices_DE124_VeDEMD_y_P0430_EventStatus
    connect CPT_ComDia_Dcm_Rte_Adapter.DataServices_DE111_VeOHTR_R_OxSnsrHtrUsBnk1Raw -> CPT_Dcm.DataServices_DE111_VeOHTR_R_OxSnsrHtrUsBnk1Raw
    connect CPT_ComDia_Dcm_Rte_Adapter.DataServices_DE102_VeCAMD_Cnt_P0340_StrtMatrMax -> CPT_Dcm.DataServices_DE102_VeCAMD_Cnt_P0340_StrtMatrMax
    connect CPT_ComDia_Dcm_Rte_Adapter.DataServices_DE208_SyncnSts -> CPT_Dcm.DataServices_DE208_SyncnSts
    connect CPT_ComDia_Dcm_Rte_Adapter.DataServices_DE124_VeDEMD_y_P2096_EventStatus -> CPT_Dcm.DataServices_DE124_VeDEMD_y_P2096_EventStatus
    connect CPT_ComDia_Dcm_Rte_Adapter.DataServices_DE124_VeDEMD_y_P0125_EventStatus -> CPT_Dcm.DataServices_DE124_VeDEMD_y_P0125_EventStatus
    connect CPT_ComDia_Dcm_Rte_Adapter.DataServices_DE102_VeCAMR_phi_Intk1MaxDifReachd -> CPT_Dcm.DataServices_DE102_VeCAMR_phi_Intk1MaxDifReachd
    connect CPT_ComDia_Dcm_Rte_Adapter.DataServices_DE124_VeDEMD_y_P0298_EventStatus -> CPT_Dcm.DataServices_DE124_VeDEMD_y_P0298_EventStatus
    connect CPT_ComDia_Dcm_Rte_Adapter.DataServices_DE111_VeOHTR_R_OxSnsrHtrDsBnk2Raw -> CPT_Dcm.DataServices_DE111_VeOHTR_R_OxSnsrHtrDsBnk2Raw
    connect CPT_ComDia_Dcm_Rte_Adapter.DataServices_DE124_VeDEMD_y_P057B_EventStatus -> CPT_Dcm.DataServices_DE124_VeDEMD_y_P057B_EventStatus
    connect CPT_ComDia_Dcm_Rte_Adapter.DataServices_DE124_VeDEMD_y_P0305_EventStatus -> CPT_Dcm.DataServices_DE124_VeDEMD_y_P0305_EventStatus
    connect CPT_ComDia_Dcm_Rte_Adapter.DataServices_DE124_VeDEMD_y_P2271_EventStatus -> CPT_Dcm.DataServices_DE124_VeDEMD_y_P2271_EventStatus
    connect CPT_ComDia_Dcm_Rte_Adapter.DataServices_DE124_VeDEMD_y_P000B_EventStatus -> CPT_Dcm.DataServices_DE124_VeDEMD_y_P000B_EventStatus
    connect CPT_ComDia_Dcm_Rte_Adapter.DataServices_DE124_VeDEMD_y_P0325_EventStatus -> CPT_Dcm.DataServices_DE124_VeDEMD_y_P0325_EventStatus
    connect CPT_ComDia_Dcm_Rte_Adapter.DataServices_DE124_VeDEMD_y_P0153_EventStatus -> CPT_Dcm.DataServices_DE124_VeDEMD_y_P0153_EventStatus
    connect CPT_ComDia_Dcm_Rte_Adapter.DataServices_DE102_VeCAMR_Cnt_Exh2MatrCntMaxReachd -> CPT_Dcm.DataServices_DE102_VeCAMR_Cnt_Exh2MatrCntMaxReachd
    connect CPT_ComDia_Dcm_Rte_Adapter.DataServices_DE102_VeCAMR_phi_Intk2MaxDifReachd -> CPT_Dcm.DataServices_DE102_VeCAMR_phi_Intk2MaxDifReachd
    connect CPT_ComDia_Dcm_Rte_Adapter.DataServices_DE124_VeDEMD_y_P0344_EventStatus -> CPT_Dcm.DataServices_DE124_VeDEMD_y_P0344_EventStatus
    connect CPT_ComDia_Dcm_Rte_Adapter.DataServices_DE124_VeDEMD_y_P2098_EventStatus -> CPT_Dcm.DataServices_DE124_VeDEMD_y_P2098_EventStatus
    connect CPT_ComDia_Dcm_Rte_Adapter.DataServices_DE124_VeDEMD_y_P0158_EventStatus -> CPT_Dcm.DataServices_DE124_VeDEMD_y_P0158_EventStatus
    connect CPT_ComDia_Dcm_Rte_Adapter.DataServices_DE124_VeDEMD_y_P0157_EventStatus -> CPT_Dcm.DataServices_DE124_VeDEMD_y_P0157_EventStatus
    connect CPT_ComDia_Dcm_Rte_Adapter.DataServices_D9E08_VeVSPR_v_VehSpd -> CPT_Dcm.DataServices_D9E08_VeVSPR_v_VehSpd
    connect CPT_ComDia_Dcm_Rte_Adapter.DataServices_DE124_CamsftPosnSnsrExh1CircIntmFlt_EnaStsReg -> CPT_Dcm.DataServices_DE124_CamsftPosnSnsrExh1CircIntmFlt_EnaStsReg
    connect CPT_ComDia_Dcm_Rte_Adapter.DataServices_DE124_CrksftPosnCamsftPosnCorrExh1Flt_EnaStsReg -> CPT_Dcm.DataServices_DE124_CrksftPosnCamsftPosnCorrExh1Flt_EnaStsReg
    connect CPT_ComDia_Dcm_Rte_Adapter.DataServices_DE201_CAM_SYNC_STATUS_INT_1 -> CPT_Dcm.DataServices_DE201_CAM_SYNC_STATUS_INT_1
    connect CPT_ComDia_Dcm_Rte_Adapter.DataServices_DE102_VeCAMD_Cnt_P0340_RunMatrMax -> CPT_Dcm.DataServices_DE102_VeCAMD_Cnt_P0340_RunMatrMax
    delegate CPT_IoSigIfAdapt_SwSStellantisCmpstn.VeLLTR_t_ShutDwnTmr <-> outer port VeLLTR_t_ShutDwnTmr
    delegate CPT_IoSigIfAdapt_SwSStellantisCmpstn.VeEVIR_t_EvapSysPresSwExclPrd <-> outer port VeEVIR_t_EvapSysPresSwExclPrd
    connect CPT_ComVeh.VeCANR_d_IgnitionOnCounter_FD3 -> CPT_IoSigIfAdapt_SwSStellantisCmpstn.VeCANR_d_IgnitionOnCounter_FD3
    connect CPT_esc_tasklink.PP_ESC_Tasklink_SyncPre_TRIGSRC -> CPT_Cdd_Composition.RP_ESC_Tasklink_SyncPre_Epm_TRIGSRC
    connect CPT_esc_tasklink.PP_ESC_Tasklink_SyncS0_TRIGSRC -> CPT_Cdd_Composition.RP_ESC_Tasklink_SyncS0_Epm_TRIGSRC
    connect CPT_esc_tasklink.PP_ESC_Tasklink_SyncS0_TRIGSRC -> CPT_Cdd_Composition.RP_ESC_Tasklink_SyncS0_IgnCl_TRIGSRC
    connect CPT_esc_tasklink.PP_ESC_Tasklink_SyncS0_TRIGSRC -> CPT_Cdd_Composition.RP_ESC_Tasklink_SyncS0_InjSyG_TRIGSRC
    connect CPT_esc_tasklink.PP_ESC_Tasklink_SyncS0_TRIGSRC -> CPT_Cdd_Composition.RP_ESC_Tasklink_SyncS0_InjVvG_TRIGSRC
    connect CPT_esc_tasklink.PP_ESC_Tasklink_SyncS0_TRIGSRC -> CPT_Cdd_Composition.RP_ESC_Tasklink_SyncS0_InjVvGPfi_TRIGSRC
    connect CPT_esc_tasklink.PP_ESC_Tasklink_SyncS1_TRIGSRC -> CPT_Cdd_Composition.RP_ESC_Tasklink_SyncS1_Epm_TRIGSRC
    connect CPT_esc_tasklink.PP_ESC_Tasklink_SyncS1_TRIGSRC -> CPT_Cdd_Composition.RP_ESC_Tasklink_SyncS1_InjSyG_TRIGSRC
    connect CPT_esc_tasklink.PP_ESC_Tasklink_SyncS1_TRIGSRC -> CPT_Cdd_Composition.RP_ESC_Tasklink_SyncS1_InjVvG_TRIGSRC
    connect CPT_ESC_OsTskActvnHndlr.PP_ESC_OsTskActvnHndlr_AgEveE0_TRIGSRC -> CPT_Cdd_Composition.RP_ESC_OsTskActvnHndlr_AgEveE0_Epm_TRIGSRC, variation-point={short-label=VP_AssemblySwConnector, sw-syscond=( /RB/PT/Common/SwSystemconsts/Adjustables/ESC_NRAGEVEWCYC_SC !=0&& /RB/PT/Common/SwSystemconsts/Adjustables/ESC_NRTSKAGEVE_SC !=0 )}
    connect CPT_ESC_OsTskActvnHndlr.PP_ESC_OsTskActvnHndlr_AgEveE1_TRIGSRC -> CPT_Cdd_Composition.RP_ESC_OsTskActvnHndlr_AgEveE1_Epm_TRIGSRC, variation-point={short-label=VP_AssemblySwConnector, sw-syscond=( /RB/PT/Common/SwSystemconsts/Adjustables/ESC_NRAGEVEWCYC_SC !=0&& /RB/PT/Common/SwSystemconsts/Adjustables/ESC_NRTSKAGEVE_SC >=2 )}
    connect CPT_ESC_OsTskActvnHndlr.PP_ESC_OsTskActvnHndlr_AgEveE2_TRIGSRC -> CPT_Cdd_Composition.RP_ESC_OsTskActvnHndlr_AgEveE2_Epm_TRIGSRC, variation-point={short-label=VP_AssemblySwConnector, sw-syscond=( /RB/PT/Common/SwSystemconsts/Adjustables/ESC_NRAGEVEWCYC_SC !=0&& /RB/PT/Common/SwSystemconsts/Adjustables/ESC_NRTSKAGEVE_SC ==3 )}
    connect CPT_rba_OsArSchedExtn_OS.PP_rba_OsArSchedExtn_1Q1_IniEnd_TRIGSRC -> CPT_IoSigIfAdapt_SwSStellantisCmpstn.RP_rba_OsArSchedExtn_1Q1_IniEnd_IoSigIfAdapt_TRIGSRC
    connect CPT_esc_tasklink.PP_ESC_Tasklink_SyncS0_TRIGSRC -> CPT_IoSigIfAdapt_SwSStellantisCmpstn.RP_ESC_Tasklink_SyncS0_IoSigIfAdapt_TRIGSRC
    connect CPT_esc_tasklink.PP_ESC_Tasklink_SyncS1_TRIGSRC -> CPT_IoSigIfAdapt_SwSStellantisCmpstn.RP_ESC_Tasklink_SyncS1_IoSigIfAdapt_TRIGSRC
    delegate CPT_ComVeh.VeLINR_b_PLA_FltHt <-> outer port VeLINR_b_PLA_FltHt
    delegate CPT_ComVeh.VeLINR_e_AGS2_CurrentPosn <-> outer port VeLINR_e_AGS2_CurrentPosn
    delegate CPT_ComVeh.VeLINR_e_LTR_PmpAirPresErr <-> outer port VeLINR_e_LTR_PmpAirPresErr
    delegate CPT_ComVeh.VeLINR_Pct_PCPM_RPM_Tar <-> outer port VeLINR_Pct_PCPM_RPM_Tar
    delegate CPT_ComVeh.VeLINR_e_PCPM_PostRunSts <-> outer port VeLINR_e_PCPM_PostRunSts
    delegate CPT_ComVeh.VeLINR_e_PCPM_DryRunErr <-> outer port VeLINR_e_PCPM_DryRunErr
    delegate CPT_ComVeh.VeLINR_e_LTR_PmpVoltErr <-> outer port VeLINR_e_LTR_PmpVoltErr
    delegate CPT_ComVeh.VeLINR_b_AGS2_ErrUndrVolt <-> outer port VeLINR_b_AGS2_ErrUndrVolt
    delegate CPT_ComVeh.VeLINR_b_AGS_ErrUndrVolt <-> outer port VeLINR_b_AGS_ErrUndrVolt
    delegate CPT_ComVeh.VeLINR_e_PCPM_OvrTempErr <-> outer port VeLINR_e_PCPM_OvrTempErr
    delegate CPT_ComVeh.VeLINR_b_AGS2_ErrOvrTemp <-> outer port VeLINR_b_AGS2_ErrOvrTemp
    delegate CPT_ComVeh.VeLINR_Pct_LCVM_PosnActr <-> outer port VeLINR_Pct_LCVM_PosnActr
    delegate CPT_ComVeh.VeLINR_e_HAPM_PostRunSts <-> outer port VeLINR_e_HAPM_PostRunSts
    delegate CPT_ComVeh.VeLINR_Pct_PCPM_RPM_Act <-> outer port VeLINR_Pct_PCPM_RPM_Act
    delegate CPT_ComVeh.VeLINR_e_PCPM_OvrCurrErr <-> outer port VeLINR_e_PCPM_OvrCurrErr
    delegate CPT_ComVeh.VeLINR_Pct_HAPM_RPM_Tar <-> outer port VeLINR_Pct_HAPM_RPM_Tar
    delegate CPT_rbm_MilHndlr.RP_MilHndlr_InPlaModeActvSts <-> outer port RP_MilHndlr_InPlaModeActvSts
    delegate CPT_ComVeh.VeLINR_e_HAPM_OvrTempErr <-> outer port VeLINR_e_HAPM_OvrTempErr
    delegate CPT_ComVeh.VeLINR_Pct_HAPM_RPM_Act <-> outer port VeLINR_Pct_HAPM_RPM_Act
    delegate CPT_ComVeh.VeLINR_b_AGS2_RespErr <-> outer port VeLINR_b_AGS2_RespErr
    delegate CPT_ComVeh.VeLINR_y_LCVM_CalSts <-> outer port VeLINR_y_LCVM_CalSts
    delegate CPT_ComVeh.VeLINR_e_LCVM_Err <-> outer port VeLINR_e_LCVM_Err
    delegate CPT_ComVeh.VeLINR_b_AGS2_ErrMeclBreakDtctd <-> outer port VeLINR_b_AGS2_ErrMeclBreakDtctd
    delegate CPT_ComVeh.VeLINR_y_AGS_ErrLIN <-> outer port VeLINR_y_AGS_ErrLIN
    delegate CPT_rbm_MilHndlr.RP_MilHndlr_ExternalMilReq <-> outer port RP_MilHndlr_ExternalMilReq
    delegate CPT_ComVeh.VeLINR_e_PCPM_UnblkgActv <-> outer port VeLINR_e_PCPM_UnblkgActv
    delegate CPT_ComVeh.VeLINR_b_AGS_ErrMeclStkDtctd <-> outer port VeLINR_b_AGS_ErrMeclStkDtctd
    delegate CPT_ComVeh.VeLINR_e_LTR_PmpDryRunErr <-> outer port VeLINR_e_LTR_PmpDryRunErr
    delegate CPT_ComVeh.VeLINR_e_LTR_PmpOvrTempErr <-> outer port VeLINR_e_LTR_PmpOvrTempErr
    delegate CPT_ComVeh.VeLINR_b_AGS_CalActv <-> outer port VeLINR_b_AGS_CalActv
    delegate CPT_ComVeh.VeLINR_b_AGS_ErrMeclBreakDtctd <-> outer port VeLINR_b_AGS_ErrMeclBreakDtctd
    delegate CPT_ComVeh.VeLINR_b_AGS_CalSts <-> outer port VeLINR_b_AGS_CalSts
    delegate CPT_ComVeh.VeLINR_b_PLA_FltElec <-> outer port VeLINR_b_PLA_FltElec
    delegate CPT_ComVeh.VeLINR_b_AGS2_ErrOvrVolt <-> outer port VeLINR_b_AGS2_ErrOvrVolt
    delegate CPT_ComVeh.VeLINR_b_LCVM_RespErr <-> outer port VeLINR_b_LCVM_RespErr
    delegate CPT_ComVeh.VeLINR_e_HAPM_VoltErr <-> outer port VeLINR_e_HAPM_VoltErr
    delegate CPT_ComVeh.VeLINR_e_LTR_PmpNodErr <-> outer port VeLINR_e_LTR_PmpNodErr
    delegate CPT_ComVeh.VeLINR_y_AGS2_ErrLIN <-> outer port VeLINR_y_AGS2_ErrLIN
    delegate CPT_ComVeh.VeLINR_e_PLA_ReqDataResp <-> outer port VeLINR_e_PLA_ReqDataResp
    delegate CPT_ComVeh.VeLINR_b_PLA_RespErr <-> outer port VeLINR_b_PLA_RespErr
    delegate CPT_rbm_MilHndlr.RP_MilHndlr_InPlaModeMILReqSts <-> outer port RP_MilHndlr_InPlaModeMILReqSts
    delegate CPT_ComVeh.VeLINR_e_PCPM_NodErr <-> outer port VeLINR_e_PCPM_NodErr
    delegate CPT_ComVeh.VeLINR_b_AGS2_CalActv <-> outer port VeLINR_b_AGS2_CalActv
    delegate CPT_ComVeh.VeLINR_y_PLA_ReqdRespData <-> outer port VeLINR_y_PLA_ReqdRespData
    delegate CPT_ComVeh.VeLINR_e_HAPM_UnblkgActv <-> outer port VeLINR_e_HAPM_UnblkgActv
    delegate CPT_ComVeh.VeLINR_b_LTR_RespErrLTR_Pmp <-> outer port VeLINR_b_LTR_RespErrLTR_Pmp
    delegate CPT_ComVeh.VeLINR_b_AGS2_CalSts <-> outer port VeLINR_b_AGS2_CalSts
    delegate CPT_ComVeh.VeLINR_b_PLA_FltMec <-> outer port VeLINR_b_PLA_FltMec
    delegate CPT_ComVeh.VeLINR_Pct_PLA_ExctDC <-> outer port VeLINR_Pct_PLA_ExctDC
    delegate CPT_ComVeh.VeLINR_e_PCPM_VoltErr <-> outer port VeLINR_e_PCPM_VoltErr
    delegate CPT_ComVeh.VeLINR_b_PLA_FltTO <-> outer port VeLINR_b_PLA_FltTO
    delegate CPT_rbm_MilHndlr.RP_MilHndlr_CatDmgingMilReq <-> outer port RP_MilHndlr_CatDmgingMilReq
    delegate CPT_ComVeh.VeLINR_e_HAPM_NodErr <-> outer port VeLINR_e_HAPM_NodErr
    delegate CPT_ComVeh.VeLINR_b_AGS_ErrOvrVolt <-> outer port VeLINR_b_AGS_ErrOvrVolt
    delegate CPT_ComVeh.VeLINR_b_AGS2_ErrMeclStkDtctd <-> outer port VeLINR_b_AGS2_ErrMeclStkDtctd
    delegate CPT_ComVeh.VeLINR_e_HAPM_OvrCurrErr <-> outer port VeLINR_e_HAPM_OvrCurrErr
    delegate CPT_ComVeh.VeLINR_e_HAPM_DryRunErr <-> outer port VeLINR_e_HAPM_DryRunErr
    delegate CPT_ComVeh.VeLINR_Pct_LTR_PmpRPM_Tar <-> outer port VeLINR_Pct_LTR_PmpRPM_Tar
    delegate CPT_ComVeh.SendCANR_HoursOilLifeRst_FD3Vld <-> outer port SendCANR_HoursOilLifeRst_FD3Vld
    delegate CPT_ComVeh.VeLINR_b_PCPM_RespErr <-> outer port VeLINR_b_PCPM_RespErr
    delegate CPT_ComVeh.VeLINR_b_HAPM_RespErr <-> outer port VeLINR_b_HAPM_RespErr
    delegate CPT_ComVeh.VeLINR_b_AGS_RespErr <-> outer port VeLINR_b_AGS_RespErr
    delegate CPT_ComVeh.VeLINR_U_LTR_PmpVolt <-> outer port VeLINR_U_LTR_PmpVolt
    delegate CPT_ComVeh.VeLINR_b_AGS_ErrOvrTemp <-> outer port VeLINR_b_AGS_ErrOvrTemp
    delegate CPT_ComVeh.VeLINR_e_LTR_PmpPostRunSts <-> outer port VeLINR_e_LTR_PmpPostRunSts
    delegate CPT_ComVeh.VeLINR_Pct_LTR_PmpRPM_Act <-> outer port VeLINR_Pct_LTR_PmpRPM_Act
    delegate CPT_ComVeh.VeLINR_e_AGS_CurrentPosn <-> outer port VeLINR_e_AGS_CurrentPosn
    delegate CPT_ComVeh.VeLINR_e_LTR_PmpOvrCurrErr <-> outer port VeLINR_e_LTR_PmpOvrCurrErr
    delegate CPT_ComCIL_Adapt.SendCANR_ImobCodReqVld <-> outer port SendCANR_ImobCodReqVld
    delegate CPT_ComCIL_Adapt.SignalLINR_RATVM_RdyForSleep <-> outer port SignalLINR_RATVM_RdyForSleep
    delegate CPT_ComCIL_Adapt.SignalLINR_LCVM_RdyForSleep <-> outer port SignalLINR_LCVM_RdyForSleep
    delegate CPT_ComCIL_Adapt.SignalLINR_AGS2_RdyForSleep <-> outer port SignalLINR_AGS2_RdyForSleep
    delegate CPT_ComCIL_Adapt.SignalLINR_AAD_RdyForSleep <-> outer port SignalLINR_AAD_RdyForSleep
    delegate CPT_ComCIL_Adapt.SignalLINR_GEN1_RdyForSleep <-> outer port SignalLINR_GEN1_RdyForSleep
    delegate CPT_ComCIL_Adapt.SignalLINR_LTR_RdyForSleep <-> outer port SignalLINR_LTR_RdyForSleep
    delegate CPT_ComCIL_Adapt.SignalLINR_EEV1_RdyForSleep <-> outer port SignalLINR_EEV1_RdyForSleep
    delegate CPT_ComCIL_Adapt.SignalLINR_EEV2_RdyForSleep <-> outer port SignalLINR_EEV2_RdyForSleep
    delegate CPT_ComCIL_Adapt.SendCANR_ImobCodReq <-> outer port SendCANR_ImobCodReq
    delegate CPT_ComCIL_Adapt.SignalLINR_PCPM_RdyForSleep <-> outer port SignalLINR_PCPM_RdyForSleep
    delegate CPT_ComCIL_Adapt.SignalLINR_AGS_RdyForSleep <-> outer port SignalLINR_AGS_RdyForSleep
    delegate CPT_ComCIL_Adapt.SignalLINR_LCVM2_RdyForSleep <-> outer port SignalLINR_LCVM2_RdyForSleep
    delegate CPT_ComCIL_Adapt.SignalLINR_PLA_RdyForSleep <-> outer port SignalLINR_PLA_RdyForSleep
    delegate CPT_ComCIL_Adapt.SignalLINR_HAPM_RdyForSleep <-> outer port SignalLINR_HAPM_RdyForSleep
    delegate CPT_IoSigDioOutp_SwSStellantisCmpstn.VeRbBSW_b_SrgSoln1PwrDwnRqrdMaiRly <-> outer port VeRbBSW_b_SrgSoln1PwrDwnRqrdMaiRly
    delegate CPT_IoSigDioOutp_SwSStellantisCmpstn.VeRbBSW_b_SecdAirShutOffSoln1PwrDwnRqrdMaiRly <-> outer port VeRbBSW_b_SecdAirShutOffSoln1PwrDwnRqrdMaiRly
    delegate CPT_IoSigDioOutp_SwSStellantisCmpstn.VeRbBSW_b_OBD_PurgVentVlvPwrDwnRqrdMaiRly <-> outer port VeRbBSW_b_OBD_PurgVentVlvPwrDwnRqrdMaiRly
    delegate CPT_IoSigDioOutp_SwSStellantisCmpstn.VeRbBSW_b_ElectcVacPmpRlyPwrDwnRqrdMaiRly <-> outer port VeRbBSW_b_ElectcVacPmpRlyPwrDwnRqrdMaiRly
    delegate CPT_IoSigDioOutp_SwSStellantisCmpstn.VeRbBSW_b_StrtrRlyPwrDwnRqrdMaiRly <-> outer port VeRbBSW_b_StrtrRlyPwrDwnRqrdMaiRly
    delegate CPT_IoSigDioOutp_SwSStellantisCmpstn.VeRbBSW_b_SrgSoln2PwrDwnRqrdMaiRly <-> outer port VeRbBSW_b_SrgSoln2PwrDwnRqrdMaiRly
    delegate CPT_IoSigDioOutp_SwSStellantisCmpstn.VeRbBSW_b_VapBlockingVlvPwrDwnRqrdMaiRly <-> outer port VeRbBSW_b_VapBlockingVlvPwrDwnRqrdMaiRly
    delegate CPT_IoSigDioOutp_SwSStellantisCmpstn.VeRbBSW_b_DualFuTankEnblRlyPwrDwnRqrdMaiRly <-> outer port VeRbBSW_b_DualFuTankEnblRlyPwrDwnRqrdMaiRly
    delegate CPT_IoSigDioOutp_SwSStellantisCmpstn.VeRbBSW_b_SecdAirPmpRlyPwrDwnRqrdMaiRly <-> outer port VeRbBSW_b_SecdAirPmpRlyPwrDwnRqrdMaiRly
    delegate CPT_IoSigDioOutp_SwSStellantisCmpstn.VeRbBSW_b_LoPresFuPmpRlyPwrDwnRqrdMaiRly <-> outer port VeRbBSW_b_LoPresFuPmpRlyPwrDwnRqrdMaiRly
    delegate CPT_IoSigDioOutp_SwSStellantisCmpstn.VeRbBSW_b_OilShutOffVlvPwrDwnRqrdMaiRly <-> outer port VeRbBSW_b_OilShutOffVlvPwrDwnRqrdMaiRly
    delegate CPT_IoSigDioOutp_SwSStellantisCmpstn.VeRbBSW_b_FuDoorPwrDwnRqrdMaiRly <-> outer port VeRbBSW_b_FuDoorPwrDwnRqrdMaiRly
    delegate CPT_IoSigPwmOutp_SwSStellantisCmpstn.SetDIOR_e_VvtIntk1OutpOps <-> outer port SetDIOR_e_VvtIntk1OutpOps
    delegate CPT_IoSigDioOutp_SwSStellantisCmpstn.VeRbBSW_b_DMTLLkPmpPwrDwnRqrdMaiRly <-> outer port VeRbBSW_b_DMTLLkPmpPwrDwnRqrdMaiRly
    delegate CPT_IoSigDioOutp_SwSStellantisCmpstn.VeRbBSW_b_AC_CluRlyPwrDwnRqrdMaiRly <-> outer port VeRbBSW_b_AC_CluRlyPwrDwnRqrdMaiRly
    delegate CPT_IoSigDioOutp_SwSStellantisCmpstn.VeRbBSW_b_SwilEngMnt1PwrDwnRqrdMaiRly <-> outer port VeRbBSW_b_SwilEngMnt1PwrDwnRqrdMaiRly
    delegate CPT_IoSigDioOutp_SwSStellantisCmpstn.VeDIOR_e_MaiRlyIndDiagInfo <-> outer port VeDIOR_e_MaiRlyIndDiagInfo
    delegate CPT_IoSigDioOutp_SwSStellantisCmpstn.VeRbBSW_b_FuTankIsolnVlvPwrDwnRqrdMaiRly <-> outer port VeRbBSW_b_FuTankIsolnVlvPwrDwnRqrdMaiRly
    delegate CPT_IoSigDioOutp_SwSStellantisCmpstn.VeRbBSW_b_ELCM_ChgOvrVlvPwrDwnRqrdMaiRly <-> outer port VeRbBSW_b_ELCM_ChgOvrVlvPwrDwnRqrdMaiRly
    delegate CPT_IoSigDioOutp_SwSStellantisCmpstn.VeRbBSW_b_TOH_ShutOffVlvPwrDwnRqrdMaiRly <-> outer port VeRbBSW_b_TOH_ShutOffVlvPwrDwnRqrdMaiRly
    delegate CPT_IoSigDioOutp_SwSStellantisCmpstn.VeRbBSW_b_RadrFanRlyHiSpdPwrDwnRqrdMaiRly <-> outer port VeRbBSW_b_RadrFanRlyHiSpdPwrDwnRqrdMaiRly
    delegate CPT_IoSigPwmOutp_SwSStellantisCmpstn.VeDIOR_VvtIntk1_HwDiagFltOutp <-> outer port VeDIOR_VvtIntk1_HwDiagFltOutp
    delegate CPT_IoSigPwmOutp_SwSStellantisCmpstn.VeDIOR_e_VvtIntk1IndDiagInfo <-> outer port VeDIOR_e_VvtIntk1IndDiagInfo
    delegate CPT_IoSigDioOutp_SwSStellantisCmpstn.VeRbBSW_b_InrushCircRlyPwrDwnRqrdMaiRly <-> outer port VeRbBSW_b_InrushCircRlyPwrDwnRqrdMaiRly
    delegate CPT_IoSigPwmOutp_SwSStellantisCmpstn.VeDIOR_VvtIntk1_HwDiagCmn <-> outer port VeDIOR_VvtIntk1_HwDiagCmn
    delegate CPT_IoSigDioOutp_SwSStellantisCmpstn.VeRbBSW_b_MakeUpAirVlvPwrDwnRqrdMaiRly <-> outer port VeRbBSW_b_MakeUpAirVlvPwrDwnRqrdMaiRly
    delegate CPT_IoSigDioOutp_SwSStellantisCmpstn.VeRbBSW_b_SwilEngMnt2PwrDwnRqrdMaiRly <-> outer port VeRbBSW_b_SwilEngMnt2PwrDwnRqrdMaiRly
    delegate CPT_IoSigDioOutp_SwSStellantisCmpstn.VeRbBSW_b_MaiRlyPwrDwnRqrdMaiRly <-> outer port VeRbBSW_b_MaiRlyPwrDwnRqrdMaiRly
    delegate CPT_IoSigPwmOutp_SwSStellantisCmpstn.VeDIOR_VvtIntk1_HwDiagFltCircDtctd <-> outer port VeDIOR_VvtIntk1_HwDiagFltCircDtctd
    delegate CPT_IoSigPwmOutp_SwSStellantisCmpstn.KeCFGR_b_VvtIntk1_ChEquid <-> outer port KeCFGR_b_VvtIntk1_ChEquid
package /RB/PT/PCT_TopLvlComposition/SwComponentTypes/PortInterfaceMappingSets
  port interface mapping set PIMSet_TopLvlComposition
    port-interface-mappings:
      7 x variable and parameter interface mapping:
        PIM_IF_tiAgEveE0TskStrt_IF_ESC_tiAgEveE0TskStrt: data-prototype-mapping{first-data-prototype=tiAgEveE0TskStrt, second-data-prototype=ESC_tiAgEveE0TskStrt}
        PIM_IF_tiAgEveE1TskStrt_IF_ESC_tiAgEveE1TskStrt: data-prototype-mapping{first-data-prototype=tiAgEveE1TskStrt, second-data-prototype=ESC_tiAgEveE1TskStrt}
        PIM_IF_agEveE1TskStrt_IF_ESC_agEveE1TskStrt: data-prototype-mapping{first-data-prototype=agEveE1TskStrt, second-data-prototype=ESC_agEveE1TskStrt}
        PIM_IF_agEveE0TskStrt_IF_ESC_agEveE0TskStrt: data-prototype-mapping{first-data-prototype=agEveE0TskStrt, second-data-prototype=ESC_agEveE0TskStrt}
        PIM_IF_idCurrRunngAgEveTsk_IF_ESC_idCurrRunngAgEveTsk: data-prototype-mapping{first-data-prototype=idCurrRunngAgEveTsk, second-data-prototype=ESC_idCurrRunngAgEveTsk}
        PIM_IF_agEveE2TskStrt_IF_ESC_agEveE2TskStrt: data-prototype-mapping{first-data-prototype=agEveE2TskStrt, second-data-prototype=ESC_agEveE2TskStrt}
        PIM_IF_tiAgEveE2TskStrt_IF_ESC_tiAgEveE2TskStrt: data-prototype-mapping{first-data-prototype=tiAgEveE2TskStrt, second-data-prototype=ESC_tiAgEveE2TskStrt}
