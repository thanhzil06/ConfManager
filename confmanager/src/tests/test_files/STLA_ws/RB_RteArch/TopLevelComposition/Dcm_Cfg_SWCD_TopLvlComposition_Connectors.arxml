AUTOSAR XML (schema 4-0-3)
# (C) All rights reserved by ROBERT BOSCH GMBH, STUTTGART
package /RB/PT/PCT_TopLvlComposition/SwComponentTypes
  composition sw component type TopLvlComposition
    connect CPT_ComDia_Dcm_Rte_Adapter.PP_DcmTest_Timer -> CPT_Dcm.R_DataServices_DcmDspData_1005_0, mapping=SR_PortMapping_DcmDspData_1005_0
package /RB/PT/PCT_TopLvlComposition/PortInterfaceMappingSets
  port interface mapping set Dcm_PortMapping
    port-interface-mappings:
      variable and parameter interface mapping SR_PortMapping_DcmDspData_1005_0: data-prototype-mapping{first-data-prototype=Data, second-data-prototype=DcmTest_Timer}
