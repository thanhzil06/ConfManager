AUTOSAR XML (schema 4-1-2)
package /RB/UBK/Project/PredefinedVariants
  predefined variant HO: post-build-variant-criterion-value-set=PostBuildVariantCriterionValueSet_0
  predefined variant SO: post-build-variant-criterion-value-set=PostBuildVariantCriterionValueSet_1
  post build variant criterion value set PostBuildVariantCriterionValueSet_0: post-build-variant-criterion-value{variant-criterion=PBSHOSO, value=1}
  post build variant criterion value set PostBuildVariantCriterionValueSet_1: post-build-variant-criterion-value{variant-criterion=PBSHOSO, value=2}
package /RB/UBK/Project/PostBuildVariantCriterions
  post build variant criterion PBSHOSO: compu {1=HO, 2=SO} "Compu Method for PBSHOSO Variant Criterion"
