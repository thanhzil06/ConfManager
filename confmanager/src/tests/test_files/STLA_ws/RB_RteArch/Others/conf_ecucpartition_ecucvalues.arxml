AUTOSAR XML (schema 4-0-2)
package /RB/UBK/Project/EcucModuleConfigurationValuess
  module config EcuC
    EcucPartitionCollection
      10 x EcucPartition, all with PartitionCanBeRestarted=false:
        EcucPartition_OsApp_{0..3}_A_1: EcucPartitionBswModuleExecution=false
        EcucPartition_OsApp_0_B_1: EcucPartitionBswModuleExecution=false
        EcucPartition_OsApp_1_B_1: EcucPartitionBswModuleExecution=false, EcucPartitionSoftwareComponentInstanceRef=CPT_MDG1_FlatView.CPT_rbf_SftyHw_ErrMngtModl, EcucPartitionSoftwareComponentInstanceRef=CPT_MDG1_FlatView.CPT_rbf_SftyHw_ShtOffPahPwrStg, EcucPartitionSoftwareComponentInstanceRef=CPT_MDG1_FlatView.CPT_rbf_SftyHw_ProgFlowChk
        EcucPartition_OsApp_1_Q_1: EcucPartitionBswModuleExecution=false, EcucPartitionSoftwareComponentInstanceRef=CPT_NvM, EcucPartitionSoftwareComponentInstanceRef=CPT_rba_IoSigIcu, EcucPartitionSoftwareComponentInstanceRef=CPT_EcuM, EcucPartitionSoftwareComponentInstanceRef=CPT_Dem, EcucPartitionSoftwareComponentInstanceRef=CPT_rba_IoDiagHbr, EcucPartitionSoftwareComponentInstanceRef=CPT_ComDia_Dcm_Rte_Adapter, EcucPartitionSoftwareComponentInstanceRef=CPT_WdgM, EcucPartitionSoftwareComponentInstanceRef=CPT_rba_IoSigAdc, EcucPartitionSoftwareComponentInstanceRef=CPT_rba_IoSigRtc, EcucPartitionSoftwareComponentInstanceRef=CPT_rba_IoDiagPwr, EcucPartitionSoftwareComponentInstanceRef=, EcucPartitionSoftwareComponentInstanceRef=CPT_rba_SyC_States, EcucPartitionSoftwareComponentInstanceRef=CPT_FiM, EcucPartitionSoftwareComponentInstanceRef=CPT_rba_IoSigDio, EcucPartitionSoftwareComponentInstanceRef=CPT_rba_IoSigPwr, EcucPartitionSoftwareComponentInstanceRef=CPT_Dcm, EcucPartitionSoftwareComponentInstanceRef=CPT_BswM, EcucPartitionSoftwareComponentInstanceRef=CPT_rba_IoSigObs, EcucPartitionSoftwareComponentInstanceRef=CPT_rba_IoDiagPs, EcucPartitionSoftwareComponentInstanceRef=CPT_rba_IoSigPwm, EcucPartitionSoftwareComponentInstanceRef=CPT_Det, EcucPartitionSoftwareComponentInstanceRef=CPT_ComM, EcucPartitionSoftwareComponentInstanceRef=CPT_Csm, EcucPartitionSoftwareComponentInstanceRef=CPT_SecOC, EcucPartitionSoftwareComponentInstanceRef=CPT_rba_IoSigHlfBr, EcucPartitionSoftwareComponentInstanceRef=CPT_rba_IoDiagHlfBr, EcucPartitionSoftwareComponentInstanceRef=CPT_rba_DiagLib, EcucPartitionSoftwareComponentInstanceRef=CPT_KeyM, EcucPartitionSoftwareComponentInstanceRef=CPT_ComCIL_Adapt, EcucPartitionSoftwareComponentInstanceRef=CPT_ComScl_EngLin, EcucPartitionSoftwareComponentInstanceRef=CPT_ComScl_NetMtrx2, EcucPartitionSoftwareComponentInstanceRef=CPT_ComScl_NetMtrx3, EcucPartitionSoftwareComponentInstanceRef=CPT_ComScl_NetMtrx, EcucPartitionSoftwareComponentInstanceRef=CPT_IoSigAdc_SwSStellantisParm, EcucPartitionSoftwareComponentInstanceRef=IoSigAdc_SwSStellantisParm, EcucPartitionSoftwareComponentInstanceRef=CPT_IoSigPwmOutp_SwSStellantisParm, EcucPartitionSoftwareComponentInstanceRef=CPT_IoSigPwmInp_SwSStellantisParm, EcucPartitionSoftwareComponentInstanceRef=CPT_IoSigDioInp_SwSStellantisParam, EcucPartitionSoftwareComponentInstanceRef=CPT_SentStack_SwSStellantisParm, EcucPartitionSoftwareComponentInstanceRef=CPT_IoSigDioOutp_SwSStellantisParam, EcucPartitionSoftwareComponentInstanceRef=EGRCoolr_DeltAbsPresSnsr, EcucPartitionSoftwareComponentInstanceRef=DP_VlvPosnSns, EcucPartitionSoftwareComponentInstanceRef=IoSigDioInp_SwSStellantisParam, EcucPartitionSoftwareComponentInstanceRef=IoSigAdc_SwSStellantisParm, EcucPartitionSoftwareComponentInstanceRef=SentStack_SwSStellantisParm, EcucPartitionSoftwareComponentInstanceRef=IoSigHbrdg_SwSStellantisParam, EcucPartitionSoftwareComponentInstanceRef=IoSigPwmOutp_SwSStellantisParm, EcucPartitionSoftwareComponentInstanceRef=IoSigDioOutp_SwSStellantisParam, EcucPartitionSoftwareComponentInstanceRef=Epm_SwSStellantis_PSwc, EcucPartitionSoftwareComponentInstanceRef=CPT_rbm_MilHndlr, EcucPartitionSoftwareComponentInstanceRef=IoSigPwmInp_SwSStellantisParm, EcucPartitionSoftwareComponentInstanceRef=MAF_Hum_Snsr, EcucPartitionSoftwareComponentInstanceRef=IoSigAdc_SwSStellantisParm, EcucPartitionSoftwareComponentInstanceRef=IoSigPwmInp_SwSStellantisParm, EcucPartitionSoftwareComponentInstanceRef=IoSigDioInp_SwSStellantisParam, EcucPartitionSoftwareComponentInstanceRef=IoSigPwmOutp_SwSStellantisParm
        EcucPartition_OsApp_2_Q_1: EcucPartitionBswModuleExecution=0
        EcucPartition_OsApp_3_Q_1: EcucPartitionBswModuleExecution=0
        EcucPartition_OsApp_0_Q_1: EcucPartitionBswModuleExecution=1, EcucPartitionSoftwareComponentInstanceRef=CPT_ComScl_NetMtrx_Scl, EcucPartitionSoftwareComponentInstanceRef=CPT_ComScl_NetMtrx2_Scl, EcucPartitionSoftwareComponentInstanceRef=CPT_ComScl_NetMtrx3_Scl, EcucPartitionSoftwareComponentInstanceRef=CPT_ComScl_EngLin_Scl, EcucPartitionSoftwareComponentInstanceRef=CPT_SWC_VcodProxi, EcucPartitionSoftwareComponentInstanceRef=CPT_SWC_VcodProxi
