AUTOSAR XML (schema 00050)
package /RB/PT/PCT_MDG1_FlatView/SwComponentTypes
  composition sw component type MDG1_FlatView
    142 x component:
      CPT_ATS_Std: type=ATS_Std
      CPT_AVS_Std: type=AVS_Std
      CPT_BGTHDEV: type=BGTHDEV
      CPT_CDShdG_GTMLib: type=CDShdG_GTMLib
      CPT_CoEng_ObdSig: type=CoEng_ObdSig
      CPT_CoEng_StAdpr: type=CoEng_StAdpr
      CPT_CoEng_StEng: type=CoEng_StEng
      CPT_ComCo_Lyr: type=ComCo_Lyr
      CPT_ComPtc: type=ComPtc
      CPT_ComScl_Appl: type=ComScl_Appl
      CPT_DEVE: type=DEVE
      CPT_DSM_Conf: type=DSM_Conf
      CPT_DcmDspUDS_DID: type=DcmDspUDS_DID
      CPT_DcmDspUDS_SecA: type=DcmDspUDS_SecA
      CPT_DevLib_PwrStgState: type=DevLib_PwrStgState
      CPT_EGSHeatr_Acttn: type=EGSHeatr_Acttn
      CPT_EGSHeatr_Ctrl: type=EGSHeatr_Ctrl
      CPT_EGSHeatr_DiagPrfmnc: type=EGSHeatr_DiagPrfmnc
      CPT_EGSHeatr_DiagWire: type=EGSHeatr_DiagWire
      CPT_EGSHeatr_SnsrCoorn: type=EGSHeatr_SnsrCoorn
      CPT_EGSHeatr_SnsrTMdl: type=EGSHeatr_SnsrTMdl
      CPT_EGSHeatr_TiHeatrOff: type=EGSHeatr_TiHeatrOff
      CPT_ETC_Std: type=ETC_Std
      CPT_EngDa_PwrEng: type=EngDa_PwrEng
      CPT_EnvP_DD: type=EnvP_DD
      CPT_EnvP_VDDiag: type=EnvP_VDDiag
      CPT_EpmBCr_IntrCo: type=EpmBCr_IntrCo
      CPT_EpmBCr_Pos: type=EpmBCr_Pos
      CPT_EpmCaS_Adap: type=EpmCaS_Adap
      CPT_EpmCaS_Diag: type=EpmCaS_Diag
      CPT_EpmCaS_Meas: type=EpmCaS_Meas
      CPT_EpmCaS_OfsDiag: type=EpmCaS_OfsDiag
      CPT_EpmCaS_RelsSigEvln: type=EpmCaS_RelsSigEvln
      CPT_EpmCaS_Seg: type=EpmCaS_Seg
      CPT_EpmCaS_Spd: type=EpmCaS_Spd
      CPT_EpmCaS_SyncnPatTi: type=EpmCaS_SyncnPatTi
      CPT_EpmCrS_Diag: type=EpmCrS_Diag
      CPT_EpmCrS_RevCnt: type=EpmCrS_RevCnt
      CPT_EpmCrS_Seg: type=EpmCrS_Seg
      CPT_EpmCrS_Spd: type=EpmCrS_Spd
      CPT_EpmErr_Trace: type=EpmErr_Trace
      CPT_EpmHAgClk_Gen: type=EpmHAgClk_Gen
      CPT_EpmHCaS_SigEval: type=EpmHCaS_SigEval
      CPT_EpmHCrS_IntHndlr: type=EpmHCrS_IntHndlr
      CPT_EpmIf_Imprt: type=EpmIf_Imprt
      CPT_EpmRRS_AgDetect: type=EpmRRS_AgDetect
      CPT_EpmRRS_StopDetect: type=EpmRRS_StopDetect
      CPT_EpmSeq_EveHndlr: type=EpmSeq_EveHndlr
      CPT_EpmSeq_StateMn: type=EpmSeq_StateMn
      CPT_EpmSrv_Lib: type=EpmSrv_Lib
      CPT_EpmSyn_CaSPos: type=EpmSyn_CaSPos
      CPT_EpmSyn_CrSPos: type=EpmSyn_CrSPos
      CPT_EpmTDC_Corrn: type=EpmTDC_Corrn
      CPT_Epm_CustAdp: type=Epm_CustAdp
      CPT_Epm_Ini: type=Epm_Ini
      CPT_Epm_OpMode: type=Epm_OpMode
      CPT_Epm_Spd: type=Epm_Spd
      CPT_Epm_SpdFeat: type=Epm_SpdFeat
      CPT_Epm_SpdGrd: type=Epm_SpdGrd
      CPT_FEL_EvapSysIfAdp: type=FEL_EvapSysIfAdp
      CPT_GlbDaAdapt_Adapt: type=GlbDaAdapt_Adapt
      CPT_GlbDa_ECUOnTime: type=GlbDa_ECUOnTime
      CPT_GlbDa_VinMngt: type=GlbDa_VinMngt
      CPT_HEGO_Htg: type=HEGO_Htg
      CPT_HEGO_OBDElec: type=HEGO_OBDElec
      CPT_HEGO_Sens: type=HEGO_Sens
      CPT_IVGdiCtl_CvoAdpn: type=IVGdiCtl_CvoAdpn
      CPT_IVGdiCtl_CvoCsersPlausyDiag: type=IVGdiCtl_CvoCsersPlausyDiag
      CPT_IVGdiCtl_CvoDiag: type=IVGdiCtl_CvoDiag
      CPT_IVGdiCtl_CvoSigAcq: type=IVGdiCtl_CvoSigAcq
      CPT_IVGdiCtl_CvoSigEvln: type=IVGdiCtl_CvoSigEvln
      CPT_IVGdiCtl_CvoSimnErr: type=IVGdiCtl_CvoSimnErr
      CPT_IgCPrimI_AcqnAdc: type=IgCPrimI_AcqnAdc
      CPT_IgnClPs_Dia: type=IgnClPs_Dia
      CPT_IgnCoilDiagCoorn: type=IgnCoilDiagCoorn
      CPT_IgnDD_Calcn: type=IgnDD_Calcn
      CPT_IgnDD_ModCtrlr: type=IgnDD_ModCtrlr
      CPT_InjDDGdi: type=InjDDGdi
      CPT_InjDDPfi: type=InjDDPfi
      CPT_InjSyG_AdpnCdnCvo: type=InjSyG_AdpnCdnCvo
      CPT_InjSyG_CalcCnvnFac: type=InjSyG_CalcCnvnFac
      CPT_InjSyG_CoCvo: type=InjSyG_CoCvo
      CPT_InjSyG_DdIf: type=InjSyG_DdIf
      CPT_InjSyG_InjTi: type=InjSyG_InjTi
      CPT_InjSyG_InjTmngAdpr: type=InjSyG_InjTmngAdpr
      CPT_InjSyG_SpCvo: type=InjSyG_SpCvo
      CPT_InjVlvPs_ConCJ: type=InjVlvPs_ConCJ
      CPT_InjVlvPs_Dia: type=InjVlvPs_Dia
      CPT_Inm_MonNode: type=Inm_MonNode
      CPT_IoSigSwAdpr_SwSStellantis: type=IoSigSwAdpr_SwSStellantis
      CPT_KONCW: type=KONCW
      CPT_KnDetControl: type=KnDetControl
      CPT_KnDetLTest: type=KnDetLTest
      CPT_KnDetSigEval: type=KnDetSigEval
      CPT_MRly_Vld2Lcy: type=MRly_Vld2Lcy
      CPT_MfDD: type=MfDD
      CPT_MfPsDia: type=MfPsDia
      CPT_MfPs_ConCY: type=MfPs_ConCY
      CPT_MoCADC_Co: type=MoCADC_Co
      CPT_MoCMPU_Co: type=MoCMPU_Co
      CPT_MoExe_Co: type=MoExe_Co
      CPT_MoXEMM_Co: type=MoXEMM_Co
      CPT_OCWDA_Co: type=OCWDA_Co
      CPT_OilCmbdSen_DD: type=OilCmbdSen_DD
      CPT_Reset_CallBack: type=Reset_CallBack
      CPT_SWAdp: type=SWAdp
      CPT_SYNTIZW: type=SYNTIZW
      CPT_SrvB: type=SrvB
      CPT_SyC_Vld2Lcy: type=SyC_Vld2Lcy
      CPT_T15_Vld2Lcy: type=T15_Vld2Lcy
      CPT_UEGO_Dac: type=UEGO_Dac
      CPT_UEGO_DiagRels: type=UEGO_DiagRels
      CPT_UEGO_DiagSigEcuAsic: type=UEGO_DiagSigEcuAsic
      CPT_UEGO_DiagSigOperPlaus: type=UEGO_DiagSigOperPlaus
      CPT_UEGO_DiagSigSnsr: type=UEGO_DiagSigSnsr
      CPT_UEGO_DiagSigWireOl: type=UEGO_DiagSigWireOl
      CPT_UEGO_DiagSigWireSc: type=UEGO_DiagSigWireSc
      CPT_UEGO_ICntct: type=UEGO_ICntct
      CPT_UEGO_IPmpPck: type=UEGO_IPmpPck
      CPT_UEGO_IPmpRef: type=UEGO_IPmpRef
      CPT_UEGO_IPmpSeg: type=UEGO_IPmpSeg
      CPT_UEGO_ISrc: type=UEGO_ISrc
      CPT_UEGO_ModCtrl: type=UEGO_ModCtrl
      CPT_UEGO_O2: type=UEGO_O2
      CPT_UEGO_O2Ref: type=UEGO_O2Ref
      CPT_UEGO_OperRels: type=UEGO_OperRels
      CPT_UEGO_OperRelsExtInhb: type=UEGO_OperRelsExtInhb
      CPT_UEGO_RCmp: type=UEGO_RCmp
      CPT_UEGO_RNernst: type=UEGO_RNernst
      CPT_UEGO_RPmp: type=UEGO_RPmp
      CPT_UEGO_TCeramic: type=UEGO_TCeramic
      CPT_UEGO_Tstr: type=UEGO_Tstr
      CPT_UEGO_UNernst: type=UEGO_UNernst
      CPT_UEGO_UPmp: type=UEGO_UPmp
      CPT_XcpAppl: type=XcpAppl
      CPT_dcmcore_dsldsd_appl: type=dcmcore_dsldsd_appl
      CPT_rba_EepAdaptDGS: type=rba_EepAdaptDGS
      CPT_rba_MemDiag: type=rba_MemDiag
      CPT_rba_OsArSchedExtn: type=rba_OsArSchedExtn
      CPT_rba_OsArSchedExtn_mcop: type=rba_OsArSchedExtn_mcop
      CPT_rba_OsShell_Event: type=rba_OsShell_Event
      CPT_rba_Svbb: type=rba_Svbb
    connect CPT_ESC_OsTskActvnHndlr.PP_ESC_OsTskActvnHndlr_AgEveE0_TRIGSRC -> CPT_SWAdp.RP_ESC_OsTskActvnHndlr_AgEveE0_TRIGSRC
    connect CPT_ESC_OsTskActvnHndlr.PP_ESC_OsTskActvnHndlr_AgEveE0_TRIGSRC -> CPT_rba_OsArSchedExtn_mcop.RP_ESC_OsTskActvnHndlr_AgEveE0_TRIGSRC
    connect CPT_ESC_OsTskActvnHndlr.PP_ESC_OsTskActvnHndlr_AgEveE1_TRIGSRC -> CPT_SWAdp.RP_ESC_OsTskActvnHndlr_AgEveE1_TRIGSRC
    connect CPT_ESC_OsTskActvnHndlr.PP_ESC_OsTskActvnHndlr_AgEveE1_TRIGSRC -> CPT_rba_OsArSchedExtn_mcop.RP_ESC_OsTskActvnHndlr_AgEveE1_TRIGSRC
    connect CPT_ESC_OsTskActvnHndlr.PP_ESC_OsTskActvnHndlr_AgEveE2_TRIGSRC -> CPT_SWAdp.RP_ESC_OsTskActvnHndlr_AgEveE2_TRIGSRC
    connect CPT_ESC_OsTskActvnHndlr.PP_ESC_OsTskActvnHndlr_AgEveE2_TRIGSRC -> CPT_rba_OsArSchedExtn_mcop.RP_ESC_OsTskActvnHndlr_AgEveE2_TRIGSRC
    connect CPT_esc_tasklink.PP_ESC_Tasklink_EpmNoSync_TRIGSRC -> CPT_SWAdp.RP_ESC_Tasklink_EpmNoSync_TRIGSRC
    connect CPT_esc_tasklink.PP_ESC_Tasklink_EpmNoSync_TRIGSRC -> CPT_rba_OsArSchedExtn_mcop.RP_ESC_Tasklink_EpmNoSync_TRIGSRC
    connect CPT_esc_tasklink.PP_ESC_Tasklink_SyncFirst_TRIGSRC -> CPT_IgnDD_ModCtrlr.RP_ESC_Tasklink_SyncFirst_TRIGSRC
    connect CPT_esc_tasklink.PP_ESC_Tasklink_SyncFirst_TRIGSRC -> CPT_InjDDGdi.RP_ESC_Tasklink_SyncFirst_TRIGSRC
    connect CPT_esc_tasklink.PP_ESC_Tasklink_SyncFirst_TRIGSRC -> CPT_KnDetControl.RP_ESC_Tasklink_SyncFirst_TRIGSRC
    connect CPT_esc_tasklink.PP_ESC_Tasklink_SyncFirst_TRIGSRC -> CPT_KnDetSigEval.RP_ESC_Tasklink_SyncFirst_TRIGSRC
    connect CPT_esc_tasklink.PP_ESC_Tasklink_SyncFirst_TRIGSRC -> CPT_rba_OsArSchedExtn_mcop.RP_ESC_Tasklink_SyncFirst_TRIGSRC
    connect CPT_esc_tasklink.PP_ESC_Tasklink_SyncIni_TRIGSRC -> CPT_EpmCaS_Adap.RP_ESC_Tasklink_SyncIni_TRIGSRC
    connect CPT_esc_tasklink.PP_ESC_Tasklink_SyncIni_TRIGSRC -> CPT_EpmCaS_Diag.RP_ESC_Tasklink_SyncIni_TRIGSRC
    connect CPT_esc_tasklink.PP_ESC_Tasklink_SyncIni_TRIGSRC -> CPT_EpmCaS_OfsDiag.RP_ESC_Tasklink_SyncIni_TRIGSRC
    connect CPT_esc_tasklink.PP_ESC_Tasklink_SyncIni_TRIGSRC -> CPT_EpmCaS_Seg.RP_ESC_Tasklink_SyncIni_TRIGSRC
    connect CPT_esc_tasklink.PP_ESC_Tasklink_SyncIni_TRIGSRC -> CPT_EpmCrS_Diag.RP_ESC_Tasklink_SyncIni_TRIGSRC
    connect CPT_esc_tasklink.PP_ESC_Tasklink_SyncIni_TRIGSRC -> CPT_EpmCrS_RevCnt.RP_ESC_Tasklink_SyncIni_TRIGSRC
    connect CPT_esc_tasklink.PP_ESC_Tasklink_SyncIni_TRIGSRC -> CPT_EpmCrS_Seg.RP_ESC_Tasklink_SyncIni_TRIGSRC
    connect CPT_esc_tasklink.PP_ESC_Tasklink_SyncIni_TRIGSRC -> CPT_EpmHCaS_SigEval.RP_ESC_Tasklink_SyncIni_TRIGSRC
    connect CPT_esc_tasklink.PP_ESC_Tasklink_SyncIni_TRIGSRC -> CPT_EpmHCrS_IntHndlr.RP_ESC_Tasklink_SyncIni_TRIGSRC
    connect CPT_esc_tasklink.PP_ESC_Tasklink_SyncIni_TRIGSRC -> CPT_EpmSeq_StateMn.RP_ESC_Tasklink_SyncIni_TRIGSRC
    connect CPT_esc_tasklink.PP_ESC_Tasklink_SyncIni_TRIGSRC -> CPT_EpmSyn_CaSPos.RP_ESC_Tasklink_SyncIni_TRIGSRC
    connect CPT_esc_tasklink.PP_ESC_Tasklink_SyncIni_TRIGSRC -> CPT_EpmSyn_CrSPos.RP_ESC_Tasklink_SyncIni_TRIGSRC
    connect CPT_esc_tasklink.PP_ESC_Tasklink_SyncIni_TRIGSRC -> CPT_Epm_CustAdp.RP_ESC_Tasklink_SyncIni_TRIGSRC
    connect CPT_esc_tasklink.PP_ESC_Tasklink_SyncIni_TRIGSRC -> CPT_Epm_OpMode.RP_ESC_Tasklink_SyncIni_TRIGSRC
    connect CPT_esc_tasklink.PP_ESC_Tasklink_SyncIni_TRIGSRC -> CPT_Epm_SpdGrd.RP_ESC_Tasklink_SyncIni_TRIGSRC
    connect CPT_esc_tasklink.PP_ESC_Tasklink_SyncIni_TRIGSRC -> CPT_IVGdiCtl_CvoAdpn.RP_ESC_Tasklink_SyncIni_TRIGSRC
    connect CPT_esc_tasklink.PP_ESC_Tasklink_SyncIni_TRIGSRC -> CPT_IVGdiCtl_CvoDiag.RP_ESC_Tasklink_SyncIni_TRIGSRC
    connect CPT_esc_tasklink.PP_ESC_Tasklink_SyncIni_TRIGSRC -> CPT_IVGdiCtl_CvoSigAcq.RP_ESC_Tasklink_SyncIni_TRIGSRC
    connect CPT_esc_tasklink.PP_ESC_Tasklink_SyncIni_TRIGSRC -> CPT_IVGdiCtl_CvoSigEvln.RP_ESC_Tasklink_SyncIni_TRIGSRC
    connect CPT_esc_tasklink.PP_ESC_Tasklink_SyncIni_TRIGSRC -> CPT_IgCPrimI_AcqnAdc.RP_ESC_Tasklink_SyncIni_TRIGSRC
    connect CPT_esc_tasklink.PP_ESC_Tasklink_SyncIni_TRIGSRC -> CPT_IgnClPs_Dia.RP_ESC_Tasklink_SyncIni_TRIGSRC
    connect CPT_esc_tasklink.PP_ESC_Tasklink_SyncIni_TRIGSRC -> CPT_IgnDD_Calcn.RP_ESC_Tasklink_SyncIni_TRIGSRC
    connect CPT_esc_tasklink.PP_ESC_Tasklink_SyncIni_TRIGSRC -> CPT_IgnDD_ModCtrlr.RP_ESC_Tasklink_SyncIni_TRIGSRC
    connect CPT_esc_tasklink.PP_ESC_Tasklink_SyncIni_TRIGSRC -> CPT_InjDDGdi.RP_ESC_Tasklink_SyncIni_TRIGSRC
    connect CPT_esc_tasklink.PP_ESC_Tasklink_SyncIni_TRIGSRC -> CPT_InjDDPfi.RP_ESC_Tasklink_SyncIni_TRIGSRC
    connect CPT_esc_tasklink.PP_ESC_Tasklink_SyncIni_TRIGSRC -> CPT_InjSyG_DdIf.RP_ESC_Tasklink_SyncIni_TRIGSRC
    connect CPT_esc_tasklink.PP_ESC_Tasklink_SyncIni_TRIGSRC -> CPT_InjSyG_InjTi.RP_ESC_Tasklink_SyncIni_TRIGSRC
    connect CPT_esc_tasklink.PP_ESC_Tasklink_SyncIni_TRIGSRC -> CPT_KnDetControl.RP_ESC_Tasklink_SyncIni_TRIGSRC
    connect CPT_esc_tasklink.PP_ESC_Tasklink_SyncIni_TRIGSRC -> CPT_MfDD.RP_ESC_Tasklink_SyncIni_TRIGSRC
    connect CPT_esc_tasklink.PP_ESC_Tasklink_SyncIni_TRIGSRC -> CPT_SYNTIZW.RP_ESC_Tasklink_SyncIni_TRIGSRC
    connect CPT_esc_tasklink.PP_ESC_Tasklink_SyncIni_TRIGSRC -> CPT_rba_OsArSchedExtn_mcop.RP_ESC_Tasklink_SyncIni_TRIGSRC
    connect CPT_esc_tasklink.PP_ESC_Tasklink_SyncPre_TRIGSRC -> CPT_EpmBCr_Pos.RP_ESC_Tasklink_SyncPre_TRIGSRC
    connect CPT_esc_tasklink.PP_ESC_Tasklink_SyncPre_TRIGSRC -> CPT_EpmCaS_Diag.RP_ESC_Tasklink_SyncPre_TRIGSRC
    connect CPT_esc_tasklink.PP_ESC_Tasklink_SyncPre_TRIGSRC -> CPT_EpmCaS_Meas.RP_ESC_Tasklink_SyncPre_TRIGSRC
    connect CPT_esc_tasklink.PP_ESC_Tasklink_SyncPre_TRIGSRC -> CPT_EpmCaS_Spd.RP_ESC_Tasklink_SyncPre_TRIGSRC
    connect CPT_esc_tasklink.PP_ESC_Tasklink_SyncPre_TRIGSRC -> CPT_EpmCrS_RevCnt.RP_ESC_Tasklink_SyncPre_TRIGSRC
    connect CPT_esc_tasklink.PP_ESC_Tasklink_SyncPre_TRIGSRC -> CPT_EpmCrS_Seg.RP_ESC_Tasklink_SyncPre_TRIGSRC
    connect CPT_esc_tasklink.PP_ESC_Tasklink_SyncPre_TRIGSRC -> CPT_EpmCrS_Spd.RP_ESC_Tasklink_SyncPre_TRIGSRC
    connect CPT_esc_tasklink.PP_ESC_Tasklink_SyncPre_TRIGSRC -> CPT_EpmHCaS_SigEval.RP_ESC_Tasklink_SyncPre_TRIGSRC
    connect CPT_esc_tasklink.PP_ESC_Tasklink_SyncPre_TRIGSRC -> CPT_EpmHCrS_IntHndlr.RP_ESC_Tasklink_SyncPre_TRIGSRC
    connect CPT_esc_tasklink.PP_ESC_Tasklink_SyncPre_TRIGSRC -> CPT_EpmRRS_StopDetect.RP_ESC_Tasklink_SyncPre_TRIGSRC
    connect CPT_esc_tasklink.PP_ESC_Tasklink_SyncPre_TRIGSRC -> CPT_EpmSeq_EveHndlr.RP_ESC_Tasklink_SyncPre_TRIGSRC
    connect CPT_esc_tasklink.PP_ESC_Tasklink_SyncPre_TRIGSRC -> CPT_EpmSeq_StateMn.RP_ESC_Tasklink_SyncPre_TRIGSRC
    connect CPT_esc_tasklink.PP_ESC_Tasklink_SyncPre_TRIGSRC -> CPT_EpmSyn_CaSPos.RP_ESC_Tasklink_SyncPre_TRIGSRC
    connect CPT_esc_tasklink.PP_ESC_Tasklink_SyncPre_TRIGSRC -> CPT_EpmSyn_CrSPos.RP_ESC_Tasklink_SyncPre_TRIGSRC
    connect CPT_esc_tasklink.PP_ESC_Tasklink_SyncPre_TRIGSRC -> CPT_EpmTDC_Corrn.RP_ESC_Tasklink_SyncPre_TRIGSRC
    connect CPT_esc_tasklink.PP_ESC_Tasklink_SyncPre_TRIGSRC -> CPT_Epm_CustAdp.RP_ESC_Tasklink_SyncPre_TRIGSRC
    connect CPT_esc_tasklink.PP_ESC_Tasklink_SyncPre_TRIGSRC -> CPT_Epm_OpMode.RP_ESC_Tasklink_SyncPre_TRIGSRC
    connect CPT_esc_tasklink.PP_ESC_Tasklink_SyncPre_TRIGSRC -> CPT_Epm_SpdFeat.RP_ESC_Tasklink_SyncPre_TRIGSRC
    connect CPT_esc_tasklink.PP_ESC_Tasklink_SyncPre_TRIGSRC -> CPT_Epm_SpdGrd.RP_ESC_Tasklink_SyncPre_TRIGSRC
    connect CPT_esc_tasklink.PP_ESC_Tasklink_SyncPre_TRIGSRC -> CPT_Epm_Spd.RP_ESC_Tasklink_SyncPre_TRIGSRC
    connect CPT_esc_tasklink.PP_ESC_Tasklink_SyncPre_TRIGSRC -> CPT_rba_OsArSchedExtn_mcop.RP_ESC_Tasklink_SyncPre_TRIGSRC
    connect CPT_esc_tasklink.PP_ESC_Tasklink_SyncS0_TRIGSRC -> CPT_IVGdiCtl_CvoAdpn.RP_ESC_Tasklink_SyncS0_TRIGSRC
    connect CPT_esc_tasklink.PP_ESC_Tasklink_SyncS0_TRIGSRC -> CPT_IVGdiCtl_CvoCsersPlausyDiag.RP_ESC_Tasklink_SyncS0_TRIGSRC
    connect CPT_esc_tasklink.PP_ESC_Tasklink_SyncS0_TRIGSRC -> CPT_IVGdiCtl_CvoDiag.RP_ESC_Tasklink_SyncS0_TRIGSRC
    connect CPT_esc_tasklink.PP_ESC_Tasklink_SyncS0_TRIGSRC -> CPT_IVGdiCtl_CvoSigAcq.RP_ESC_Tasklink_SyncS0_TRIGSRC
    connect CPT_esc_tasklink.PP_ESC_Tasklink_SyncS0_TRIGSRC -> CPT_IVGdiCtl_CvoSigEvln.RP_ESC_Tasklink_SyncS0_TRIGSRC
    connect CPT_esc_tasklink.PP_ESC_Tasklink_SyncS0_TRIGSRC -> CPT_IVGdiCtl_CvoSimnErr.RP_ESC_Tasklink_SyncS0_TRIGSRC
    connect CPT_esc_tasklink.PP_ESC_Tasklink_SyncS0_TRIGSRC -> CPT_IgnDD_Calcn.RP_ESC_Tasklink_SyncS0_TRIGSRC
    connect CPT_esc_tasklink.PP_ESC_Tasklink_SyncS0_TRIGSRC -> CPT_IgnDD_ModCtrlr.RP_ESC_Tasklink_SyncS0_TRIGSRC
    connect CPT_esc_tasklink.PP_ESC_Tasklink_SyncS0_TRIGSRC -> CPT_InjDDGdi.RP_ESC_Tasklink_SyncS0_TRIGSRC
    connect CPT_esc_tasklink.PP_ESC_Tasklink_SyncS0_TRIGSRC -> CPT_InjDDPfi.RP_ESC_Tasklink_SyncS0_TRIGSRC
    connect CPT_esc_tasklink.PP_ESC_Tasklink_SyncS0_TRIGSRC -> CPT_InjSyG_AdpnCdnCvo.RP_ESC_Tasklink_SyncS0_TRIGSRC
    connect CPT_esc_tasklink.PP_ESC_Tasklink_SyncS0_TRIGSRC -> CPT_InjSyG_CoCvo.RP_ESC_Tasklink_SyncS0_TRIGSRC
    connect CPT_esc_tasklink.PP_ESC_Tasklink_SyncS0_TRIGSRC -> CPT_InjSyG_DdIf.RP_ESC_Tasklink_SyncS0_TRIGSRC
    connect CPT_esc_tasklink.PP_ESC_Tasklink_SyncS0_TRIGSRC -> CPT_InjSyG_InjTmngAdpr.RP_ESC_Tasklink_SyncS0_TRIGSRC
    connect CPT_esc_tasklink.PP_ESC_Tasklink_SyncS0_TRIGSRC -> CPT_InjSyG_SpCvo.RP_ESC_Tasklink_SyncS0_TRIGSRC
    connect CPT_esc_tasklink.PP_ESC_Tasklink_SyncS0_TRIGSRC -> CPT_SYNTIZW.RP_ESC_Tasklink_SyncS0_TRIGSRC
    connect CPT_esc_tasklink.PP_ESC_Tasklink_SyncS0_TRIGSRC -> CPT_rba_OsArSchedExtn_mcop.RP_ESC_Tasklink_SyncS0_TRIGSRC
    connect CPT_esc_tasklink.PP_ESC_Tasklink_SyncS1_TRIGSRC -> CPT_InjDDGdi.RP_ESC_Tasklink_SyncS1_TRIGSRC
    connect CPT_esc_tasklink.PP_ESC_Tasklink_SyncS1_TRIGSRC -> CPT_InjSyG_CoCvo.RP_ESC_Tasklink_SyncS1_TRIGSRC
    connect CPT_esc_tasklink.PP_ESC_Tasklink_SyncS1_TRIGSRC -> CPT_SYNTIZW.RP_ESC_Tasklink_SyncS1_TRIGSRC
    connect CPT_esc_tasklink.PP_ESC_Tasklink_SyncS1_TRIGSRC -> CPT_rba_OsArSchedExtn_mcop.RP_ESC_Tasklink_SyncS1_TRIGSRC
    connect CPT_rba_OsArSchedExtn_OS.PP_rba_OsArSchedExtn_0Q1_AirPrdtnFuCalcn_TRIGSRC -> CPT_rba_OsArSchedExtn.RP_rba_OsArSchedExtn_0Q1_AirPrdtnFuCalcn_TRIGSRC
    connect CPT_rba_OsArSchedExtn_OS.PP_rba_OsArSchedExtn_0Q1_BDCC_TRIGSRC -> CPT_rba_OsArSchedExtn.RP_rba_OsArSchedExtn_0Q1_BDCC_TRIGSRC
    connect CPT_rba_OsArSchedExtn_OS.PP_rba_OsArSchedExtn_0Q1_BDCE_TRIGSRC -> CPT_rba_OsArSchedExtn.RP_rba_OsArSchedExtn_0Q1_BDCE_TRIGSRC
    connect CPT_rba_OsArSchedExtn_OS.PP_rba_OsArSchedExtn_0Q1_CalWup_IniEnd_TRIGSRC -> CPT_rba_OsArSchedExtn.RP_rba_OsArSchedExtn_0Q1_CalWup_IniEnd_TRIGSRC
    connect CPT_rba_OsArSchedExtn_OS.PP_rba_OsArSchedExtn_0Q1_DRE_TRIGSRC -> CPT_rba_OsArSchedExtn_mcop.RP_rba_OsArSchedExtn_0Q1_DRE_TRIGSRC
    connect CPT_rba_OsArSchedExtn_OS.PP_rba_OsArSchedExtn_0Q1_EngEve_TRIGSRC -> CPT_rba_OsArSchedExtn.RP_rba_OsArSchedExtn_0Q1_EngEve_TRIGSRC
    connect CPT_rba_OsArSchedExtn_OS.PP_rba_OsArSchedExtn_0Q1_EngStopd_TRIGSRC -> CPT_rba_OsArSchedExtn.RP_rba_OsArSchedExtn_0Q1_EngStopd_TRIGSRC
    connect CPT_rba_OsArSchedExtn_OS.PP_rba_OsArSchedExtn_0Q1_FastPahTrqCalcn_TRIGSRC -> CPT_rba_OsArSchedExtn.RP_rba_OsArSchedExtn_0Q1_FastPahTrqCalcn_TRIGSRC
    connect CPT_rba_OsArSchedExtn_OS.PP_rba_OsArSchedExtn_0Q1_MS_TRIGSRC -> CPT_rba_OsArSchedExtn.RP_rba_OsArSchedExtn_0Q1_MS_TRIGSRC
    connect CPT_rba_OsArSchedExtn_OS.PP_rba_OsArSchedExtn_0Q1_MidPwr_TRIGSRC -> CPT_rba_OsArSchedExtn.RP_rba_OsArSchedExtn_0Q1_MidPwr_TRIGSRC
    connect CPT_rba_OsArSchedExtn_OS.PP_rba_OsArSchedExtn_0Q1_OIE_TRIGSRC -> CPT_rba_OsArSchedExtn.RP_rba_OsArSchedExtn_0Q1_OIE_TRIGSRC
    connect CPT_rba_OsArSchedExtn_OS.PP_rba_OsArSchedExtn_0Q1_Shutdown_Seq_TRIGSRC -> CPT_rba_OsArSchedExtn_OS.RP_rba_OsArSchedExtn_0Q1_Shutdown_Seq_TRIGSRC
    connect CPT_rba_OsArSchedExtn_OS.PP_rba_OsArSchedExtn_0Q1_Shutdown_Seq_TRIGSRC -> CPT_rba_OsArSchedExtn_mcop.RP_rba_OsArSchedExtn_0Q1_Shutdown_Seq_TRIGSRC
    connect CPT_rba_OsArSchedExtn_OS.PP_rba_OsArSchedExtn_0Q1_Shutdown_TRIGSRC -> CPT_rba_OsArSchedExtn_OS.RP_rba_OsArSchedExtn_0Q1_Shutdown_TRIGSRC
    connect CPT_rba_OsArSchedExtn_OS.PP_rba_OsArSchedExtn_0Q1_Shutdown_TRIGSRC -> CPT_rba_OsArSchedExtn_mcop.RP_rba_OsArSchedExtn_0Q1_Shutdown_TRIGSRC
    connect CPT_rba_OsArSchedExtn_OS.PP_rba_OsArSchedExtn_0Q1_SyncnLost_TRIGSRC -> CPT_rba_OsArSchedExtn.RP_rba_OsArSchedExtn_0Q1_SyncnLost_TRIGSRC
    connect CPT_rba_OsArSchedExtn_OS.PP_rba_OsArSchedExtn_0Q1_TDCI_TRIGSRC -> CPT_rba_OsArSchedExtn.RP_rba_OsArSchedExtn_0Q1_TDCI_TRIGSRC
    connect CPT_rba_OsArSchedExtn_OS.PP_rba_OsArSchedExtn_0Q1_TDCP_TRIGSRC -> CPT_rba_OsArSchedExtn.RP_rba_OsArSchedExtn_0Q1_TDCP_TRIGSRC
    connect CPT_rba_OsArSchedExtn_OS.PP_rba_OsArSchedExtn_1B1_IniEnd_TRIGSRC -> CPT_MoExe_Co.RP_rba_OsArSchedExtn_1B1_IniEnd_TRIGSRC
    connect CPT_rba_OsArSchedExtn_OS.PP_rba_OsArSchedExtn_1B1_IniEnd_TRIGSRC -> CPT_rba_OsArSchedExtn_mcop.RP_rba_OsArSchedExtn_1B1_IniEnd_TRIGSRC
    connect CPT_rba_OsArSchedExtn_OS.PP_rba_OsArSchedExtn_1B1_MS_TRIGSRC -> CPT_rba_OsArSchedExtn.RP_rba_OsArSchedExtn_1B1_MS_TRIGSRC
    connect CPT_rba_OsArSchedExtn_OS.PP_rba_OsArSchedExtn_1B1_Mo_TRIGSRC -> CPT_MoExe_Co.RP_rba_OsArSchedExtn_1B1_Mo_TRIGSRC
    connect CPT_rba_OsArSchedExtn_OS.PP_rba_OsArSchedExtn_1B1_Mo_TRIGSRC -> CPT_rba_OsArSchedExtn_mcop.RP_rba_OsArSchedExtn_1B1_Mo_TRIGSRC
    connect CPT_rba_OsArSchedExtn_OS.PP_rba_OsArSchedExtn_1Q1_AirPrdtnFuCalcn_TRIGSRC -> CPT_rba_OsArSchedExtn.RP_rba_OsArSchedExtn_1Q1_AirPrdtnFuCalcn_TRIGSRC
    connect CPT_rba_OsArSchedExtn_OS.PP_rba_OsArSchedExtn_1Q1_BDCC_TRIGSRC -> CPT_rba_OsArSchedExtn.RP_rba_OsArSchedExtn_1Q1_BDCC_TRIGSRC
    connect CPT_rba_OsArSchedExtn_OS.PP_rba_OsArSchedExtn_1Q1_BDCE_TRIGSRC -> CPT_rba_OsArSchedExtn.RP_rba_OsArSchedExtn_1Q1_BDCE_TRIGSRC
    connect CPT_rba_OsArSchedExtn_OS.PP_rba_OsArSchedExtn_1Q1_Com1_TRIGSRC -> CPT_rba_OsArSchedExtn.RP_rba_OsArSchedExtn_1Q1_Com1_TRIGSRC
    connect CPT_rba_OsArSchedExtn_OS.PP_rba_OsArSchedExtn_1Q1_Com3_TRIGSRC -> CPT_rba_OsArSchedExtn.RP_rba_OsArSchedExtn_1Q1_Com3_TRIGSRC
    connect CPT_rba_OsArSchedExtn_OS.PP_rba_OsArSchedExtn_1Q1_DRE_TRIGSRC -> CPT_rba_OsArSchedExtn.RP_rba_OsArSchedExtn_1Q1_DRE_TRIGSRC
    connect CPT_rba_OsArSchedExtn_OS.PP_rba_OsArSchedExtn_1Q1_EngEve_TRIGSRC -> CPT_rba_OsArSchedExtn.RP_rba_OsArSchedExtn_1Q1_EngEve_TRIGSRC
    connect CPT_rba_OsArSchedExtn_OS.PP_rba_OsArSchedExtn_1Q1_EngStopd_TRIGSRC -> CPT_rba_OsArSchedExtn.RP_rba_OsArSchedExtn_1Q1_EngStopd_TRIGSRC
    connect CPT_rba_OsArSchedExtn_OS.PP_rba_OsArSchedExtn_1Q1_FastPahTrqCalcn_TRIGSRC -> CPT_rba_OsArSchedExtn.RP_rba_OsArSchedExtn_1Q1_FastPahTrqCalcn_TRIGSRC
    connect CPT_rba_OsArSchedExtn_OS.PP_rba_OsArSchedExtn_1Q1_IniEnd_TRIGSRC -> CPT_DSM_Conf.RP_rba_OsArSchedExtn_1Q1_IniEnd_TRIGSRC
    connect CPT_rba_OsArSchedExtn_OS.PP_rba_OsArSchedExtn_1Q1_IniEnd_TRIGSRC -> CPT_EGSHeatr_Ctrl.RP_rba_OsArSchedExtn_1Q1_IniEnd_TRIGSRC
    connect CPT_rba_OsArSchedExtn_OS.PP_rba_OsArSchedExtn_1Q1_IniEnd_TRIGSRC -> CPT_EGSHeatr_DiagPrfmnc.RP_rba_OsArSchedExtn_1Q1_IniEnd_TRIGSRC
    connect CPT_rba_OsArSchedExtn_OS.PP_rba_OsArSchedExtn_1Q1_IniEnd_TRIGSRC -> CPT_EGSHeatr_SnsrCoorn.RP_rba_OsArSchedExtn_1Q1_IniEnd_TRIGSRC
    connect CPT_rba_OsArSchedExtn_OS.PP_rba_OsArSchedExtn_1Q1_IniEnd_TRIGSRC -> CPT_EnvP_DD.RP_rba_OsArSchedExtn_1Q1_IniEnd_TRIGSRC
    connect CPT_rba_OsArSchedExtn_OS.PP_rba_OsArSchedExtn_1Q1_IniEnd_TRIGSRC -> CPT_EnvP_VDDiag.RP_rba_OsArSchedExtn_1Q1_IniEnd_TRIGSRC
    connect CPT_rba_OsArSchedExtn_OS.PP_rba_OsArSchedExtn_1Q1_IniEnd_TRIGSRC -> CPT_EpmBCr_Pos.RP_rba_OsArSchedExtn_1Q1_IniEnd_TRIGSRC
    connect CPT_rba_OsArSchedExtn_OS.PP_rba_OsArSchedExtn_1Q1_IniEnd_TRIGSRC -> CPT_EpmCaS_Adap.RP_rba_OsArSchedExtn_1Q1_IniEnd_TRIGSRC
    connect CPT_rba_OsArSchedExtn_OS.PP_rba_OsArSchedExtn_1Q1_IniEnd_TRIGSRC -> CPT_EpmCaS_Diag.RP_rba_OsArSchedExtn_1Q1_IniEnd_TRIGSRC
    connect CPT_rba_OsArSchedExtn_OS.PP_rba_OsArSchedExtn_1Q1_IniEnd_TRIGSRC -> CPT_EpmCaS_Meas.RP_rba_OsArSchedExtn_1Q1_IniEnd_TRIGSRC
    connect CPT_rba_OsArSchedExtn_OS.PP_rba_OsArSchedExtn_1Q1_IniEnd_TRIGSRC -> CPT_EpmCaS_OfsDiag.RP_rba_OsArSchedExtn_1Q1_IniEnd_TRIGSRC
    connect CPT_rba_OsArSchedExtn_OS.PP_rba_OsArSchedExtn_1Q1_IniEnd_TRIGSRC -> CPT_EpmCaS_RelsSigEvln.RP_rba_OsArSchedExtn_1Q1_IniEnd_TRIGSRC
    connect CPT_rba_OsArSchedExtn_OS.PP_rba_OsArSchedExtn_1Q1_IniEnd_TRIGSRC -> CPT_EpmCaS_Seg.RP_rba_OsArSchedExtn_1Q1_IniEnd_TRIGSRC
    connect CPT_rba_OsArSchedExtn_OS.PP_rba_OsArSchedExtn_1Q1_IniEnd_TRIGSRC -> CPT_EpmCaS_Spd.RP_rba_OsArSchedExtn_1Q1_IniEnd_TRIGSRC
    connect CPT_rba_OsArSchedExtn_OS.PP_rba_OsArSchedExtn_1Q1_IniEnd_TRIGSRC -> CPT_EpmCrS_Diag.RP_rba_OsArSchedExtn_1Q1_IniEnd_TRIGSRC
    connect CPT_rba_OsArSchedExtn_OS.PP_rba_OsArSchedExtn_1Q1_IniEnd_TRIGSRC -> CPT_EpmCrS_RevCnt.RP_rba_OsArSchedExtn_1Q1_IniEnd_TRIGSRC
    connect CPT_rba_OsArSchedExtn_OS.PP_rba_OsArSchedExtn_1Q1_IniEnd_TRIGSRC -> CPT_EpmCrS_Seg.RP_rba_OsArSchedExtn_1Q1_IniEnd_TRIGSRC
    connect CPT_rba_OsArSchedExtn_OS.PP_rba_OsArSchedExtn_1Q1_IniEnd_TRIGSRC -> CPT_EpmCrS_Spd.RP_rba_OsArSchedExtn_1Q1_IniEnd_TRIGSRC
    connect CPT_rba_OsArSchedExtn_OS.PP_rba_OsArSchedExtn_1Q1_IniEnd_TRIGSRC -> CPT_EpmHCaS_SigEval.RP_rba_OsArSchedExtn_1Q1_IniEnd_TRIGSRC
    connect CPT_rba_OsArSchedExtn_OS.PP_rba_OsArSchedExtn_1Q1_IniEnd_TRIGSRC -> CPT_EpmIf_Imprt.RP_rba_OsArSchedExtn_1Q1_IniEnd_TRIGSRC
    connect CPT_rba_OsArSchedExtn_OS.PP_rba_OsArSchedExtn_1Q1_IniEnd_TRIGSRC -> CPT_EpmRRS_AgDetect.RP_rba_OsArSchedExtn_1Q1_IniEnd_TRIGSRC
    connect CPT_rba_OsArSchedExtn_OS.PP_rba_OsArSchedExtn_1Q1_IniEnd_TRIGSRC -> CPT_EpmSeq_StateMn.RP_rba_OsArSchedExtn_1Q1_IniEnd_TRIGSRC
    connect CPT_rba_OsArSchedExtn_OS.PP_rba_OsArSchedExtn_1Q1_IniEnd_TRIGSRC -> CPT_EpmSyn_CaSPos.RP_rba_OsArSchedExtn_1Q1_IniEnd_TRIGSRC
    connect CPT_rba_OsArSchedExtn_OS.PP_rba_OsArSchedExtn_1Q1_IniEnd_TRIGSRC -> CPT_Epm_CustAdp.RP_rba_OsArSchedExtn_1Q1_IniEnd_TRIGSRC
    connect CPT_rba_OsArSchedExtn_OS.PP_rba_OsArSchedExtn_1Q1_IniEnd_TRIGSRC -> CPT_Epm_OpMode.RP_rba_OsArSchedExtn_1Q1_IniEnd_TRIGSRC
    connect CPT_rba_OsArSchedExtn_OS.PP_rba_OsArSchedExtn_1Q1_IniEnd_TRIGSRC -> CPT_Epm_SpdFeat.RP_rba_OsArSchedExtn_1Q1_IniEnd_TRIGSRC
    connect CPT_rba_OsArSchedExtn_OS.PP_rba_OsArSchedExtn_1Q1_IniEnd_TRIGSRC -> CPT_Epm_Spd.RP_rba_OsArSchedExtn_1Q1_IniEnd_TRIGSRC
    connect CPT_rba_OsArSchedExtn_OS.PP_rba_OsArSchedExtn_1Q1_IniEnd_TRIGSRC -> CPT_HEGO_Sens.RP_rba_OsArSchedExtn_1Q1_IniEnd_TRIGSRC
    connect CPT_rba_OsArSchedExtn_OS.PP_rba_OsArSchedExtn_1Q1_IniEnd_TRIGSRC -> CPT_InjDDGdi.RP_rba_OsArSchedExtn_1Q1_IniEnd_TRIGSRC
    connect CPT_rba_OsArSchedExtn_OS.PP_rba_OsArSchedExtn_1Q1_IniEnd_TRIGSRC -> CPT_InjVlvPs_Dia.RP_rba_OsArSchedExtn_1Q1_IniEnd_TRIGSRC
    connect CPT_rba_OsArSchedExtn_OS.PP_rba_OsArSchedExtn_1Q1_IniEnd_TRIGSRC -> CPT_OilCmbdSen_DD.RP_rba_OsArSchedExtn_1Q1_IniEnd_TRIGSRC
    connect CPT_rba_OsArSchedExtn_OS.PP_rba_OsArSchedExtn_1Q1_IniEnd_TRIGSRC -> CPT_SyC_Vld2Lcy.RP_rba_OsArSchedExtn_1Q1_IniEnd_TRIGSRC
    connect CPT_rba_OsArSchedExtn_OS.PP_rba_OsArSchedExtn_1Q1_IniEnd_TRIGSRC -> CPT_UEGO_OperRels.RP_rba_OsArSchedExtn_1Q1_IniEnd_TRIGSRC
    connect CPT_rba_OsArSchedExtn_OS.PP_rba_OsArSchedExtn_1Q1_IniEnd_TRIGSRC -> CPT_rba_EepAdaptDGS.RP_rba_OsArSchedExtn_1Q1_IniEnd_TRIGSRC
    connect CPT_rba_OsArSchedExtn_OS.PP_rba_OsArSchedExtn_1Q1_IniEnd_TRIGSRC -> CPT_rba_OsArSchedExtn_OS.RP_rba_OsArSchedExtn_1Q1_IniEnd_TRIGSRC
    connect CPT_rba_OsArSchedExtn_OS.PP_rba_OsArSchedExtn_1Q1_IniEnd_TRIGSRC -> CPT_rba_OsArSchedExtn_mcop.RP_rba_OsArSchedExtn_1Q1_IniEnd_TRIGSRC
    connect CPT_rba_OsArSchedExtn_OS.PP_rba_OsArSchedExtn_1Q1_MS_TRIGSRC -> CPT_rba_OsArSchedExtn.RP_rba_OsArSchedExtn_1Q1_MS_TRIGSRC
    connect CPT_rba_OsArSchedExtn_OS.PP_rba_OsArSchedExtn_1Q1_MidPwr_TRIGSRC -> CPT_rba_OsArSchedExtn.RP_rba_OsArSchedExtn_1Q1_MidPwr_TRIGSRC
    connect CPT_rba_OsArSchedExtn_OS.PP_rba_OsArSchedExtn_1Q1_OIE_TRIGSRC -> CPT_rba_OsArSchedExtn.RP_rba_OsArSchedExtn_1Q1_OIE_TRIGSRC
    connect CPT_rba_OsArSchedExtn_OS.PP_rba_OsArSchedExtn_1Q1_ReIniModeM_TRIGSRC -> CPT_rba_OsArSchedExtn_OS.RP_rba_OsArSchedExtn_1Q1_ReIniModeM_TRIGSRC
    connect CPT_rba_OsArSchedExtn_OS.PP_rba_OsArSchedExtn_1Q1_ReIniModeM_TRIGSRC -> CPT_rba_OsArSchedExtn_mcop.RP_rba_OsArSchedExtn_1Q1_ReIniModeM_TRIGSRC
    connect CPT_rba_OsArSchedExtn_OS.PP_rba_OsArSchedExtn_1Q1_Shutdown_TRIGSRC -> CPT_rba_OsArSchedExtn_OS.RP_rba_OsArSchedExtn_1Q1_Shutdown_TRIGSRC
    connect CPT_rba_OsArSchedExtn_OS.PP_rba_OsArSchedExtn_1Q1_Shutdown_TRIGSRC -> CPT_rba_OsArSchedExtn_mcop.RP_rba_OsArSchedExtn_1Q1_Shutdown_TRIGSRC
    connect CPT_rba_OsArSchedExtn_OS.PP_rba_OsArSchedExtn_1Q1_SyncnLost_TRIGSRC -> CPT_rba_OsArSchedExtn.RP_rba_OsArSchedExtn_1Q1_SyncnLost_TRIGSRC
    connect CPT_rba_OsArSchedExtn_OS.PP_rba_OsArSchedExtn_1Q1_TDCI_TRIGSRC -> CPT_rba_OsArSchedExtn.RP_rba_OsArSchedExtn_1Q1_TDCI_TRIGSRC
    connect CPT_rba_OsArSchedExtn_OS.PP_rba_OsArSchedExtn_1Q1_TDCP_TRIGSRC -> CPT_rba_OsArSchedExtn.RP_rba_OsArSchedExtn_1Q1_TDCP_TRIGSRC
    connect CPT_rba_OsArSchedExtn_OS.PP_rba_OsArSchedExtn_2Q1_Com2_TRIGSRC -> CPT_rba_OsArSchedExtn.RP_rba_OsArSchedExtn_2Q1_Com2_TRIGSRC
    connect CPT_rba_OsArSchedExtn_OS.PP_rba_OsArSchedExtn_2Q1_DRE_TRIGSRC -> CPT_rba_OsArSchedExtn.RP_rba_OsArSchedExtn_2Q1_DRE_TRIGSRC
    connect CPT_rba_OsArSchedExtn_OS.PP_rba_OsArSchedExtn_2Q1_EngEve_TRIGSRC -> CPT_rba_OsArSchedExtn.RP_rba_OsArSchedExtn_2Q1_EngEve_TRIGSRC
    connect CPT_rba_OsArSchedExtn_OS.PP_rba_OsArSchedExtn_2Q1_MS_TRIGSRC -> CPT_rba_OsArSchedExtn.RP_rba_OsArSchedExtn_2Q1_MS_TRIGSRC
    connect CPT_rba_OsArSchedExtn_OS.PP_rba_OsArSchedExtn_2Q1_OIE_TRIGSRC -> CPT_rba_OsArSchedExtn.RP_rba_OsArSchedExtn_2Q1_OIE_TRIGSRC
    connect CPT_rba_OsArSchedExtn_OS.PP_rba_OsArSchedExtn_2Q1_Shutdown_TRIGSRC -> CPT_rba_OsArSchedExtn_OS.RP_rba_OsArSchedExtn_2Q1_Shutdown_TRIGSRC
    connect CPT_rba_OsArSchedExtn_OS.PP_rba_OsArSchedExtn_2Q1_Shutdown_TRIGSRC -> CPT_rba_OsArSchedExtn_mcop.RP_rba_OsArSchedExtn_2Q1_Shutdown_TRIGSRC
    connect CPT_rba_OsArSchedExtn_OS.PP_rba_OsArSchedExtn_3Q1_DRE_TRIGSRC -> CPT_rba_OsArSchedExtn.RP_rba_OsArSchedExtn_3Q1_DRE_TRIGSRC
    connect CPT_rba_OsArSchedExtn_OS.PP_rba_OsArSchedExtn_3Q1_EngEve_TRIGSRC -> CPT_rba_OsArSchedExtn.RP_rba_OsArSchedExtn_3Q1_EngEve_TRIGSRC
    connect CPT_rba_OsArSchedExtn_OS.PP_rba_OsArSchedExtn_3Q1_MS_TRIGSRC -> CPT_rba_OsArSchedExtn.RP_rba_OsArSchedExtn_3Q1_MS_TRIGSRC
    connect CPT_rba_OsArSchedExtn_OS.PP_rba_OsArSchedExtn_3Q1_OIE_TRIGSRC -> CPT_rba_OsArSchedExtn.RP_rba_OsArSchedExtn_3Q1_OIE_TRIGSRC
    connect CPT_rba_OsArSchedExtn_OS.PP_rba_OsArSchedExtn_3Q1_Shutdown_TRIGSRC -> CPT_rba_OsArSchedExtn_OS.RP_rba_OsArSchedExtn_3Q1_Shutdown_TRIGSRC
    connect CPT_rba_OsArSchedExtn_OS.PP_rba_OsArSchedExtn_3Q1_Shutdown_TRIGSRC -> CPT_rba_OsArSchedExtn_mcop.RP_rba_OsArSchedExtn_3Q1_Shutdown_TRIGSRC
    connect CPT_rba_OsArSchedExtn_OS.PP_rba_OsArSchedExtn_DSM_Clear_TRIGSRC -> CPT_DEVE.RP_rba_OsArSchedExtn_DSM_Clear_TRIGSRC
    connect CPT_rba_OsArSchedExtn_OS.PP_rba_OsArSchedExtn_DSM_Clear_TRIGSRC -> CPT_EGSHeatr_DiagPrfmnc.RP_rba_OsArSchedExtn_DSM_Clear_TRIGSRC
    connect CPT_rba_OsArSchedExtn_OS.PP_rba_OsArSchedExtn_DSM_Clear_TRIGSRC -> CPT_EGSHeatr_DiagWire.RP_rba_OsArSchedExtn_DSM_Clear_TRIGSRC
    connect CPT_rba_OsArSchedExtn_OS.PP_rba_OsArSchedExtn_DSM_Clear_TRIGSRC -> CPT_EnvP_DD.RP_rba_OsArSchedExtn_DSM_Clear_TRIGSRC
    connect CPT_rba_OsArSchedExtn_OS.PP_rba_OsArSchedExtn_DSM_Clear_TRIGSRC -> CPT_EnvP_VDDiag.RP_rba_OsArSchedExtn_DSM_Clear_TRIGSRC
    connect CPT_rba_OsArSchedExtn_OS.PP_rba_OsArSchedExtn_DSM_Clear_TRIGSRC -> CPT_EpmCaS_Adap.RP_rba_OsArSchedExtn_DSM_Clear_TRIGSRC
    connect CPT_rba_OsArSchedExtn_OS.PP_rba_OsArSchedExtn_DSM_Clear_TRIGSRC -> CPT_EpmCaS_OfsDiag.RP_rba_OsArSchedExtn_DSM_Clear_TRIGSRC
    connect CPT_rba_OsArSchedExtn_OS.PP_rba_OsArSchedExtn_DSM_Clear_TRIGSRC -> CPT_EpmCrS_Diag.RP_rba_OsArSchedExtn_DSM_Clear_TRIGSRC
    connect CPT_rba_OsArSchedExtn_OS.PP_rba_OsArSchedExtn_DSM_Clear_TRIGSRC -> CPT_EpmErr_Trace.RP_rba_OsArSchedExtn_DSM_Clear_TRIGSRC
    connect CPT_rba_OsArSchedExtn_OS.PP_rba_OsArSchedExtn_DSM_Clear_TRIGSRC -> CPT_EpmRRS_AgDetect.RP_rba_OsArSchedExtn_DSM_Clear_TRIGSRC
    connect CPT_rba_OsArSchedExtn_OS.PP_rba_OsArSchedExtn_DSM_Clear_TRIGSRC -> CPT_GlbDaAdapt_Adapt.RP_rba_OsArSchedExtn_DSM_Clear_TRIGSRC
    connect CPT_rba_OsArSchedExtn_OS.PP_rba_OsArSchedExtn_DSM_Clear_TRIGSRC -> CPT_HEGO_OBDElec.RP_rba_OsArSchedExtn_DSM_Clear_TRIGSRC
    connect CPT_rba_OsArSchedExtn_OS.PP_rba_OsArSchedExtn_DSM_Clear_TRIGSRC -> CPT_HEGO_Sens.RP_rba_OsArSchedExtn_DSM_Clear_TRIGSRC
    connect CPT_rba_OsArSchedExtn_OS.PP_rba_OsArSchedExtn_DSM_Clear_TRIGSRC -> CPT_IVGdiCtl_CvoCsersPlausyDiag.RP_rba_OsArSchedExtn_DSM_Clear_TRIGSRC
    connect CPT_rba_OsArSchedExtn_OS.PP_rba_OsArSchedExtn_DSM_Clear_TRIGSRC -> CPT_IVGdiCtl_CvoDiag.RP_rba_OsArSchedExtn_DSM_Clear_TRIGSRC
    connect CPT_rba_OsArSchedExtn_OS.PP_rba_OsArSchedExtn_DSM_Clear_TRIGSRC -> CPT_InjSyG_CoCvo.RP_rba_OsArSchedExtn_DSM_Clear_TRIGSRC
    connect CPT_rba_OsArSchedExtn_OS.PP_rba_OsArSchedExtn_DSM_Clear_TRIGSRC -> CPT_MoCADC_Co.RP_rba_OsArSchedExtn_DSM_Clear_TRIGSRC
    connect CPT_rba_OsArSchedExtn_OS.PP_rba_OsArSchedExtn_DSM_Clear_TRIGSRC -> CPT_MoExe_Co.RP_rba_OsArSchedExtn_DSM_Clear_TRIGSRC
    connect CPT_rba_OsArSchedExtn_OS.PP_rba_OsArSchedExtn_DSM_Clear_TRIGSRC -> CPT_OCWDA_Co.RP_rba_OsArSchedExtn_DSM_Clear_TRIGSRC
    connect CPT_rba_OsArSchedExtn_OS.PP_rba_OsArSchedExtn_DSM_Clear_TRIGSRC -> CPT_UEGO_DiagSigEcuAsic.RP_rba_OsArSchedExtn_DSM_Clear_TRIGSRC
    connect CPT_rba_OsArSchedExtn_OS.PP_rba_OsArSchedExtn_DSM_Clear_TRIGSRC -> CPT_UEGO_DiagSigOperPlaus.RP_rba_OsArSchedExtn_DSM_Clear_TRIGSRC
    connect CPT_rba_OsArSchedExtn_OS.PP_rba_OsArSchedExtn_DSM_Clear_TRIGSRC -> CPT_UEGO_DiagSigSnsr.RP_rba_OsArSchedExtn_DSM_Clear_TRIGSRC
    connect CPT_rba_OsArSchedExtn_OS.PP_rba_OsArSchedExtn_DSM_Clear_TRIGSRC -> CPT_rba_OsArSchedExtn_mcop.RP_rba_OsArSchedExtn_DSM_Clear_TRIGSRC
    connect CPT_rba_OsArSchedExtn_OS.PP_rba_OsArSchedExtn_DSM_Reini_TRIGSRC -> CPT_rba_OsArSchedExtn.RP_rba_OsArSchedExtn_DSM_Reini_TRIGSRC
