AUTOSAR XML (schema 4-2-2)
package /FCACompositions/RootProject
  composition sw component type RootProject
    component TopLvlComposition: type=TopLvlComposition
