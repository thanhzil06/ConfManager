AUTOSAR XML (schema 4-0-3)
package /RB/UBK/Project/EcucModuleConfigurationValuess
  ecuc value collection RteEcucValueCollections: ecu-extract=MDG1_EXTR, ecuc-values=[Os, Rte, EcuC, Com]
