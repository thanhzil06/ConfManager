AUTOSAR XML (schema 4-0-2)
package /RB/UBK/Project/EcucModuleConfigurationValuess
  module config EcuC
    EcucVariationResolver: PredefinedVariantRef=VPRE_SysConst_Adjustable, PredefinedVariantRef=VPRE_ESC
