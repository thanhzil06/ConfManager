AUTOSAR XML (schema 00050)
package /RB/PT/PCFG_ECU
  system MDG1_EXTR: category=ECU_EXTRACT, ecu-extract-version=1.0.0, system-version=1.0.0
    system mapping SYSMPG_MDG1
      data-mappings:
        sender-receiver-to-signal-mapping={data-element=CPT_MDG1_FlatView.RP_COM_Rx_AGS2_ECM_STATUS.VD_COM_Rx_AGS2_BoostStat, system-signal=SystemSignal_COM_Rx_AGS2_BoostStat}
        sender-receiver-to-signal-mapping={data-element=CPT_MDG1_FlatView.RP_COM_Rx_AGS2_ECM_STATUS.VD_COM_Rx_AGS2_CalActv, system-signal=SystemSignal_COM_Rx_AGS2_CalActv}
        sender-receiver-to-signal-mapping={data-element=CPT_MDG1_FlatView.RP_COM_Rx_AGS2_ECM_STATUS.VD_COM_Rx_AGS2_CalStat, system-signal=SystemSignal_COM_Rx_AGS2_CalStat}
        sender-receiver-to-signal-mapping={data-element=CPT_MDG1_FlatView.RP_COM_Rx_AGS2_ECM_STATUS.VD_COM_Rx_AGS2_CurrPos, system-signal=SystemSignal_COM_Rx_AGS2_CurrPos}
        sender-receiver-to-signal-mapping={data-element=CPT_MDG1_FlatView.RP_COM_Rx_AGS2_ECM_STATUS.VD_COM_Rx_AGS2_ErrLIN, system-signal=SystemSignal_COM_Rx_AGS2_ErrLIN}
        sender-receiver-to-signal-mapping={data-element=CPT_MDG1_FlatView.RP_COM_Rx_AGS2_ECM_STATUS.VD_COM_Rx_AGS2_ErrMechBreak, system-signal=SystemSignal_COM_Rx_AGS2_ErrMechBreak}
        sender-receiver-to-signal-mapping={data-element=CPT_MDG1_FlatView.RP_COM_Rx_AGS2_ECM_STATUS.VD_COM_Rx_AGS2_ErrMechStuck, system-signal=SystemSignal_COM_Rx_AGS2_ErrMechStuck}
        sender-receiver-to-signal-mapping={data-element=CPT_MDG1_FlatView.RP_COM_Rx_AGS2_ECM_STATUS.VD_COM_Rx_AGS2_ErrOvrTemp, system-signal=SystemSignal_COM_Rx_AGS2_ErrOvrTemp}
        sender-receiver-to-signal-mapping={data-element=CPT_MDG1_FlatView.RP_COM_Rx_AGS2_ECM_STATUS.VD_COM_Rx_AGS2_ErrOvrVolt, system-signal=SystemSignal_COM_Rx_AGS2_ErrOvrVolt}
        sender-receiver-to-signal-mapping={data-element=CPT_MDG1_FlatView.RP_COM_Rx_AGS2_ECM_STATUS.VD_COM_Rx_AGS2_ErrUnVolt, system-signal=SystemSignal_COM_Rx_AGS2_ErrUnVolt}
        sender-receiver-to-signal-mapping={data-element=CPT_MDG1_FlatView.RP_COM_Rx_AGS2_ECM_STATUS.VD_COM_Rx_RsErr_AGS2, system-signal=SystemSignal_COM_Rx_RsErr_AGS2}
        sender-receiver-to-signal-mapping={data-element=CPT_MDG1_FlatView.RP_COM_Rx_AGS2_ECM_STATUS.VD_COM_Rx_S2MResBit1_AGS2, system-signal=SystemSignal_COM_Rx_S2MResBit1_AGS2}
        sender-receiver-to-signal-mapping={data-element=CPT_MDG1_FlatView.RP_COM_Rx_AGS2_ECM_STATUS.VD_COM_Rx_S2MResByte1_AGS2, system-signal=SystemSignal_COM_Rx_S2MResByte1_AGS2}
        sender-receiver-to-signal-mapping={data-element=CPT_MDG1_FlatView.RP_COM_Rx_AGS2_ECM_STATUS.VD_COM_Rx_S2MResByte2_AGS2, system-signal=SystemSignal_COM_Rx_S2MResByte2_AGS2}
        sender-receiver-to-signal-mapping={data-element=CPT_MDG1_FlatView.RP_COM_Rx_AGS_ECM_STATUS.VD_COM_Rx_AGS_BoostStat, system-signal=SystemSignal_COM_Rx_AGS_BoostStat}
        sender-receiver-to-signal-mapping={data-element=CPT_MDG1_FlatView.RP_COM_Rx_AGS_ECM_STATUS.VD_COM_Rx_AGS_CalActv, system-signal=SystemSignal_COM_Rx_AGS_CalActv}
        sender-receiver-to-signal-mapping={data-element=CPT_MDG1_FlatView.RP_COM_Rx_AGS_ECM_STATUS.VD_COM_Rx_AGS_CalStat, system-signal=SystemSignal_COM_Rx_AGS_CalStat}
        sender-receiver-to-signal-mapping={data-element=CPT_MDG1_FlatView.RP_COM_Rx_AGS_ECM_STATUS.VD_COM_Rx_AGS_CurrPos, system-signal=SystemSignal_COM_Rx_AGS_CurrPos}
        sender-receiver-to-signal-mapping={data-element=CPT_MDG1_FlatView.RP_COM_Rx_AGS_ECM_STATUS.VD_COM_Rx_AGS_ErrLIN, system-signal=SystemSignal_COM_Rx_AGS_ErrLIN}
        sender-receiver-to-signal-mapping={data-element=CPT_MDG1_FlatView.RP_COM_Rx_AGS_ECM_STATUS.VD_COM_Rx_AGS_ErrMechBreak, system-signal=SystemSignal_COM_Rx_AGS_ErrMechBreak}
        sender-receiver-to-signal-mapping={data-element=CPT_MDG1_FlatView.RP_COM_Rx_AGS_ECM_STATUS.VD_COM_Rx_AGS_ErrMechStuck, system-signal=SystemSignal_COM_Rx_AGS_ErrMechStuck}
        sender-receiver-to-signal-mapping={data-element=CPT_MDG1_FlatView.RP_COM_Rx_AGS_ECM_STATUS.VD_COM_Rx_AGS_ErrOvrTemp, system-signal=SystemSignal_COM_Rx_AGS_ErrOvrTemp}
        sender-receiver-to-signal-mapping={data-element=CPT_MDG1_FlatView.RP_COM_Rx_AGS_ECM_STATUS.VD_COM_Rx_AGS_ErrOvrVolt, system-signal=SystemSignal_COM_Rx_AGS_ErrOvrVolt}
        sender-receiver-to-signal-mapping={data-element=CPT_MDG1_FlatView.RP_COM_Rx_AGS_ECM_STATUS.VD_COM_Rx_AGS_ErrUnVolt, system-signal=SystemSignal_COM_Rx_AGS_ErrUnVolt}
        sender-receiver-to-signal-mapping={data-element=CPT_MDG1_FlatView.RP_COM_Rx_AGS_ECM_STATUS.VD_COM_Rx_RsErr_AGS, system-signal=SystemSignal_COM_Rx_RsErr_AGS}
        sender-receiver-to-signal-mapping={data-element=CPT_MDG1_FlatView.RP_COM_Rx_EEV1_ECM.VD_COM_Rx_EEV1_CalStat, system-signal=SystemSignal_COM_Rx_EEV1_CalStat}
        sender-receiver-to-signal-mapping={data-element=CPT_MDG1_FlatView.RP_COM_Rx_EEV1_ECM.VD_COM_Rx_EEV1_ERR, system-signal=SystemSignal_COM_Rx_EEV1_ERR}
        sender-receiver-to-signal-mapping={data-element=CPT_MDG1_FlatView.RP_COM_Rx_EEV1_ECM.VD_COM_Rx_EEV1_HALL, system-signal=SystemSignal_COM_Rx_EEV1_HALL}
        sender-receiver-to-signal-mapping={data-element=CPT_MDG1_FlatView.RP_COM_Rx_EEV1_ECM.VD_COM_Rx_EEV1_MotorCurr, system-signal=SystemSignal_COM_Rx_EEV1_MotorCurr}
        sender-receiver-to-signal-mapping={data-element=CPT_MDG1_FlatView.RP_COM_Rx_EEV1_ECM.VD_COM_Rx_EEV1_MotorVolt, system-signal=SystemSignal_COM_Rx_EEV1_MotorVolt}
        sender-receiver-to-signal-mapping={data-element=CPT_MDG1_FlatView.RP_COM_Rx_EEV1_ECM.VD_COM_Rx_EEV1_PosAct, system-signal=SystemSignal_COM_Rx_EEV1_PosAct}
        sender-receiver-to-signal-mapping={data-element=CPT_MDG1_FlatView.RP_COM_Rx_EEV1_ECM.VD_COM_Rx_EEV1_Sts, system-signal=SystemSignal_COM_Rx_EEV1_Sts}
        sender-receiver-to-signal-mapping={data-element=CPT_MDG1_FlatView.RP_COM_Rx_EEV1_ECM.VD_COM_Rx_EEV1_SupplyVolt, system-signal=SystemSignal_COM_Rx_EEV1_SupplyVolt}
        sender-receiver-to-signal-mapping={data-element=CPT_MDG1_FlatView.RP_COM_Rx_EEV1_ECM.VD_COM_Rx_EEV1_Temp, system-signal=SystemSignal_COM_Rx_EEV1_Temp}
        sender-receiver-to-signal-mapping={data-element=CPT_MDG1_FlatView.RP_COM_Rx_EEV1_ECM.VD_COM_Rx_RsErr_EEV1, system-signal=SystemSignal_COM_Rx_RsErr_EEV1}
        sender-receiver-to-signal-mapping={data-element=CPT_MDG1_FlatView.RP_COM_Rx_EEV2_ECM.VD_COM_Rx_EEV2_CalStat, system-signal=SystemSignal_COM_Rx_EEV2_CalStat}
        sender-receiver-to-signal-mapping={data-element=CPT_MDG1_FlatView.RP_COM_Rx_EEV2_ECM.VD_COM_Rx_EEV2_ERR, system-signal=SystemSignal_COM_Rx_EEV2_ERR}
        sender-receiver-to-signal-mapping={data-element=CPT_MDG1_FlatView.RP_COM_Rx_EEV2_ECM.VD_COM_Rx_EEV2_HALL, system-signal=SystemSignal_COM_Rx_EEV2_HALL}
        sender-receiver-to-signal-mapping={data-element=CPT_MDG1_FlatView.RP_COM_Rx_EEV2_ECM.VD_COM_Rx_EEV2_MotorCurr, system-signal=SystemSignal_COM_Rx_EEV2_MotorCurr}
        sender-receiver-to-signal-mapping={data-element=CPT_MDG1_FlatView.RP_COM_Rx_EEV2_ECM.VD_COM_Rx_EEV2_MotorVolt, system-signal=SystemSignal_COM_Rx_EEV2_MotorVolt}
        sender-receiver-to-signal-mapping={data-element=CPT_MDG1_FlatView.RP_COM_Rx_EEV2_ECM.VD_COM_Rx_EEV2_PosAct, system-signal=SystemSignal_COM_Rx_EEV2_PosAct}
        sender-receiver-to-signal-mapping={data-element=CPT_MDG1_FlatView.RP_COM_Rx_EEV2_ECM.VD_COM_Rx_EEV2_Sts, system-signal=SystemSignal_COM_Rx_EEV2_Sts}
        sender-receiver-to-signal-mapping={data-element=CPT_MDG1_FlatView.RP_COM_Rx_EEV2_ECM.VD_COM_Rx_EEV2_SupplyVolt, system-signal=SystemSignal_COM_Rx_EEV2_SupplyVolt}
        sender-receiver-to-signal-mapping={data-element=CPT_MDG1_FlatView.RP_COM_Rx_EEV2_ECM.VD_COM_Rx_EEV2_Temp, system-signal=SystemSignal_COM_Rx_EEV2_Temp}
        sender-receiver-to-signal-mapping={data-element=CPT_MDG1_FlatView.RP_COM_Rx_EEV2_ECM.VD_COM_Rx_RsErr_EEV2, system-signal=SystemSignal_COM_Rx_RsErr_EEV2}
        sender-receiver-to-signal-mapping={data-element=CPT_MDG1_FlatView.RP_COM_Rx_HAPM_STAT.VD_COM_Rx_HAPM_AIR_PRE_ERR, system-signal=SystemSignal_COM_Rx_HAPM_AIR_PRE_ERR}
        sender-receiver-to-signal-mapping={data-element=CPT_MDG1_FlatView.RP_COM_Rx_HAPM_STAT.VD_COM_Rx_HAPM_CURR, system-signal=SystemSignal_COM_Rx_HAPM_CURR}
        sender-receiver-to-signal-mapping={data-element=CPT_MDG1_FlatView.RP_COM_Rx_HAPM_STAT.VD_COM_Rx_HAPM_DBLK_ACTV, system-signal=SystemSignal_COM_Rx_HAPM_DBLK_ACTV}
        sender-receiver-to-signal-mapping={data-element=CPT_MDG1_FlatView.RP_COM_Rx_HAPM_STAT.VD_COM_Rx_HAPM_DR_RN_ERR, system-signal=SystemSignal_COM_Rx_HAPM_DR_RN_ERR}
        sender-receiver-to-signal-mapping={data-element=CPT_MDG1_FlatView.RP_COM_Rx_HAPM_STAT.VD_COM_Rx_HAPM_NODE_ERR, system-signal=SystemSignal_COM_Rx_HAPM_NODE_ERR}
        sender-receiver-to-signal-mapping={data-element=CPT_MDG1_FlatView.RP_COM_Rx_HAPM_STAT.VD_COM_Rx_HAPM_OVR_CUR_ERR, system-signal=SystemSignal_COM_Rx_HAPM_OVR_CUR_ERR}
        sender-receiver-to-signal-mapping={data-element=CPT_MDG1_FlatView.RP_COM_Rx_HAPM_STAT.VD_COM_Rx_HAPM_OVR_TMP_ERR, system-signal=SystemSignal_COM_Rx_HAPM_OVR_TMP_ERR}
        sender-receiver-to-signal-mapping={data-element=CPT_MDG1_FlatView.RP_COM_Rx_HAPM_STAT.VD_COM_Rx_HAPM_POST_RUN_STAT, system-signal=SystemSignal_COM_Rx_HAPM_POST_RUN_STAT}
        sender-receiver-to-signal-mapping={data-element=CPT_MDG1_FlatView.RP_COM_Rx_HAPM_STAT.VD_COM_Rx_HAPM_RPM_ACTL, system-signal=SystemSignal_COM_Rx_HAPM_RPM_ACTL}
        sender-receiver-to-signal-mapping={data-element=CPT_MDG1_FlatView.RP_COM_Rx_HAPM_STAT.VD_COM_Rx_HAPM_RPM_TGT, system-signal=SystemSignal_COM_Rx_HAPM_RPM_TGT}
        sender-receiver-to-signal-mapping={data-element=CPT_MDG1_FlatView.RP_COM_Rx_HAPM_STAT.VD_COM_Rx_HAPM_TEMP, system-signal=SystemSignal_COM_Rx_HAPM_TEMP}
        sender-receiver-to-signal-mapping={data-element=CPT_MDG1_FlatView.RP_COM_Rx_HAPM_STAT.VD_COM_Rx_HAPM_VLTG, system-signal=SystemSignal_COM_Rx_HAPM_VLTG}
        sender-receiver-to-signal-mapping={data-element=CPT_MDG1_FlatView.RP_COM_Rx_HAPM_STAT.VD_COM_Rx_HAPM_VLTG_ERR, system-signal=SystemSignal_COM_Rx_HAPM_VLTG_ERR}
        sender-receiver-to-signal-mapping={data-element=CPT_MDG1_FlatView.RP_COM_Rx_HAPM_STAT.VD_COM_Rx_RsErr_HAPM_PUMP, system-signal=SystemSignal_COM_Rx_RsErr_HAPM_PUMP}
        sender-receiver-to-signal-mapping={data-element=CPT_MDG1_FlatView.RP_COM_Rx_HAPM_VER.VD_COM_Rx_HAPM_SUPPLIER, system-signal=SystemSignal_COM_Rx_HAPM_SUPPLIER}
        sender-receiver-to-signal-mapping={data-element=CPT_MDG1_FlatView.RP_COM_Rx_HAPM_VER.VD_COM_Rx_HAPM_VERSION, system-signal=SystemSignal_COM_Rx_HAPM_VERSION}
        sender-receiver-to-signal-mapping={data-element=CPT_MDG1_FlatView.RP_COM_Rx_LCVM2_ECM.VD_COM_Rx_LCVM2_CalStat, system-signal=SystemSignal_COM_Rx_LCVM2_CalStat}
        sender-receiver-to-signal-mapping={data-element=CPT_MDG1_FlatView.RP_COM_Rx_LCVM2_ECM.VD_COM_Rx_LCVM2_ERR, system-signal=SystemSignal_COM_Rx_LCVM2_ERR}
        sender-receiver-to-signal-mapping={data-element=CPT_MDG1_FlatView.RP_COM_Rx_LCVM2_ECM.VD_COM_Rx_LCVM2_MotorVolt, system-signal=SystemSignal_COM_Rx_LCVM2_MotorVolt}
        sender-receiver-to-signal-mapping={data-element=CPT_MDG1_FlatView.RP_COM_Rx_LCVM2_ECM.VD_COM_Rx_LCVM2_PosAct, system-signal=SystemSignal_COM_Rx_LCVM2_PosAct}
        sender-receiver-to-signal-mapping={data-element=CPT_MDG1_FlatView.RP_COM_Rx_LCVM2_ECM.VD_COM_Rx_LCVM2_Sts, system-signal=SystemSignal_COM_Rx_LCVM2_Sts}
        sender-receiver-to-signal-mapping={data-element=CPT_MDG1_FlatView.RP_COM_Rx_LCVM2_ECM.VD_COM_Rx_RsErr_LCVM2, system-signal=SystemSignal_COM_Rx_RsErr_LCVM2}
        sender-receiver-to-signal-mapping={data-element=CPT_MDG1_FlatView.RP_COM_Rx_LCVM_ECM.VD_COM_Rx_LCVM_CalStat, system-signal=SystemSignal_COM_Rx_LCVM_CalStat}
        sender-receiver-to-signal-mapping={data-element=CPT_MDG1_FlatView.RP_COM_Rx_LCVM_ECM.VD_COM_Rx_LCVM_ERR, system-signal=SystemSignal_COM_Rx_LCVM_ERR}
        sender-receiver-to-signal-mapping={data-element=CPT_MDG1_FlatView.RP_COM_Rx_LCVM_ECM.VD_COM_Rx_LCVM_MotorVolt, system-signal=SystemSignal_COM_Rx_LCVM_MotorVolt}
        sender-receiver-to-signal-mapping={data-element=CPT_MDG1_FlatView.RP_COM_Rx_LCVM_ECM.VD_COM_Rx_LCVM_PosAct, system-signal=SystemSignal_COM_Rx_LCVM_PosAct}
        sender-receiver-to-signal-mapping={data-element=CPT_MDG1_FlatView.RP_COM_Rx_LCVM_ECM.VD_COM_Rx_LCVM_Sts, system-signal=SystemSignal_COM_Rx_LCVM_Sts}
        sender-receiver-to-signal-mapping={data-element=CPT_MDG1_FlatView.RP_COM_Rx_LCVM_ECM.VD_COM_Rx_RsErr_LCVM, system-signal=SystemSignal_COM_Rx_RsErr_LCVM}
        sender-receiver-to-signal-mapping={data-element=CPT_MDG1_FlatView.RP_COM_Rx_LTRP_STAT.VD_COM_Rx_LTRP_AIR_PRE_ERR, system-signal=SystemSignal_COM_Rx_LTRP_AIR_PRE_ERR}
        sender-receiver-to-signal-mapping={data-element=CPT_MDG1_FlatView.RP_COM_Rx_LTRP_STAT.VD_COM_Rx_LTRP_CURR, system-signal=SystemSignal_COM_Rx_LTRP_CURR}
        sender-receiver-to-signal-mapping={data-element=CPT_MDG1_FlatView.RP_COM_Rx_LTRP_STAT.VD_COM_Rx_LTRP_DBLK_ACTV, system-signal=SystemSignal_COM_Rx_LTRP_DBLK_ACTV}
        sender-receiver-to-signal-mapping={data-element=CPT_MDG1_FlatView.RP_COM_Rx_LTRP_STAT.VD_COM_Rx_LTRP_DR_RN_ERR, system-signal=SystemSignal_COM_Rx_LTRP_DR_RN_ERR}
        sender-receiver-to-signal-mapping={data-element=CPT_MDG1_FlatView.RP_COM_Rx_LTRP_STAT.VD_COM_Rx_LTRP_NODE_ERR, system-signal=SystemSignal_COM_Rx_LTRP_NODE_ERR}
        sender-receiver-to-signal-mapping={data-element=CPT_MDG1_FlatView.RP_COM_Rx_LTRP_STAT.VD_COM_Rx_LTRP_OVR_CUR_ERR, system-signal=SystemSignal_COM_Rx_LTRP_OVR_CUR_ERR}
        sender-receiver-to-signal-mapping={data-element=CPT_MDG1_FlatView.RP_COM_Rx_LTRP_STAT.VD_COM_Rx_LTRP_OVR_TMP_ERR, system-signal=SystemSignal_COM_Rx_LTRP_OVR_TMP_ERR}
        sender-receiver-to-signal-mapping={data-element=CPT_MDG1_FlatView.RP_COM_Rx_LTRP_STAT.VD_COM_Rx_LTRP_POST_RUN_STAT, system-signal=SystemSignal_COM_Rx_LTRP_POST_RUN_STAT}
        sender-receiver-to-signal-mapping={data-element=CPT_MDG1_FlatView.RP_COM_Rx_LTRP_STAT.VD_COM_Rx_LTRP_RPM_ACTL, system-signal=SystemSignal_COM_Rx_LTRP_RPM_ACTL}
        sender-receiver-to-signal-mapping={data-element=CPT_MDG1_FlatView.RP_COM_Rx_LTRP_STAT.VD_COM_Rx_LTRP_RPM_TGT, system-signal=SystemSignal_COM_Rx_LTRP_RPM_TGT}
        sender-receiver-to-signal-mapping={data-element=CPT_MDG1_FlatView.RP_COM_Rx_LTRP_STAT.VD_COM_Rx_LTRP_TEMP, system-signal=SystemSignal_COM_Rx_LTRP_TEMP}
        sender-receiver-to-signal-mapping={data-element=CPT_MDG1_FlatView.RP_COM_Rx_LTRP_STAT.VD_COM_Rx_LTRP_VLTG, system-signal=SystemSignal_COM_Rx_LTRP_VLTG}
        sender-receiver-to-signal-mapping={data-element=CPT_MDG1_FlatView.RP_COM_Rx_LTRP_STAT.VD_COM_Rx_LTRP_VLTG_ERR, system-signal=SystemSignal_COM_Rx_LTRP_VLTG_ERR}
        sender-receiver-to-signal-mapping={data-element=CPT_MDG1_FlatView.RP_COM_Rx_LTRP_STAT.VD_COM_Rx_RsErr_LTRP_PUMP, system-signal=SystemSignal_COM_Rx_RsErr_LTRP_PUMP}
        sender-receiver-to-signal-mapping={data-element=CPT_MDG1_FlatView.RP_COM_Rx_LTRP_VER.VD_COM_Rx_LTRP_SUPPLIER, system-signal=SystemSignal_COM_Rx_LTRP_SUPPLIER}
        sender-receiver-to-signal-mapping={data-element=CPT_MDG1_FlatView.RP_COM_Rx_LTRP_VER.VD_COM_Rx_LTRP_VERSION, system-signal=SystemSignal_COM_Rx_LTRP_VERSION}
        sender-receiver-to-signal-mapping={data-element=CPT_MDG1_FlatView.RP_COM_Rx_PCPM_Stat.VD_COM_Rx_PCPM_AIR_PRE_ERR, system-signal=SystemSignal_COM_Rx_PCPM_AIR_PRE_ERR}
        sender-receiver-to-signal-mapping={data-element=CPT_MDG1_FlatView.RP_COM_Rx_PCPM_Stat.VD_COM_Rx_PCPM_CURR, system-signal=SystemSignal_COM_Rx_PCPM_CURR}
        sender-receiver-to-signal-mapping={data-element=CPT_MDG1_FlatView.RP_COM_Rx_PCPM_Stat.VD_COM_Rx_PCPM_DBLK_ACTV, system-signal=SystemSignal_COM_Rx_PCPM_DBLK_ACTV}
        sender-receiver-to-signal-mapping={data-element=CPT_MDG1_FlatView.RP_COM_Rx_PCPM_Stat.VD_COM_Rx_PCPM_DR_RN_ERR, system-signal=SystemSignal_COM_Rx_PCPM_DR_RN_ERR}
        sender-receiver-to-signal-mapping={data-element=CPT_MDG1_FlatView.RP_COM_Rx_PCPM_Stat.VD_COM_Rx_PCPM_NODE_ERR, system-signal=SystemSignal_COM_Rx_PCPM_NODE_ERR}
        sender-receiver-to-signal-mapping={data-element=CPT_MDG1_FlatView.RP_COM_Rx_PCPM_Stat.VD_COM_Rx_PCPM_OVR_CUR_ERR, system-signal=SystemSignal_COM_Rx_PCPM_OVR_CUR_ERR}
        sender-receiver-to-signal-mapping={data-element=CPT_MDG1_FlatView.RP_COM_Rx_PCPM_Stat.VD_COM_Rx_PCPM_OVR_TMP_ERR, system-signal=SystemSignal_COM_Rx_PCPM_OVR_TMP_ERR}
        sender-receiver-to-signal-mapping={data-element=CPT_MDG1_FlatView.RP_COM_Rx_PCPM_Stat.VD_COM_Rx_PCPM_POST_RUN_STAT, system-signal=SystemSignal_COM_Rx_PCPM_POST_RUN_STAT}
        sender-receiver-to-signal-mapping={data-element=CPT_MDG1_FlatView.RP_COM_Rx_PCPM_Stat.VD_COM_Rx_PCPM_RPM_ACTL, system-signal=SystemSignal_COM_Rx_PCPM_RPM_ACTL}
        sender-receiver-to-signal-mapping={data-element=CPT_MDG1_FlatView.RP_COM_Rx_PCPM_Stat.VD_COM_Rx_PCPM_RPM_TGT, system-signal=SystemSignal_COM_Rx_PCPM_RPM_TGT}
        sender-receiver-to-signal-mapping={data-element=CPT_MDG1_FlatView.RP_COM_Rx_PCPM_Stat.VD_COM_Rx_PCPM_TEMP, system-signal=SystemSignal_COM_Rx_PCPM_TEMP}
        sender-receiver-to-signal-mapping={data-element=CPT_MDG1_FlatView.RP_COM_Rx_PCPM_Stat.VD_COM_Rx_PCPM_VLTG, system-signal=SystemSignal_COM_Rx_PCPM_VLTG}
        sender-receiver-to-signal-mapping={data-element=CPT_MDG1_FlatView.RP_COM_Rx_PCPM_Stat.VD_COM_Rx_PCPM_VLTG_ERR, system-signal=SystemSignal_COM_Rx_PCPM_VLTG_ERR}
        sender-receiver-to-signal-mapping={data-element=CPT_MDG1_FlatView.RP_COM_Rx_PCPM_Stat.VD_COM_Rx_RsErr_PCPM_PUMP, system-signal=SystemSignal_COM_Rx_RsErr_PCPM_PUMP}
        sender-receiver-to-signal-mapping={data-element=CPT_MDG1_FlatView.RP_COM_Rx_PCPM_VER.VD_COM_Rx_PCPM_SUPPLIER, system-signal=SystemSignal_COM_Rx_PCPM_SUPPLIER}
        sender-receiver-to-signal-mapping={data-element=CPT_MDG1_FlatView.RP_COM_Rx_PCPM_VER.VD_COM_Rx_PCPM_VERSION, system-signal=SystemSignal_COM_Rx_PCPM_VERSION}
        sender-receiver-to-signal-mapping={data-element=CPT_MDG1_FlatView.RP_COM_Rx_PLA_INFO.VD_COM_Rx_PLA_ExicCurrent, system-signal=SystemSignal_COM_Rx_PLA_ExicCurrent}
        sender-receiver-to-signal-mapping={data-element=CPT_MDG1_FlatView.RP_COM_Rx_PLA_INFO.VD_COM_Rx_PLA_ExicDutyCycle, system-signal=SystemSignal_COM_Rx_PLA_ExicDutyCycle}
        sender-receiver-to-signal-mapping={data-element=CPT_MDG1_FlatView.RP_COM_Rx_PLA_INFO.VD_COM_Rx_PLA_Fault_El, system-signal=SystemSignal_COM_Rx_PLA_Fault_El}
        sender-receiver-to-signal-mapping={data-element=CPT_MDG1_FlatView.RP_COM_Rx_PLA_INFO.VD_COM_Rx_PLA_Fault_HT, system-signal=SystemSignal_COM_Rx_PLA_Fault_HT}
        sender-receiver-to-signal-mapping={data-element=CPT_MDG1_FlatView.RP_COM_Rx_PLA_INFO.VD_COM_Rx_PLA_Fault_Mec, system-signal=SystemSignal_COM_Rx_PLA_Fault_Mec}
        sender-receiver-to-signal-mapping={data-element=CPT_MDG1_FlatView.RP_COM_Rx_PLA_INFO.VD_COM_Rx_PLA_Fault_TO, system-signal=SystemSignal_COM_Rx_PLA_Fault_TO}
        sender-receiver-to-signal-mapping={data-element=CPT_MDG1_FlatView.RP_COM_Rx_PLA_INFO.VD_COM_Rx_PLA_Request_data_Response, system-signal=SystemSignal_COM_Rx_PLA_Request_data_Response}
        sender-receiver-to-signal-mapping={data-element=CPT_MDG1_FlatView.RP_COM_Rx_PLA_INFO.VD_COM_Rx_PLA_Requested_response_data, system-signal=SystemSignal_COM_Rx_PLA_Requested_response_data}
        sender-receiver-to-signal-mapping={data-element=CPT_MDG1_FlatView.RP_COM_Rx_PLA_INFO.VD_COM_Rx_RsErr_PLA, system-signal=SystemSignal_COM_Rx_RsErr_PLA}
        sender-receiver-to-signal-mapping={data-element=CPT_MDG1_FlatView.PP_COM_Tx_ECM_AGS2_DEMAND.VD_COM_Tx_AGS2_BoostRq, system-signal=SystemSignal_COM_Tx_AGS2_BoostRq}
        sender-receiver-to-signal-mapping={data-element=CPT_MDG1_FlatView.PP_COM_Tx_ECM_AGS2_DEMAND.VD_COM_Tx_AGS2_CalRq, system-signal=SystemSignal_COM_Tx_AGS2_CalRq}
        sender-receiver-to-signal-mapping={data-element=CPT_MDG1_FlatView.PP_COM_Tx_ECM_AGS2_DEMAND.VD_COM_Tx_AGS2_PosRq, system-signal=SystemSignal_COM_Tx_AGS2_PosRq}
        sender-receiver-to-signal-mapping={data-element=CPT_MDG1_FlatView.PP_COM_Tx_ECM_AGS2_DEMAND.VD_COM_Tx_M2SRes2Bit_AGS2, system-signal=SystemSignal_COM_Tx_M2SRes2Bit_AGS2}
        sender-receiver-to-signal-mapping={data-element=CPT_MDG1_FlatView.PP_COM_Tx_ECM_AGS2_DEMAND.VD_COM_Tx_M2SResByte1_AGS2, system-signal=SystemSignal_COM_Tx_M2SResByte1_AGS2}
        sender-receiver-to-signal-mapping={data-element=CPT_MDG1_FlatView.PP_COM_Tx_ECM_AGS2_DEMAND.VD_COM_Tx_M2SResByte2_AGS2, system-signal=SystemSignal_COM_Tx_M2SResByte2_AGS2}
        sender-receiver-to-signal-mapping={data-element=CPT_MDG1_FlatView.PP_COM_Tx_ECM_AGS_DEMAND.VD_COM_Tx_AGS_BoostRq, system-signal=SystemSignal_COM_Tx_AGS_BoostRq}
        sender-receiver-to-signal-mapping={data-element=CPT_MDG1_FlatView.PP_COM_Tx_ECM_AGS_DEMAND.VD_COM_Tx_AGS_CalRq, system-signal=SystemSignal_COM_Tx_AGS_CalRq}
        sender-receiver-to-signal-mapping={data-element=CPT_MDG1_FlatView.PP_COM_Tx_ECM_AGS_DEMAND.VD_COM_Tx_AGS_PosRq, system-signal=SystemSignal_COM_Tx_AGS_PosRq}
        sender-receiver-to-signal-mapping={data-element=CPT_MDG1_FlatView.PP_COM_Tx_ECM_EEV.VD_COM_Tx_EEV1_CalRq, system-signal=SystemSignal_COM_Tx_EEV1_CalRq}
        sender-receiver-to-signal-mapping={data-element=CPT_MDG1_FlatView.PP_COM_Tx_ECM_EEV.VD_COM_Tx_EEV1_PosRq, system-signal=SystemSignal_COM_Tx_EEV1_PosRq}
        sender-receiver-to-signal-mapping={data-element=CPT_MDG1_FlatView.PP_COM_Tx_ECM_EEV.VD_COM_Tx_EEV2_CalRq, system-signal=SystemSignal_COM_Tx_EEV2_CalRq}
        sender-receiver-to-signal-mapping={data-element=CPT_MDG1_FlatView.PP_COM_Tx_ECM_EEV.VD_COM_Tx_EEV2_PosRq, system-signal=SystemSignal_COM_Tx_EEV2_PosRq}
        sender-receiver-to-signal-mapping={data-element=CPT_MDG1_FlatView.PP_COM_Tx_ECM_LCVM.VD_COM_Tx_LCVM_CalRq, system-signal=SystemSignal_COM_Tx_LCVM_CalRq}
        sender-receiver-to-signal-mapping={data-element=CPT_MDG1_FlatView.PP_COM_Tx_ECM_LCVM.VD_COM_Tx_LCVM_PosRq, system-signal=SystemSignal_COM_Tx_LCVM_PosRq}
        sender-receiver-to-signal-mapping={data-element=CPT_MDG1_FlatView.PP_COM_Tx_ECM_LCVM.VD_COM_Tx_LCVM_PosSv, system-signal=SystemSignal_COM_Tx_LCVM_PosSv}
        sender-receiver-to-signal-mapping={data-element=CPT_MDG1_FlatView.PP_COM_Tx_ECM_LCVM2.VD_COM_Tx_LCVM2_CalRq, system-signal=SystemSignal_COM_Tx_LCVM2_CalRq}
        sender-receiver-to-signal-mapping={data-element=CPT_MDG1_FlatView.PP_COM_Tx_ECM_LCVM2.VD_COM_Tx_LCVM2_PosRq, system-signal=SystemSignal_COM_Tx_LCVM2_PosRq}
        sender-receiver-to-signal-mapping={data-element=CPT_MDG1_FlatView.PP_COM_Tx_ECM_LCVM2.VD_COM_Tx_LCVM2_PosSv, system-signal=SystemSignal_COM_Tx_LCVM2_PosSv}
        sender-receiver-to-signal-mapping={data-element=CPT_MDG1_FlatView.PP_COM_Tx_HAPM_REQ.VD_COM_Tx_HAPM_POST_RUN_REQ, system-signal=SystemSignal_COM_Tx_HAPM_POST_RUN_REQ}
        sender-receiver-to-signal-mapping={data-element=CPT_MDG1_FlatView.PP_COM_Tx_HAPM_REQ.VD_COM_Tx_HAPM_RPM_REQ, system-signal=SystemSignal_COM_Tx_HAPM_RPM_REQ}
        sender-receiver-to-signal-mapping={data-element=CPT_MDG1_FlatView.PP_COM_Tx_LTRP_REQ.VD_COM_Tx_LTRP_POST_RUN_REQ, system-signal=SystemSignal_COM_Tx_LTRP_POST_RUN_REQ}
        sender-receiver-to-signal-mapping={data-element=CPT_MDG1_FlatView.PP_COM_Tx_LTRP_REQ.VD_COM_Tx_LTRP_RPM_REQ, system-signal=SystemSignal_COM_Tx_LTRP_RPM_REQ}
        sender-receiver-to-signal-mapping={data-element=CPT_MDG1_FlatView.PP_COM_Tx_MASTER_PLA.VD_COM_Tx_PLA_ExicLimit, system-signal=SystemSignal_COM_Tx_PLA_ExicLimit}
        sender-receiver-to-signal-mapping={data-element=CPT_MDG1_FlatView.PP_COM_Tx_MASTER_PLA.VD_COM_Tx_PLA_RampCOSpeed, system-signal=SystemSignal_COM_Tx_PLA_RampCOSpeed}
        sender-receiver-to-signal-mapping={data-element=CPT_MDG1_FlatView.PP_COM_Tx_MASTER_PLA.VD_COM_Tx_PLA_RampTime, system-signal=SystemSignal_COM_Tx_PLA_RampTime}
        sender-receiver-to-signal-mapping={data-element=CPT_MDG1_FlatView.PP_COM_Tx_MASTER_PLA.VD_COM_Tx_PLA_Reg_parameter, system-signal=SystemSignal_COM_Tx_PLA_Reg_parameter}
        sender-receiver-to-signal-mapping={data-element=CPT_MDG1_FlatView.PP_COM_Tx_MASTER_PLA.VD_COM_Tx_PLA_Request_data, system-signal=SystemSignal_COM_Tx_PLA_Request_data}
        sender-receiver-to-signal-mapping={data-element=CPT_MDG1_FlatView.PP_COM_Tx_MASTER_PLA.VD_COM_Tx_PLA_SetVoltage, system-signal=SystemSignal_COM_Tx_PLA_SetVoltage}
        sender-receiver-to-signal-mapping={data-element=CPT_MDG1_FlatView.PP_COM_Tx_MASTER_PLA.VD_COM_Tx_PLA_Thermal_protection, system-signal=SystemSignal_COM_Tx_PLA_Thermal_protection}
        sender-receiver-to-signal-mapping={data-element=CPT_MDG1_FlatView.PP_COM_Tx_PCPM_REQ.VD_COM_Tx_PCPM_POST_RUN_REQ, system-signal=SystemSignal_COM_Tx_PCPM_POST_RUN_REQ}
        sender-receiver-to-signal-mapping={data-element=CPT_MDG1_FlatView.PP_COM_Tx_PCPM_REQ.VD_COM_Tx_PCPM_RPM_REQ, system-signal=SystemSignal_COM_Tx_PCPM_RPM_REQ}
        sender-receiver-to-signal-mapping={data-element=CPT_MDG1_FlatView.RP_COM_Rx_ADAS_FD_HMI_FD3.VD_COM_Rx_CRC_ADAS_FD_HMI_FD3, system-signal=SystemSignal_COM_Rx_CRC_ADAS_FD_HMI_FD3}
        sender-receiver-to-signal-mapping={data-element=CPT_MDG1_FlatView.RP_COM_Rx_ADAS_FD_HMI_FD3.VD_COM_Rx_MessageCounter_ADAS_FD_HMI_FD3, system-signal=SystemSignal_COM_Rx_MessageCounter_ADAS_FD_HMI_FD3}
        sender-receiver-to-signal-mapping={data-element=CPT_MDG1_FlatView.RP_COM_Rx_ADAS_FD_HMI_FD3.VD_COM_Rx_Set_Speed_KPH_FD3, system-signal=SystemSignal_COM_Rx_Set_Speed_KPH_FD3}
        sender-receiver-to-signal-mapping={data-element=CPT_MDG1_FlatView.RP_COM_Rx_ADAS_FD_INFO2.VD_COM_Rx_TSRSts, system-signal=SystemSignal_COM_Rx_TSRSts}
        sender-receiver-to-signal-mapping={data-element=CPT_MDG1_FlatView.RP_COM_Rx_ADCM_FD_A4.VD_COM_Rx_FL_Lvl_RawAD_Src, system-signal=SystemSignal_COM_Rx_FL_Lvl_RawAD_Src}
        sender-receiver-to-signal-mapping={data-element=CPT_MDG1_FlatView.RP_COM_Rx_ADCM_FD_A4.VD_COM_Rx_FL_Lvl_Stat_Src, system-signal=SystemSignal_COM_Rx_FL_Lvl_Stat_Src}
        sender-receiver-to-signal-mapping={data-element=CPT_MDG1_FlatView.RP_COM_Rx_ADCM_FD_A4.VD_COM_Rx_FL_Z_Accel_Stat_Src, system-signal=SystemSignal_COM_Rx_FL_Z_Accel_Stat_Src}
        sender-receiver-to-signal-mapping={data-element=CPT_MDG1_FlatView.RP_COM_Rx_ADCM_FD_A4.VD_COM_Rx_FR_Lvl_RawAD_Src, system-signal=SystemSignal_COM_Rx_FR_Lvl_RawAD_Src}
        sender-receiver-to-signal-mapping={data-element=CPT_MDG1_FlatView.RP_COM_Rx_ADCM_FD_A4.VD_COM_Rx_FR_Lvl_Stat_Src, system-signal=SystemSignal_COM_Rx_FR_Lvl_Stat_Src}
        sender-receiver-to-signal-mapping={data-element=CPT_MDG1_FlatView.RP_COM_Rx_ADCM_FD_A4.VD_COM_Rx_FR_Z_Accel_Stat_Src, system-signal=SystemSignal_COM_Rx_FR_Z_Accel_Stat_Src}
        sender-receiver-to-signal-mapping={data-element=CPT_MDG1_FlatView.RP_COM_Rx_ADCM_FD_A4.VD_COM_Rx_RC_Z_Accel_Stat_Src, system-signal=SystemSignal_COM_Rx_RC_Z_Accel_Stat_Src}
        sender-receiver-to-signal-mapping={data-element=CPT_MDG1_FlatView.RP_COM_Rx_ADCM_FD_A4.VD_COM_Rx_RL_Lvl_RawAD_Src, system-signal=SystemSignal_COM_Rx_RL_Lvl_RawAD_Src}
        sender-receiver-to-signal-mapping={data-element=CPT_MDG1_FlatView.RP_COM_Rx_ADCM_FD_A4.VD_COM_Rx_RL_Lvl_Stat_Src, system-signal=SystemSignal_COM_Rx_RL_Lvl_Stat_Src}
        sender-receiver-to-signal-mapping={data-element=CPT_MDG1_FlatView.RP_COM_Rx_ADCM_FD_A4.VD_COM_Rx_RR_Lvl_RawAD_Src, system-signal=SystemSignal_COM_Rx_RR_Lvl_RawAD_Src}
        sender-receiver-to-signal-mapping={data-element=CPT_MDG1_FlatView.RP_COM_Rx_ADCM_FD_A4.VD_COM_Rx_RR_Lvl_Stat_Src, system-signal=SystemSignal_COM_Rx_RR_Lvl_Stat_Src}
        sender-receiver-to-signal-mapping={data-element=CPT_MDG1_FlatView.RP_COM_Rx_ADCM_FD_A4.VD_COM_Rx_Z_Acceleration_FL_Src, system-signal=SystemSignal_COM_Rx_Z_Acceleration_FL_Src}
        sender-receiver-to-signal-mapping={data-element=CPT_MDG1_FlatView.RP_COM_Rx_ADCM_FD_A4.VD_COM_Rx_Z_Acceleration_FR_Src, system-signal=SystemSignal_COM_Rx_Z_Acceleration_FR_Src}
        sender-receiver-to-signal-mapping={data-element=CPT_MDG1_FlatView.RP_COM_Rx_ADCM_FD_A4.VD_COM_Rx_Z_Acceleration_RC_Src, system-signal=SystemSignal_COM_Rx_Z_Acceleration_RC_Src}
        sender-receiver-to-signal-mapping={data-element=CPT_MDG1_FlatView.RP_COM_Rx_ASCM_FD_2.VD_COM_Rx_ASCM_Stat, system-signal=SystemSignal_COM_Rx_ASCM_Stat}
        sender-receiver-to-signal-mapping={data-element=CPT_MDG1_FlatView.RP_COM_Rx_BCM_FD_10.VD_COM_Rx_CmdIgnSts, system-signal=SystemSignal_COM_Rx_CmdIgnSts}
        sender-receiver-to-signal-mapping={data-element=CPT_MDG1_FlatView.RP_COM_Rx_BCM_FD_10.VD_COM_Rx_CompressorACReqSts, system-signal=SystemSignal_COM_Rx_CompressorACReqSts}
        sender-receiver-to-signal-mapping={data-element=CPT_MDG1_FlatView.RP_COM_Rx_BCM_FD_10.VD_COM_Rx_ExternalTemperatureC, system-signal=SystemSignal_COM_Rx_ExternalTemperatureC}
        sender-receiver-to-signal-mapping={data-element=CPT_MDG1_FlatView.RP_COM_Rx_BCM_FD_10.VD_COM_Rx_SpSt_Pad1, system-signal=SystemSignal_COM_Rx_SpSt_Pad1}
        sender-receiver-to-signal-mapping={data-element=CPT_MDG1_FlatView.RP_COM_Rx_BCM_FD_11.VD_COM_Rx_A2D_DRV_TEMP_DR_POS, system-signal=SystemSignal_COM_Rx_A2D_DRV_TEMP_DR_POS}
        sender-receiver-to-signal-mapping={data-element=CPT_MDG1_FlatView.RP_COM_Rx_BCM_FD_11.VD_COM_Rx_AcOutputCurrentSts, system-signal=SystemSignal_COM_Rx_AcOutputCurrentSts}
        sender-receiver-to-signal-mapping={data-element=CPT_MDG1_FlatView.RP_COM_Rx_BCM_FD_11.VD_COM_Rx_PARK_BRK_EGD, system-signal=SystemSignal_COM_Rx_PARK_BRK_EGD}
        sender-receiver-to-signal-mapping={data-element=CPT_MDG1_FlatView.RP_COM_Rx_BCM_FD_11.VD_COM_Rx_Parallel_Prk_Ast_Pad1, system-signal=SystemSignal_COM_Rx_Parallel_Prk_Ast_Pad1}
        sender-receiver-to-signal-mapping={data-element=CPT_MDG1_FlatView.RP_COM_Rx_BCM_FD_11.VD_COM_Rx_StopStartClimateInfo, system-signal=SystemSignal_COM_Rx_StopStartClimateInfo}
        sender-receiver-to-signal-mapping={data-element=CPT_MDG1_FlatView.RP_COM_Rx_BCM_FD_12.VD_COM_Rx_GlobDrvMdRq_BCM, system-signal=SystemSignal_COM_Rx_GlobDrvMdRq_BCM}
        sender-receiver-to-signal-mapping={data-element=CPT_MDG1_FlatView.RP_COM_Rx_BCM_FD_12.VD_COM_Rx_Left_Button_BCM, system-signal=SystemSignal_COM_Rx_Left_Button_BCM}
        sender-receiver-to-signal-mapping={data-element=CPT_MDG1_FlatView.RP_COM_Rx_BCM_FD_12.VD_COM_Rx_PowerShot_BCM, system-signal=SystemSignal_COM_Rx_PowerShot_BCM}
        sender-receiver-to-signal-mapping={data-element=CPT_MDG1_FlatView.RP_COM_Rx_BCM_FD_12.VD_COM_Rx_Right_Button_BCM, system-signal=SystemSignal_COM_Rx_Right_Button_BCM}
        sender-receiver-to-signal-mapping={data-element=CPT_MDG1_FlatView.RP_COM_Rx_BCM_FD_12.VD_COM_Rx_Sport_Request, system-signal=SystemSignal_COM_Rx_Sport_Request}
        sender-receiver-to-signal-mapping={data-element=CPT_MDG1_FlatView.RP_COM_Rx_BCM_FD_12.VD_COM_Rx_TerrainModeInterfaceButton_BCM, system-signal=SystemSignal_COM_Rx_TerrainModeInterfaceButton_BCM}
        sender-receiver-to-signal-mapping={data-element=CPT_MDG1_FlatView.RP_COM_Rx_BCM_FD_12.VD_COM_Rx_TerrainSwStat, system-signal=SystemSignal_COM_Rx_TerrainSwStat}
        sender-receiver-to-signal-mapping={data-element=CPT_MDG1_FlatView.RP_COM_Rx_BCM_FD_12.VD_COM_Rx_Tow_Request, system-signal=SystemSignal_COM_Rx_Tow_Request}
        sender-receiver-to-signal-mapping={data-element=CPT_MDG1_FlatView.RP_COM_Rx_BCM_FD_12.VD_COM_Rx_Trns_DrvMdReq_BCM, system-signal=SystemSignal_COM_Rx_Trns_DrvMdReq_BCM}
        sender-receiver-to-signal-mapping={data-element=CPT_MDG1_FlatView.RP_COM_Rx_BCM_FD_14.VD_COM_Rx_Command_15Sts, system-signal=SystemSignal_COM_Rx_Command_15Sts}
        sender-receiver-to-signal-mapping={data-element=CPT_MDG1_FlatView.RP_COM_Rx_BCM_FD_23.VD_COM_Rx_PowerDraw, system-signal=SystemSignal_COM_Rx_PowerDraw}
        sender-receiver-to-signal-mapping={data-element=CPT_MDG1_FlatView.RP_COM_Rx_BCM_FD_23.VD_COM_Rx_Worksite_Inverter_Active, system-signal=SystemSignal_COM_Rx_Worksite_Inverter_Active}
        sender-receiver-to-signal-mapping={data-element=CPT_MDG1_FlatView.RP_COM_Rx_BCM_FD_26.VD_COM_Rx_DRV_TEMP_DR_POS_PCT, system-signal=SystemSignal_COM_Rx_DRV_TEMP_DR_POS_PCT}
        sender-receiver-to-signal-mapping={data-element=CPT_MDG1_FlatView.RP_COM_Rx_BCM_FD_26.VD_COM_Rx_HAS_OnOffSts, system-signal=SystemSignal_COM_Rx_HAS_OnOffSts}
        sender-receiver-to-signal-mapping={data-element=CPT_MDG1_FlatView.RP_COM_Rx_BCM_FD_26.VD_COM_Rx_HVAC_CLNT_FLW_MIN, system-signal=SystemSignal_COM_Rx_HVAC_CLNT_FLW_MIN}
        sender-receiver-to-signal-mapping={data-element=CPT_MDG1_FlatView.RP_COM_Rx_BCM_FD_27.VD_COM_Rx_Blower_Diagnostics, system-signal=SystemSignal_COM_Rx_Blower_Diagnostics}
        sender-receiver-to-signal-mapping={data-element=CPT_MDG1_FlatView.RP_COM_Rx_BCM_FD_27.VD_COM_Rx_Blower_Speed, system-signal=SystemSignal_COM_Rx_Blower_Speed}
        sender-receiver-to-signal-mapping={data-element=CPT_MDG1_FlatView.RP_COM_Rx_BCM_FD_29.VD_COM_Rx_ITBM_DSP_RQ, system-signal=SystemSignal_COM_Rx_ITBM_DSP_RQ}
        sender-receiver-to-signal-mapping={data-element=CPT_MDG1_FlatView.RP_COM_Rx_BCM_FD_29.VD_COM_Rx_ITBM_TrlrStat, system-signal=SystemSignal_COM_Rx_ITBM_TrlrStat}
        sender-receiver-to-signal-mapping={data-element=CPT_MDG1_FlatView.RP_COM_Rx_BCM_FD_3.VD_COM_Rx_Battery_Volt_1, system-signal=SystemSignal_COM_Rx_Battery_Volt_1}
        sender-receiver-to-signal-mapping={data-element=CPT_MDG1_FlatView.RP_COM_Rx_BCM_FD_3.VD_COM_Rx_Battery_Volt_2, system-signal=SystemSignal_COM_Rx_Battery_Volt_2}
        sender-receiver-to-signal-mapping={data-element=CPT_MDG1_FlatView.RP_COM_Rx_BCM_FD_4.VD_COM_Rx_AM_ECM_Trace, system-signal=SystemSignal_COM_Rx_AM_ECM_Trace}
        sender-receiver-to-signal-mapping={data-element=CPT_MDG1_FlatView.RP_COM_Rx_BCM_FD_4.VD_COM_Rx_BCMSAMFailSts, system-signal=SystemSignal_COM_Rx_BCMSAMFailSts}
        sender-receiver-to-signal-mapping={data-element=CPT_MDG1_FlatView.RP_COM_Rx_BCM_FD_4.VD_COM_Rx_CRC_BCM4, system-signal=SystemSignal_COM_Rx_CRC_BCM4}
        sender-receiver-to-signal-mapping={data-element=CPT_MDG1_FlatView.RP_COM_Rx_BCM_FD_4.VD_COM_Rx_ExternalTemperatureAD_Voltage, system-signal=SystemSignal_COM_Rx_ExternalTemperatureAD_Voltage}
        sender-receiver-to-signal-mapping={data-element=CPT_MDG1_FlatView.RP_COM_Rx_BCM_FD_4.VD_COM_Rx_FUEL_VOLT, system-signal=SystemSignal_COM_Rx_FUEL_VOLT}
        sender-receiver-to-signal-mapping={data-element=CPT_MDG1_FlatView.RP_COM_Rx_BCM_FD_4.VD_COM_Rx_FUEL_VOLT2, system-signal=SystemSignal_COM_Rx_FUEL_VOLT2}
        sender-receiver-to-signal-mapping={data-element=CPT_MDG1_FlatView.RP_COM_Rx_BCM_FD_4.VD_COM_Rx_MessageCounter_BCM4, system-signal=SystemSignal_COM_Rx_MessageCounter_BCM4}
        sender-receiver-to-signal-mapping={data-element=CPT_MDG1_FlatView.RP_COM_Rx_BCM_FD_4.VD_COM_Rx_VoltageMax, system-signal=SystemSignal_COM_Rx_VoltageMax}
        sender-receiver-to-signal-mapping={data-element=CPT_MDG1_FlatView.RP_COM_Rx_BCM_FD_4.VD_COM_Rx_VoltageMin, system-signal=SystemSignal_COM_Rx_VoltageMin}
        sender-receiver-to-signal-mapping={data-element=CPT_MDG1_FlatView.RP_COM_Rx_BCM_FD_6.VD_COM_Rx_ChkFuelLevelSts, system-signal=SystemSignal_COM_Rx_ChkFuelLevelSts}
        sender-receiver-to-signal-mapping={data-element=CPT_MDG1_FlatView.RP_COM_Rx_BCM_FD_6.VD_COM_Rx_ChkFuelLevelSts2, system-signal=SystemSignal_COM_Rx_ChkFuelLevelSts2}
        sender-receiver-to-signal-mapping={data-element=CPT_MDG1_FlatView.RP_COM_Rx_BCM_FD_7.VD_COM_Rx_IgnitionOnCounter, system-signal=SystemSignal_COM_Rx_IgnitionOnCounter}
        sender-receiver-to-signal-mapping={data-element=CPT_MDG1_FlatView.RP_COM_Rx_BRAKE_FD_6_FD3.VD_COM_Rx_CRC_BRAKE_FD_6_FD3, system-signal=SystemSignal_COM_Rx_CRC_BRAKE_FD_6_FD3}
        sender-receiver-to-signal-mapping={data-element=CPT_MDG1_FlatView.RP_COM_Rx_BRAKE_FD_6_FD3.VD_COM_Rx_DriverReq_AxleTrq_Enabled_BSMFD3, system-signal=SystemSignal_COM_Rx_DriverReq_AxleTrq_Enabled_BSMFD3}
        sender-receiver-to-signal-mapping={data-element=CPT_MDG1_FlatView.RP_COM_Rx_BRAKE_FD_6_FD3.VD_COM_Rx_DriverRequested_AxleTrq_BSM_FD3, system-signal=SystemSignal_COM_Rx_DriverRequested_AxleTrq_BSM_FD3}
        sender-receiver-to-signal-mapping={data-element=CPT_MDG1_FlatView.RP_COM_Rx_BRAKE_FD_6_FD3.VD_COM_Rx_MessageCounter_BRAKE_FD_6_FD3, system-signal=SystemSignal_COM_Rx_MessageCounter_BRAKE_FD_6_FD3}
        sender-receiver-to-signal-mapping={data-element=CPT_MDG1_FlatView.RP_COM_Rx_BRAKE_FD_6_FD3.VD_COM_Rx_Not_OK_To_Race_FD3, system-signal=SystemSignal_COM_Rx_Not_OK_To_Race_FD3}
        sender-receiver-to-signal-mapping={data-element=CPT_MDG1_FlatView.RP_COM_Rx_BRAKE_FD_6_FD3.VD_COM_Rx_TotalAxle_Max_Rq_BSM_FD3, system-signal=SystemSignal_COM_Rx_TotalAxle_Max_Rq_BSM_FD3}
        sender-receiver-to-signal-mapping={data-element=CPT_MDG1_FlatView.RP_COM_Rx_BRAKE_FD_6_FD3.VD_COM_Rx_TotalAxle_Min_Rq_BSM_FD3, system-signal=SystemSignal_COM_Rx_TotalAxle_Min_Rq_BSM_FD3}
        sender-receiver-to-signal-mapping={data-element=CPT_MDG1_FlatView.RP_COM_Rx_BRAKE_FD_6_FD3.VD_COM_Rx_TotalAxle_Rq_BSM_FD3, system-signal=SystemSignal_COM_Rx_TotalAxle_Rq_BSM_FD3}
        sender-receiver-to-signal-mapping={data-element=CPT_MDG1_FlatView.RP_COM_Rx_CFG_DATA_CODE_REQUEST.VD_COM_Rx_Digit01_DigitDummy, system-signal=SystemSignal_COM_Rx_Digit01_DigitDummy}
        sender-receiver-to-signal-mapping={data-element=CPT_MDG1_FlatView.RP_COM_Rx_CFG_DATA_CODE_REQUEST.VD_COM_Rx_Digit03_Digit02, system-signal=SystemSignal_COM_Rx_Digit03_Digit02}
        sender-receiver-to-signal-mapping={data-element=CPT_MDG1_FlatView.RP_COM_Rx_CFG_DATA_CODE_REQUEST.VD_COM_Rx_Digit05_Digit04, system-signal=SystemSignal_COM_Rx_Digit05_Digit04}
        sender-receiver-to-signal-mapping={data-element=CPT_MDG1_FlatView.RP_COM_Rx_CFG_DATA_CODE_REQUEST.VD_COM_Rx_Digit07_Digit06, system-signal=SystemSignal_COM_Rx_Digit07_Digit06}
        sender-receiver-to-signal-mapping={data-element=CPT_MDG1_FlatView.RP_COM_Rx_CFG_DATA_CODE_REQUEST.VD_COM_Rx_Digit09_Digit08, system-signal=SystemSignal_COM_Rx_Digit09_Digit08}
        sender-receiver-to-signal-mapping={data-element=CPT_MDG1_FlatView.RP_COM_Rx_CFG_DATA_CODE_REQUEST.VD_COM_Rx_Digit11_Digit10, system-signal=SystemSignal_COM_Rx_Digit11_Digit10}
        sender-receiver-to-signal-mapping={data-element=CPT_MDG1_FlatView.RP_COM_Rx_CVPAM_FD_Info.VD_COM_Rx_SPMControlSts, system-signal=SystemSignal_COM_Rx_SPMControlSts}
        sender-receiver-to-signal-mapping={data-element=CPT_MDG1_FlatView.RP_COM_Rx_DRIVETRAIN_FD_3.VD_COM_Rx_CRC_DRIVETRAIN3, system-signal=SystemSignal_COM_Rx_CRC_DRIVETRAIN3}
        sender-receiver-to-signal-mapping={data-element=CPT_MDG1_FlatView.RP_COM_Rx_DRIVETRAIN_FD_3.VD_COM_Rx_MessageCounter_DRIVETRAIN3, system-signal=SystemSignal_COM_Rx_MessageCounter_DRIVETRAIN3}
        sender-receiver-to-signal-mapping={data-element=CPT_MDG1_FlatView.RP_COM_Rx_DRIVETRAIN_FD_3.VD_COM_Rx_TCASERANGESTATUS, system-signal=SystemSignal_COM_Rx_TCASERANGESTATUS}
        sender-receiver-to-signal-mapping={data-element=CPT_MDG1_FlatView.RP_COM_Rx_EPS_FD_2.VD_COM_Rx_EPS_Warn_Disp_Rq, system-signal=SystemSignal_COM_Rx_EPS_Warn_Disp_Rq}
        sender-receiver-to-signal-mapping={data-element=CPT_MDG1_FlatView.RP_COM_Rx_FOTA_MASTER.VD_COM_Rx_FOTA_Install_Type, system-signal=SystemSignal_COM_Rx_FOTA_Install_Type}
        sender-receiver-to-signal-mapping={data-element=CPT_MDG1_FlatView.RP_COM_Rx_FOTA_MASTER.VD_COM_Rx_FOTA_Status, system-signal=SystemSignal_COM_Rx_FOTA_Status}
        sender-receiver-to-signal-mapping={data-element=CPT_MDG1_FlatView.RP_COM_Rx_GPF_DATA_FD_1.VD_COM_Rx_GPF_T1_Status, system-signal=SystemSignal_COM_Rx_GPF_T1_Status}
        sender-receiver-to-signal-mapping={data-element=CPT_MDG1_FlatView.RP_COM_Rx_GPF_DATA_FD_1.VD_COM_Rx_GPF_T1_TEMP, system-signal=SystemSignal_COM_Rx_GPF_T1_TEMP}
        sender-receiver-to-signal-mapping={data-element=CPT_MDG1_FlatView.RP_COM_Rx_GPF_DATA_FD_1.VD_COM_Rx_GPF_T2_Status, system-signal=SystemSignal_COM_Rx_GPF_T2_Status}
        sender-receiver-to-signal-mapping={data-element=CPT_MDG1_FlatView.RP_COM_Rx_GPF_DATA_FD_1.VD_COM_Rx_GPF_T2_TEMP, system-signal=SystemSignal_COM_Rx_GPF_T2_TEMP}
        sender-receiver-to-signal-mapping={data-element=CPT_MDG1_FlatView.RP_COM_Rx_HVBATTERY1.VD_COM_Rx_CODE_CLR_BPCM, system-signal=SystemSignal_COM_Rx_CODE_CLR_BPCM}
        sender-receiver-to-signal-mapping={data-element=CPT_MDG1_FlatView.RP_COM_Rx_HVBATTERY1.VD_COM_Rx_HVBatteryCurrent, system-signal=SystemSignal_COM_Rx_HVBatteryCurrent}
        sender-receiver-to-signal-mapping={data-element=CPT_MDG1_FlatView.RP_COM_Rx_HVBATTERY1.VD_COM_Rx_REPRGD_PFC_CLR_BPCM, system-signal=SystemSignal_COM_Rx_REPRGD_PFC_CLR_BPCM}
        sender-receiver-to-signal-mapping={data-element=CPT_MDG1_FlatView.RP_COM_Rx_HVBATTERY2.VD_COM_Rx_HVBatteryMILRequest, system-signal=SystemSignal_COM_Rx_HVBatteryMILRequest}
        sender-receiver-to-signal-mapping={data-element=CPT_MDG1_FlatView.RP_COM_Rx_HVBATTERY2.VD_COM_Rx_HVBatterySOC, system-signal=SystemSignal_COM_Rx_HVBatterySOC}
        sender-receiver-to-signal-mapping={data-element=CPT_MDG1_FlatView.RP_COM_Rx_HVBATTERY2.VD_COM_Rx_HVBatterySOCV, system-signal=SystemSignal_COM_Rx_HVBatterySOCV}
        sender-receiver-to-signal-mapping={data-element=CPT_MDG1_FlatView.RP_COM_Rx_HVBATTERY3.VD_COM_Rx_HVBatChargePower_Instant, system-signal=SystemSignal_COM_Rx_HVBatChargePower_Instant}
        sender-receiver-to-signal-mapping={data-element=CPT_MDG1_FlatView.RP_COM_Rx_HVBATTERY3.VD_COM_Rx_HVBatChargePower_InstantV, system-signal=SystemSignal_COM_Rx_HVBatChargePower_InstantV}
        sender-receiver-to-signal-mapping={data-element=CPT_MDG1_FlatView.RP_COM_Rx_HVBATTERY3.VD_COM_Rx_HVBatChargePower_Long, system-signal=SystemSignal_COM_Rx_HVBatChargePower_Long}
        sender-receiver-to-signal-mapping={data-element=CPT_MDG1_FlatView.RP_COM_Rx_HVBATTERY3.VD_COM_Rx_HVBatChargePower_LongV, system-signal=SystemSignal_COM_Rx_HVBatChargePower_LongV}
        sender-receiver-to-signal-mapping={data-element=CPT_MDG1_FlatView.RP_COM_Rx_HVBATTERY3.VD_COM_Rx_HVBatChargePower_Short, system-signal=SystemSignal_COM_Rx_HVBatChargePower_Short}
        sender-receiver-to-signal-mapping={data-element=CPT_MDG1_FlatView.RP_COM_Rx_HVBATTERY3.VD_COM_Rx_HVBatChargePower_ShortV, system-signal=SystemSignal_COM_Rx_HVBatChargePower_ShortV}
        sender-receiver-to-signal-mapping={data-element=CPT_MDG1_FlatView.RP_COM_Rx_HVBATTERY3.VD_COM_Rx_HVBatDischargePower_LongV, system-signal=SystemSignal_COM_Rx_HVBatDischargePower_LongV}
        sender-receiver-to-signal-mapping={data-element=CPT_MDG1_FlatView.RP_COM_Rx_HVBATTERY5.VD_COM_Rx_HVBattery_RealTimeClock, system-signal=SystemSignal_COM_Rx_HVBattery_RealTimeClock}
        sender-receiver-to-signal-mapping={data-element=CPT_MDG1_FlatView.RP_COM_Rx_HVBATTERY5.VD_COM_Rx_HVBattery_RealTimeClockV, system-signal=SystemSignal_COM_Rx_HVBattery_RealTimeClockV}
        sender-receiver-to-signal-mapping={data-element=CPT_MDG1_FlatView.RP_COM_Rx_HV_CHARGER1.VD_COM_Rx_CODE_CLR_IDCM, system-signal=SystemSignal_COM_Rx_CODE_CLR_IDCM}
        sender-receiver-to-signal-mapping={data-element=CPT_MDG1_FlatView.RP_COM_Rx_HV_CHARGER1.VD_COM_Rx_REPRGD_PFC_CLR_IDCM, system-signal=SystemSignal_COM_Rx_REPRGD_PFC_CLR_IDCM}
        sender-receiver-to-signal-mapping={data-element=CPT_MDG1_FlatView.RP_COM_Rx_HYBRID_DISPLAY.VD_COM_Rx_HybridMILRequest, system-signal=SystemSignal_COM_Rx_HybridMILRequest}
        sender-receiver-to-signal-mapping={data-element=CPT_MDG1_FlatView.RP_COM_Rx_HYBRID_HVAC.VD_COM_Rx_ElecClntHtrInletTemp, system-signal=SystemSignal_COM_Rx_ElecClntHtrInletTemp}
        sender-receiver-to-signal-mapping={data-element=CPT_MDG1_FlatView.RP_COM_Rx_HYBRID_HVAC.VD_COM_Rx_ElecCoolantHtrPwr, system-signal=SystemSignal_COM_Rx_ElecCoolantHtrPwr}
        sender-receiver-to-signal-mapping={data-element=CPT_MDG1_FlatView.RP_COM_Rx_HYBRID_HVAC.VD_COM_Rx_HTAuxPmpMontrngRPM, system-signal=SystemSignal_COM_Rx_HTAuxPmpMontrngRPM}
        sender-receiver-to-signal-mapping={data-element=CPT_MDG1_FlatView.RP_COM_Rx_HYBRID_HVAC.VD_COM_Rx_HTAuxPmpRPMAct, system-signal=SystemSignal_COM_Rx_HTAuxPmpRPMAct}
        sender-receiver-to-signal-mapping={data-element=CPT_MDG1_FlatView.RP_COM_Rx_HYBRID_HVAC.VD_COM_Rx_HTShtOffVlvReq, system-signal=SystemSignal_COM_Rx_HTShtOffVlvReq}
        sender-receiver-to-signal-mapping={data-element=CPT_MDG1_FlatView.RP_COM_Rx_HYBRID_HVAC.VD_COM_Rx_HeaterCoreInletTemp, system-signal=SystemSignal_COM_Rx_HeaterCoreInletTemp}
        sender-receiver-to-signal-mapping={data-element=CPT_MDG1_FlatView.RP_COM_Rx_HYBRID_THERMAL_COMMAND.VD_COM_Rx_AirflowRequest, system-signal=SystemSignal_COM_Rx_AirflowRequest}
        sender-receiver-to-signal-mapping={data-element=CPT_MDG1_FlatView.RP_COM_Rx_HYBRID_THERMAL_COMMAND.VD_COM_Rx_LTR_PumpFlowRequest, system-signal=SystemSignal_COM_Rx_LTR_PumpFlowRequest}
        sender-receiver-to-signal-mapping={data-element=CPT_MDG1_FlatView.RP_COM_Rx_HYBRID_THERMAL_COMMAND.VD_COM_Rx_PECP2_PumpSpeedActual, system-signal=SystemSignal_COM_Rx_PECP2_PumpSpeedActual}
        sender-receiver-to-signal-mapping={data-element=CPT_MDG1_FlatView.RP_COM_Rx_HYBRID_THERMAL_COMMAND.VD_COM_Rx_PECP_PumpSpeedActual, system-signal=SystemSignal_COM_Rx_PECP_PumpSpeedActual}
        sender-receiver-to-signal-mapping={data-element=CPT_MDG1_FlatView.RP_COM_Rx_HYBRID_THERMAL_COMMAND.VD_COM_Rx_PE_CoolTempIn, system-signal=SystemSignal_COM_Rx_PE_CoolTempIn}
        sender-receiver-to-signal-mapping={data-element=CPT_MDG1_FlatView.RP_COM_Rx_HYBRID_THERMAL_COMMAND.VD_COM_Rx_PE_CoolTempOut, system-signal=SystemSignal_COM_Rx_PE_CoolTempOut}
        sender-receiver-to-signal-mapping={data-element=CPT_MDG1_FlatView.RP_COM_Rx_HYBRID_THERMAL_COMMAND.VD_COM_Rx_RadiatorFanSts, system-signal=SystemSignal_COM_Rx_RadiatorFanSts}
        sender-receiver-to-signal-mapping={data-element=CPT_MDG1_FlatView.RP_COM_Rx_IBS3_DATA_1.VD_COM_Rx_CRC_IBS3DATA1, system-signal=SystemSignal_COM_Rx_CRC_IBS3DATA1}
        sender-receiver-to-signal-mapping={data-element=CPT_MDG1_FlatView.RP_COM_Rx_IBS3_DATA_1.VD_COM_Rx_CurrBattFailStatus, system-signal=SystemSignal_COM_Rx_CurrBattFailStatus}
        sender-receiver-to-signal-mapping={data-element=CPT_MDG1_FlatView.RP_COM_Rx_IBS3_DATA_1.VD_COM_Rx_IBS3_Error_Internal, system-signal=SystemSignal_COM_Rx_IBS3_Error_Internal}
        sender-receiver-to-signal-mapping={data-element=CPT_MDG1_FlatView.RP_COM_Rx_IBS3_DATA_1.VD_COM_Rx_IBS3_Ibatt, system-signal=SystemSignal_COM_Rx_IBS3_Ibatt}
        sender-receiver-to-signal-mapping={data-element=CPT_MDG1_FlatView.RP_COM_Rx_IBS3_DATA_1.VD_COM_Rx_IBS3_SOF_VC, system-signal=SystemSignal_COM_Rx_IBS3_SOF_VC}
        sender-receiver-to-signal-mapping={data-element=CPT_MDG1_FlatView.RP_COM_Rx_IBS3_DATA_1.VD_COM_Rx_IBS3_SOF_V_Accuracy, system-signal=SystemSignal_COM_Rx_IBS3_SOF_V_Accuracy}
        sender-receiver-to-signal-mapping={data-element=CPT_MDG1_FlatView.RP_COM_Rx_IBS3_DATA_1.VD_COM_Rx_IBS3_Vbatt, system-signal=SystemSignal_COM_Rx_IBS3_Vbatt}
        sender-receiver-to-signal-mapping={data-element=CPT_MDG1_FlatView.RP_COM_Rx_IBS3_DATA_1.VD_COM_Rx_MessageCounter_IBS3DATA1, system-signal=SystemSignal_COM_Rx_MessageCounter_IBS3DATA1}
        sender-receiver-to-signal-mapping={data-element=CPT_MDG1_FlatView.RP_COM_Rx_IBS3_DATA_1.VD_COM_Rx_RsErrIBS3, system-signal=SystemSignal_COM_Rx_RsErrIBS3}
        sender-receiver-to-signal-mapping={data-element=CPT_MDG1_FlatView.RP_COM_Rx_IBS3_DATA_1.VD_COM_Rx_VoltBattFailStatus, system-signal=SystemSignal_COM_Rx_VoltBattFailStatus}
        sender-receiver-to-signal-mapping={data-element=CPT_MDG1_FlatView.RP_COM_Rx_IBS3_DATA_2.VD_COM_Rx_IBS3_FLAG_DISCONNECT, system-signal=SystemSignal_COM_Rx_IBS3_FLAG_DISCONNECT}
        sender-receiver-to-signal-mapping={data-element=CPT_MDG1_FlatView.RP_COM_Rx_IBS3_DATA_2.VD_COM_Rx_IBS3_SOC, system-signal=SystemSignal_COM_Rx_IBS3_SOC}
        sender-receiver-to-signal-mapping={data-element=CPT_MDG1_FlatView.RP_COM_Rx_IBS3_DATA_2.VD_COM_Rx_IBS3_SOC_Accuracy, system-signal=SystemSignal_COM_Rx_IBS3_SOC_Accuracy}
        sender-receiver-to-signal-mapping={data-element=CPT_MDG1_FlatView.RP_COM_Rx_IBS3_DATA_2.VD_COM_Rx_IBS3_SOH_Q, system-signal=SystemSignal_COM_Rx_IBS3_SOH_Q}
        sender-receiver-to-signal-mapping={data-element=CPT_MDG1_FlatView.RP_COM_Rx_IBS3_DATA_2.VD_COM_Rx_IBS3_SOH_Q_Accuracy, system-signal=SystemSignal_COM_Rx_IBS3_SOH_Q_Accuracy}
        sender-receiver-to-signal-mapping={data-element=CPT_MDG1_FlatView.RP_COM_Rx_IBS3_DATA_2.VD_COM_Rx_IBS3_T_BATT, system-signal=SystemSignal_COM_Rx_IBS3_T_BATT}
        sender-receiver-to-signal-mapping={data-element=CPT_MDG1_FlatView.RP_COM_Rx_IBS3_DATA_2.VD_COM_Rx_IBS3_TempFailStatus, system-signal=SystemSignal_COM_Rx_IBS3_TempFailStatus}
        sender-receiver-to-signal-group-mapping={data-element=CPT_MDG1_FlatView.RP_COM_Rx_IMMO_CODE_RESPONSE.VD_COM_Rx_IMMO_CODE_RESPONSE_Pkt, signal-group=SystemSignalGroup_COM_Rx_IMMO_CODE_RESPONSE_Pkt, type-mapping=sender-rec-record-type-mapping=record-element-mappings=[{application-record-element=ControlEncodingRsp, system-signal=SystemSignal_COM_Rx_ControlEncodingRsp}, {application-record-element=MKKey1org21, system-signal=SystemSignal_COM_Rx_MKKey1org21}, {application-record-element=MKKey2org22, system-signal=SystemSignal_COM_Rx_MKKey2org22}, {application-record-element=MKKey_3, system-signal=SystemSignal_COM_Rx_MKKey_3}, {application-record-element=MKKey_4, system-signal=SystemSignal_COM_Rx_MKKey_4}, {application-record-element=MKKey_5, system-signal=SystemSignal_COM_Rx_MKKey_5}, {application-record-element=MKKey_6, system-signal=SystemSignal_COM_Rx_MKKey_6}]}
        sender-receiver-to-signal-mapping={data-element=CPT_MDG1_FlatView.RP_COM_Rx_IMMO_SOP_REQUEST.VD_COM_Rx_IMMO_SOP_REQUEST, system-signal=SystemSignal_COM_Rx_IMMO_SOP_REQUEST}
        sender-receiver-to-signal-mapping={data-element=CPT_MDG1_FlatView.RP_COM_Rx_IMPACT_INFO.VD_COM_Rx_IMPACTCommand, system-signal=SystemSignal_COM_Rx_IMPACTCommand}
        sender-receiver-to-signal-mapping={data-element=CPT_MDG1_FlatView.RP_COM_Rx_IMPACT_INFO.VD_COM_Rx_IMPACTConfirm, system-signal=SystemSignal_COM_Rx_IMPACTConfirm}
        sender-receiver-to-signal-mapping={data-element=CPT_MDG1_FlatView.RP_COM_Rx_IMPACT_INFO.VD_COM_Rx_IMPACTThreshold, system-signal=SystemSignal_COM_Rx_IMPACTThreshold}
        sender-receiver-to-signal-mapping={data-element=CPT_MDG1_FlatView.RP_COM_Rx_IPC_FD_1.VD_COM_Rx_CRC_IPC1, system-signal=SystemSignal_COM_Rx_CRC_IPC1}
        sender-receiver-to-signal-mapping={data-element=CPT_MDG1_FlatView.RP_COM_Rx_IPC_FD_1.VD_COM_Rx_MessageCounter_IPC1, system-signal=SystemSignal_COM_Rx_MessageCounter_IPC1}
        sender-receiver-to-signal-mapping={data-element=CPT_MDG1_FlatView.RP_COM_Rx_IPC_FD_1.VD_COM_Rx_TotalOdometer, system-signal=SystemSignal_COM_Rx_TotalOdometer}
        sender-receiver-to-signal-mapping={data-element=CPT_MDG1_FlatView.RP_COM_Rx_IPC_FD_1.VD_COM_Rx_WTS_LmpRqOn, system-signal=SystemSignal_COM_Rx_WTS_LmpRqOn}
        sender-receiver-to-signal-mapping={data-element=CPT_MDG1_FlatView.RP_COM_Rx_IPC_FD_4.VD_COM_Rx_CFG_Manual_DPF, system-signal=SystemSignal_COM_Rx_CFG_Manual_DPF}
        sender-receiver-to-signal-mapping={data-element=CPT_MDG1_FlatView.RP_COM_Rx_IPC_FD_4.VD_COM_Rx_DisplayedSpeedLimSts, system-signal=SystemSignal_COM_Rx_DisplayedSpeedLimSts}
        sender-receiver-to-signal-mapping={data-element=CPT_MDG1_FlatView.RP_COM_Rx_IPC_FD_4.VD_COM_Rx_FuelFltrRst, system-signal=SystemSignal_COM_Rx_FuelFltrRst}
        sender-receiver-to-signal-mapping={data-element=CPT_MDG1_FlatView.RP_COM_Rx_IPC_FD_4.VD_COM_Rx_OilChgRst, system-signal=SystemSignal_COM_Rx_OilChgRst}
        sender-receiver-to-signal-mapping={data-element=CPT_MDG1_FlatView.RP_COM_Rx_IPC_VEHICLE_SETUP.VD_COM_Rx_Dist_Unit, system-signal=SystemSignal_COM_Rx_Dist_Unit}
        sender-receiver-to-signal-mapping={data-element=CPT_MDG1_FlatView.RP_COM_Rx_IPC_VEHICLE_SETUP.VD_COM_Rx_New_Spd_Zone_Ind, system-signal=SystemSignal_COM_Rx_New_Spd_Zone_Ind}
        sender-receiver-to-signal-mapping={data-element=CPT_MDG1_FlatView.RP_COM_Rx_IPC_VEHICLE_SETUP.VD_COM_Rx_Speed_Unit, system-signal=SystemSignal_COM_Rx_Speed_Unit}
        sender-receiver-to-signal-mapping={data-element=CPT_MDG1_FlatView.RP_COM_Rx_IPC_VEHICLE_SETUP.VD_COM_Rx_Traffic_Sign_Info, system-signal=SystemSignal_COM_Rx_Traffic_Sign_Info}
        sender-receiver-to-signal-mapping={data-element=CPT_MDG1_FlatView.RP_COM_Rx_PT_SYSTEM_FD_1_FD3.VD_COM_Rx_APCM_Rq_PT_FD3, system-signal=SystemSignal_COM_Rx_APCM_Rq_PT_FD3}
        sender-receiver-to-signal-mapping={data-element=CPT_MDG1_FlatView.RP_COM_Rx_PT_SYSTEM_FD_1_FD3.VD_COM_Rx_AWD_Status_PT_FD3, system-signal=SystemSignal_COM_Rx_AWD_Status_PT_FD3}
        sender-receiver-to-signal-mapping={data-element=CPT_MDG1_FlatView.RP_COM_Rx_PT_SYSTEM_FD_1_FD3.VD_COM_Rx_AlternatorFail_PT_FD3, system-signal=SystemSignal_COM_Rx_AlternatorFail_PT_FD3}
        sender-receiver-to-signal-mapping={data-element=CPT_MDG1_FlatView.RP_COM_Rx_PT_SYSTEM_FD_1_FD3.VD_COM_Rx_AtmosphericPressure_PT_FD3, system-signal=SystemSignal_COM_Rx_AtmosphericPressure_PT_FD3}
        sender-receiver-to-signal-mapping={data-element=CPT_MDG1_FlatView.RP_COM_Rx_PT_SYSTEM_FD_1_FD3.VD_COM_Rx_CRC_PT_SYSTEM_FD_1_FD3, system-signal=SystemSignal_COM_Rx_CRC_PT_SYSTEM_FD_1_FD3}
        sender-receiver-to-signal-mapping={data-element=CPT_MDG1_FlatView.RP_COM_Rx_PT_SYSTEM_FD_1_FD3.VD_COM_Rx_CrankEnable_PT_FD3, system-signal=SystemSignal_COM_Rx_CrankEnable_PT_FD3}
        sender-receiver-to-signal-mapping={data-element=CPT_MDG1_FlatView.RP_COM_Rx_PT_SYSTEM_FD_1_FD3.VD_COM_Rx_DriveReady_PT_FD3, system-signal=SystemSignal_COM_Rx_DriveReady_PT_FD3}
        sender-receiver-to-signal-mapping={data-element=CPT_MDG1_FlatView.RP_COM_Rx_PT_SYSTEM_FD_1_FD3.VD_COM_Rx_DriverPowerReq_PT_FD3, system-signal=SystemSignal_COM_Rx_DriverPowerReq_PT_FD3}
        sender-receiver-to-signal-mapping={data-element=CPT_MDG1_FlatView.RP_COM_Rx_PT_SYSTEM_FD_1_FD3.VD_COM_Rx_DrvAway_Alert_PT_FD3, system-signal=SystemSignal_COM_Rx_DrvAway_Alert_PT_FD3}
        sender-receiver-to-signal-mapping={data-element=CPT_MDG1_FlatView.RP_COM_Rx_PT_SYSTEM_FD_1_FD3.VD_COM_Rx_DrvAway_Inhibit_PT_FD3, system-signal=SystemSignal_COM_Rx_DrvAway_Inhibit_PT_FD3}
        sender-receiver-to-signal-mapping={data-element=CPT_MDG1_FlatView.RP_COM_Rx_PT_SYSTEM_FD_1_FD3.VD_COM_Rx_ESS_RqShftPark_PT_FD3, system-signal=SystemSignal_COM_Rx_ESS_RqShftPark_PT_FD3}
        sender-receiver-to-signal-mapping={data-element=CPT_MDG1_FlatView.RP_COM_Rx_PT_SYSTEM_FD_1_FD3.VD_COM_Rx_EVCU2_THA_Resp_FD3, system-signal=SystemSignal_COM_Rx_EVCU2_THA_Resp_FD3}
        sender-receiver-to-signal-mapping={data-element=CPT_MDG1_FlatView.RP_COM_Rx_PT_SYSTEM_FD_1_FD3.VD_COM_Rx_GasPedalPositionFailSts_PT_FD3, system-signal=SystemSignal_COM_Rx_GasPedalPositionFailSts_PT_FD3}
        sender-receiver-to-signal-mapping={data-element=CPT_MDG1_FlatView.RP_COM_Rx_PT_SYSTEM_FD_1_FD3.VD_COM_Rx_GasPedalPosition_PT_FD3, system-signal=SystemSignal_COM_Rx_GasPedalPosition_PT_FD3}
        sender-receiver-to-signal-mapping={data-element=CPT_MDG1_FlatView.RP_COM_Rx_PT_SYSTEM_FD_1_FD3.VD_COM_Rx_GearEngagedForDisplay_PT_FD3, system-signal=SystemSignal_COM_Rx_GearEngagedForDisplay_PT_FD3}
        sender-receiver-to-signal-mapping={data-element=CPT_MDG1_FlatView.RP_COM_Rx_PT_SYSTEM_FD_1_FD3.VD_COM_Rx_GearEngaged_PT_FD3, system-signal=SystemSignal_COM_Rx_GearEngaged_PT_FD3}
        sender-receiver-to-signal-mapping={data-element=CPT_MDG1_FlatView.RP_COM_Rx_PT_SYSTEM_FD_1_FD3.VD_COM_Rx_GearIndicationSts_PT_FD3, system-signal=SystemSignal_COM_Rx_GearIndicationSts_PT_FD3}
        sender-receiver-to-signal-mapping={data-element=CPT_MDG1_FlatView.RP_COM_Rx_PT_SYSTEM_FD_1_FD3.VD_COM_Rx_HAS_SoH_PT_FD3, system-signal=SystemSignal_COM_Rx_HAS_SoH_PT_FD3}
        sender-receiver-to-signal-mapping={data-element=CPT_MDG1_FlatView.RP_COM_Rx_PT_SYSTEM_FD_1_FD3.VD_COM_Rx_MessageCounter_PT_SYSTEM_FD_1FD3, system-signal=SystemSignal_COM_Rx_MessageCounter_PT_SYSTEM_FD_1FD3}
        sender-receiver-to-signal-mapping={data-element=CPT_MDG1_FlatView.RP_COM_Rx_PT_SYSTEM_FD_1_FD3.VD_COM_Rx_ParkingFailSts_PT_FD3, system-signal=SystemSignal_COM_Rx_ParkingFailSts_PT_FD3}
        sender-receiver-to-signal-mapping={data-element=CPT_MDG1_FlatView.RP_COM_Rx_PT_SYSTEM_FD_1_FD3.VD_COM_Rx_ParkingSts_PT_FD3, system-signal=SystemSignal_COM_Rx_ParkingSts_PT_FD3}
        sender-receiver-to-signal-mapping={data-element=CPT_MDG1_FlatView.RP_COM_Rx_PT_SYSTEM_FD_1_FD3.VD_COM_Rx_PdlPosActual_PT_FD3, system-signal=SystemSignal_COM_Rx_PdlPosActual_PT_FD3}
        sender-receiver-to-signal-mapping={data-element=CPT_MDG1_FlatView.RP_COM_Rx_PT_SYSTEM_FD_1_FD3.VD_COM_Rx_PowertrainPrplsnActv_PT_FD3, system-signal=SystemSignal_COM_Rx_PowertrainPrplsnActv_PT_FD3}
        sender-receiver-to-signal-mapping={data-element=CPT_MDG1_FlatView.RP_COM_Rx_PT_SYSTEM_FD_1_FD3.VD_COM_Rx_R_SHFT_LOCK_PT_FD3, system-signal=SystemSignal_COM_Rx_R_SHFT_LOCK_PT_FD3}
        sender-receiver-to-signal-mapping={data-element=CPT_MDG1_FlatView.RP_COM_Rx_PT_SYSTEM_FD_1_FD3.VD_COM_Rx_RawPVS1_PT_FD3, system-signal=SystemSignal_COM_Rx_RawPVS1_PT_FD3}
        sender-receiver-to-signal-mapping={data-element=CPT_MDG1_FlatView.RP_COM_Rx_PT_SYSTEM_FD_1_FD3.VD_COM_Rx_RawPVS2_PT_FD3, system-signal=SystemSignal_COM_Rx_RawPVS2_PT_FD3}
        sender-receiver-to-signal-mapping={data-element=CPT_MDG1_FlatView.RP_COM_Rx_PT_SYSTEM_FD_1_FD3.VD_COM_Rx_ShiftLeverLockReq_PT_FD3, system-signal=SystemSignal_COM_Rx_ShiftLeverLockReq_PT_FD3}
        sender-receiver-to-signal-mapping={data-element=CPT_MDG1_FlatView.RP_COM_Rx_PT_SYSTEM_FD_1_FD3.VD_COM_Rx_ShiftLeverPosition_PT_FD3, system-signal=SystemSignal_COM_Rx_ShiftLeverPosition_PT_FD3}
        sender-receiver-to-signal-mapping={data-element=CPT_MDG1_FlatView.RP_COM_Rx_PT_SYSTEM_FD_1_FD3.VD_COM_Rx_TargetGear_PT_FD3, system-signal=SystemSignal_COM_Rx_TargetGear_PT_FD3}
        sender-receiver-to-signal-mapping={data-element=CPT_MDG1_FlatView.RP_COM_Rx_PT_SYSTEM_FD_1_FD3.VD_COM_Rx_TerrainModeStat_PT_FD3, system-signal=SystemSignal_COM_Rx_TerrainModeStat_PT_FD3}
        sender-receiver-to-signal-mapping={data-element=CPT_MDG1_FlatView.RP_COM_Rx_PT_SYSTEM_FD_1_FD3.VD_COM_Rx_TransmissionFailSts_PT_FD3, system-signal=SystemSignal_COM_Rx_TransmissionFailSts_PT_FD3}
        sender-receiver-to-signal-mapping={data-element=CPT_MDG1_FlatView.RP_COM_Rx_PT_SYSTEM_FD_1_FD3.VD_COM_Rx_TransmissionWarnings_PT_FD3, system-signal=SystemSignal_COM_Rx_TransmissionWarnings_PT_FD3}
        sender-receiver-to-signal-mapping={data-element=CPT_MDG1_FlatView.RP_COM_Rx_PT_SYSTEM_FD_1_FD3.VD_COM_Rx_TurtleModeSts_PT_FD3, system-signal=SystemSignal_COM_Rx_TurtleModeSts_PT_FD3}
        sender-receiver-to-signal-mapping={data-element=CPT_MDG1_FlatView.RP_COM_Rx_PT_SYSTEM_FD_1_FD3.VD_COM_Rx_VehSpd_Overridden_PT_FD3, system-signal=SystemSignal_COM_Rx_VehSpd_Overridden_PT_FD3}
        sender-receiver-to-signal-mapping={data-element=CPT_MDG1_FlatView.RP_COM_Rx_PT_SYSTEM_FD_1_FD3.VD_COM_Rx_Warn_BTO_PT_FD3, system-signal=SystemSignal_COM_Rx_Warn_BTO_PT_FD3}
        sender-receiver-to-signal-mapping={data-element=CPT_MDG1_FlatView.RP_COM_Rx_RFHUB_FD_1.VD_COM_Rx_IgnPosSts, system-signal=SystemSignal_COM_Rx_IgnPosSts}
        sender-receiver-to-signal-mapping={data-element=CPT_MDG1_FlatView.RP_COM_Rx_STEERING1.VD_COM_Rx_LwsAngle_SCCM, system-signal=SystemSignal_COM_Rx_LwsAngle_SCCM}
        sender-receiver-to-signal-mapping={data-element=CPT_MDG1_FlatView.RP_COM_Rx_STEERING1.VD_COM_Rx_LwsSpeed_SCCM, system-signal=SystemSignal_COM_Rx_LwsSpeed_SCCM}
        sender-receiver-to-signal-mapping={data-element=CPT_MDG1_FlatView.RP_COM_Rx_TELEMATIC_FD_1.VD_COM_Rx_Day1_TLM, system-signal=SystemSignal_COM_Rx_Day1_TLM}
        sender-receiver-to-signal-mapping={data-element=CPT_MDG1_FlatView.RP_COM_Rx_TELEMATIC_FD_1.VD_COM_Rx_Day2_TLM, system-signal=SystemSignal_COM_Rx_Day2_TLM}
        sender-receiver-to-signal-mapping={data-element=CPT_MDG1_FlatView.RP_COM_Rx_TELEMATIC_FD_1.VD_COM_Rx_Hour1_TLM, system-signal=SystemSignal_COM_Rx_Hour1_TLM}
        sender-receiver-to-signal-mapping={data-element=CPT_MDG1_FlatView.RP_COM_Rx_TELEMATIC_FD_1.VD_COM_Rx_Hour2_TLM, system-signal=SystemSignal_COM_Rx_Hour2_TLM}
        sender-receiver-to-signal-mapping={data-element=CPT_MDG1_FlatView.RP_COM_Rx_TELEMATIC_FD_1.VD_COM_Rx_Minute1_TLM, system-signal=SystemSignal_COM_Rx_Minute1_TLM}
        sender-receiver-to-signal-mapping={data-element=CPT_MDG1_FlatView.RP_COM_Rx_TELEMATIC_FD_1.VD_COM_Rx_Minute2_TLM, system-signal=SystemSignal_COM_Rx_Minute2_TLM}
        sender-receiver-to-signal-mapping={data-element=CPT_MDG1_FlatView.RP_COM_Rx_TELEMATIC_FD_1.VD_COM_Rx_Month1_TLM, system-signal=SystemSignal_COM_Rx_Month1_TLM}
        sender-receiver-to-signal-mapping={data-element=CPT_MDG1_FlatView.RP_COM_Rx_TELEMATIC_FD_1.VD_COM_Rx_Month2_TLM, system-signal=SystemSignal_COM_Rx_Month2_TLM}
        sender-receiver-to-signal-mapping={data-element=CPT_MDG1_FlatView.RP_COM_Rx_TELEMATIC_FD_1.VD_COM_Rx_Year{1..4}_TLM, system-signal=SystemSignal_COM_Rx_Year{1..4}_TLM}
        sender-receiver-to-signal-mapping={data-element=CPT_MDG1_FlatView.RP_COM_Rx_TELEMATIC_FD_11.VD_COM_Rx_Launch_RPM_Selected_Setting2, system-signal=SystemSignal_COM_Rx_Launch_RPM_Selected_Setting2}
        sender-receiver-to-signal-mapping={data-element=CPT_MDG1_FlatView.RP_COM_Rx_TELEMATIC_FD_11.VD_COM_Rx_Launch_Sft_Btn_status, system-signal=SystemSignal_COM_Rx_Launch_Sft_Btn_status}
        sender-receiver-to-signal-mapping={data-element=CPT_MDG1_FlatView.RP_COM_Rx_TELEMATIC_FD_14.VD_COM_Rx_PSI_Gr{1..5}_RPM_SET, system-signal=SystemSignal_COM_Rx_PSI_Gr{1..5}_RPM_SET}
        sender-receiver-to-signal-mapping={data-element=CPT_MDG1_FlatView.RP_COM_Rx_TELEMATIC_FD_14.VD_COM_Rx_PSI_RPM_Reset, system-signal=SystemSignal_COM_Rx_PSI_RPM_Reset}
        sender-receiver-to-signal-mapping={data-element=CPT_MDG1_FlatView.RP_COM_Rx_TELEMATIC_FD_14.VD_COM_Rx_PSI_Rq, system-signal=SystemSignal_COM_Rx_PSI_Rq}
        sender-receiver-to-signal-mapping={data-element=CPT_MDG1_FlatView.RP_COM_Rx_TELEMATIC_FD_14.VD_COM_Rx_RACE_CLDWN_ON_OFF_REQ, system-signal=SystemSignal_COM_Rx_RACE_CLDWN_ON_OFF_REQ}
        sender-receiver-to-signal-mapping={data-element=CPT_MDG1_FlatView.RP_COM_Rx_TELEMATIC_FD_5.VD_COM_Rx_GlobDrvMdRq, system-signal=SystemSignal_COM_Rx_GlobDrvMdRq}
        sender-receiver-to-signal-mapping={data-element=CPT_MDG1_FlatView.RP_COM_Rx_VSIM_FD_1.VD_COM_Rx_IdleShutDown_Disable, system-signal=SystemSignal_COM_Rx_IdleShutDown_Disable}
        sender-receiver-to-signal-mapping={data-element=CPT_MDG1_FlatView.RP_COM_Rx_VSIM_FD_1.VD_COM_Rx_J1939_RPM_RQ, system-signal=SystemSignal_COM_Rx_J1939_RPM_RQ}
        sender-receiver-to-signal-mapping={data-element=CPT_MDG1_FlatView.RP_COM_Rx_VSIM_FD_1.VD_COM_Rx_PTO_IdleSpd{1..3}, system-signal=SystemSignal_COM_Rx_PTO_IdleSpd{1..3}}
        sender-receiver-to-signal-mapping={data-element=CPT_MDG1_FlatView.RP_COM_Rx_VSIM_FD_1.VD_COM_Rx_PosEngdSwStat, system-signal=SystemSignal_COM_Rx_PosEngdSwStat}
        sender-receiver-to-signal-mapping={data-element=CPT_MDG1_FlatView.PP_COM_Tx_ENGINE_FD_1_FD3.VD_COM_Tx_ACPressureFailSts_FD3, system-signal=SystemSignal_COM_Tx_ACPressureFailSts_FD3}
        sender-receiver-to-signal-mapping={data-element=CPT_MDG1_FlatView.PP_COM_Tx_ENGINE_FD_1_FD3.VD_COM_Tx_ACPressure_FD3, system-signal=SystemSignal_COM_Tx_ACPressure_FD3}
        sender-receiver-to-signal-mapping={data-element=CPT_MDG1_FlatView.PP_COM_Tx_ENGINE_FD_1_FD3.VD_COM_Tx_AGS2Posn_FD3, system-signal=SystemSignal_COM_Tx_AGS2Posn_FD3}
        sender-receiver-to-signal-mapping={data-element=CPT_MDG1_FlatView.PP_COM_Tx_ENGINE_FD_1_FD3.VD_COM_Tx_AtmosphericPressureFailSts_W_FD3, system-signal=SystemSignal_COM_Tx_AtmosphericPressureFailSts_W_FD3}
        sender-receiver-to-signal-mapping={data-element=CPT_MDG1_FlatView.PP_COM_Tx_ENGINE_FD_1_FD3.VD_COM_Tx_AtmosphericPressure_W_FD3, system-signal=SystemSignal_COM_Tx_AtmosphericPressure_W_FD3}
        sender-receiver-to-signal-mapping={data-element=CPT_MDG1_FlatView.PP_COM_Tx_ENGINE_FD_1_FD3.VD_COM_Tx_BoostVacGauge_FD3, system-signal=SystemSignal_COM_Tx_BoostVacGauge_FD3}
        sender-receiver-to-signal-mapping={data-element=CPT_MDG1_FlatView.PP_COM_Tx_ENGINE_FD_1_FD3.VD_COM_Tx_BrkSw1Stat_FD3, system-signal=SystemSignal_COM_Tx_BrkSw1Stat_FD3}
        sender-receiver-to-signal-mapping={data-element=CPT_MDG1_FlatView.PP_COM_Tx_ENGINE_FD_1_FD3.VD_COM_Tx_BrkSw2Stat_FD3, system-signal=SystemSignal_COM_Tx_BrkSw2Stat_FD3}
        sender-receiver-to-signal-mapping={data-element=CPT_MDG1_FlatView.PP_COM_Tx_ENGINE_FD_1_FD3.VD_COM_Tx_CRC_ENGINE1_FD3, system-signal=SystemSignal_COM_Tx_CRC_ENGINE1_FD3}
        sender-receiver-to-signal-mapping={data-element=CPT_MDG1_FlatView.PP_COM_Tx_ENGINE_FD_1_FD3.VD_COM_Tx_ESP_TrqRqEnabl_FD3, system-signal=SystemSignal_COM_Tx_ESP_TrqRqEnabl_FD3}
        sender-receiver-to-signal-mapping={data-element=CPT_MDG1_FlatView.PP_COM_Tx_ENGINE_FD_1_FD3.VD_COM_Tx_EngMaxRPM_W_FD3, system-signal=SystemSignal_COM_Tx_EngMaxRPM_W_FD3}
        sender-receiver-to-signal-mapping={data-element=CPT_MDG1_FlatView.PP_COM_Tx_ENGINE_FD_1_FD3.VD_COM_Tx_HighPressureFuelSystemFailureFD3, system-signal=SystemSignal_COM_Tx_HighPressureFuelSystemFailureFD3}
        sender-receiver-to-signal-mapping={data-element=CPT_MDG1_FlatView.PP_COM_Tx_ENGINE_FD_1_FD3.VD_COM_Tx_Lv1CrsCtrlOff_FD3, system-signal=SystemSignal_COM_Tx_Lv1CrsCtrlOff_FD3}
        sender-receiver-to-signal-mapping={data-element=CPT_MDG1_FlatView.PP_COM_Tx_ENGINE_FD_1_FD3.VD_COM_Tx_MessageCounter_ENGINE1_FD3, system-signal=SystemSignal_COM_Tx_MessageCounter_ENGINE1_FD3}
        sender-receiver-to-signal-mapping={data-element=CPT_MDG1_FlatView.PP_COM_Tx_ENGINE_FD_1_FD3.VD_COM_Tx_RawPVS1_FD3, system-signal=SystemSignal_COM_Tx_RawPVS1_FD3}
        sender-receiver-to-signal-mapping={data-element=CPT_MDG1_FlatView.PP_COM_Tx_ENGINE_FD_1_FD3.VD_COM_Tx_RawPVS2_FD3, system-signal=SystemSignal_COM_Tx_RawPVS2_FD3}
        sender-receiver-to-signal-mapping={data-element=CPT_MDG1_FlatView.PP_COM_Tx_ENGINE_FD_1_FD3.VD_COM_Tx_RawTPS1_FD3, system-signal=SystemSignal_COM_Tx_RawTPS1_FD3}
        sender-receiver-to-signal-mapping={data-element=CPT_MDG1_FlatView.PP_COM_Tx_ENGINE_FD_1_FD3.VD_COM_Tx_RawTPS2_FD3, system-signal=SystemSignal_COM_Tx_RawTPS2_FD3}
        sender-receiver-to-signal-mapping={data-element=CPT_MDG1_FlatView.PP_COM_Tx_ENGINE_FD_1_FD3.VD_COM_Tx_ThermalManagementActive_W_FD3, system-signal=SystemSignal_COM_Tx_ThermalManagementActive_W_FD3}
        sender-receiver-to-signal-mapping={data-element=CPT_MDG1_FlatView.PP_COM_Tx_ENGINE_FD_1_FD3.VD_COM_Tx_ThrottlePosition_FD3, system-signal=SystemSignal_COM_Tx_ThrottlePosition_FD3}
        sender-receiver-to-signal-mapping={data-element=CPT_MDG1_FlatView.PP_COM_Tx_ENGINE_FD_1_FD3.VD_COM_Tx_TransWarmUpMin_RPM_FD3, system-signal=SystemSignal_COM_Tx_TransWarmUpMin_RPM_FD3}
        sender-receiver-to-signal-mapping={data-element=CPT_MDG1_FlatView.PP_COM_Tx_ENGINE_FD_1_FD3.VD_COM_Tx_TransWarmUpReq_FD3, system-signal=SystemSignal_COM_Tx_TransWarmUpReq_FD3}
        sender-receiver-to-signal-mapping={data-element=CPT_MDG1_FlatView.PP_COM_Tx_ENGINE_FD_1_FD3.VD_COM_Tx_VehicleSetSpeed_W_FD3, system-signal=SystemSignal_COM_Tx_VehicleSetSpeed_W_FD3}
        sender-receiver-to-signal-mapping={data-element=CPT_MDG1_FlatView.PP_COM_Tx_ENGINE_FD_3_FD3.VD_COM_Tx_CRC_ENGINE3_FD3, system-signal=SystemSignal_COM_Tx_CRC_ENGINE3_FD3}
        sender-receiver-to-signal-mapping={data-element=CPT_MDG1_FlatView.PP_COM_Tx_ENGINE_FD_3_FD3.VD_COM_Tx_MessageCounter_ENGINE3_FD3, system-signal=SystemSignal_COM_Tx_MessageCounter_ENGINE3_FD3}
        sender-receiver-to-signal-group-mapping={data-element=CPT_MDG1_FlatView.PP_COM_Tx_ENGINE_FD_3_FD3.VD_COM_Tx_ENGINE_FD_3_FD, signal-group=SystemSignalGroup_COM_Tx_ENGINE_FD_3_FD, type-mapping=sender-rec-record-type-mapping=record-element-mappings=[{application-record-element=AfterRunCoolantPumpFailSts_FD3, system-signal=SystemSignal_COM_Tx_AfterRunCoolantPumpFailSts_FD3}, {application-record-element=AxleInAir_Stat_FD3, system-signal=SystemSignal_COM_Tx_AxleInAir_Stat_FD3}, {application-record-element=CC_SetSpdDspl_KPH_FD3, system-signal=SystemSignal_COM_Tx_CC_SetSpdDspl_KPH_FD3}, {application-record-element=CC_SetSpdDspl_MPH_FD3, system-signal=SystemSignal_COM_Tx_CC_SetSpdDspl_MPH_FD3}, {application-record-element=CoolVlvPos_FD3, system-signal=SystemSignal_COM_Tx_CoolVlvPos_FD3}, {application-record-element=CruiseControlLampSts_FD3, system-signal=SystemSignal_COM_Tx_CruiseControlLampSts_FD3}, {application-record-element=CruiseControlSts_FD3, system-signal=SystemSignal_COM_Tx_CruiseControlSts_FD3}, {application-record-element=DefFuelEcon_FD3, system-signal=SystemSignal_COM_Tx_DefFuelEcon_FD3}, {application-record-element=DistOilLifeRst_FD3, system-signal=SystemSignal_COM_Tx_DistOilLifeRst_FD3}, {application-record-element=ECM_Thermal_AAD_Request_FD3, system-signal=SystemSignal_COM_Tx_ECM_Thermal_AAD_Request_FD3}, {application-record-element=EngineOilCritical_FD3, system-signal=SystemSignal_COM_Tx_EngineOilCritical_FD3}, {application-record-element=EngineOilLevel_FD3, system-signal=SystemSignal_COM_Tx_EngineOilLevel_FD3}, {application-record-element=EngineOilMin_FD3, system-signal=SystemSignal_COM_Tx_EngineOilMin_FD3}, {application-record-element=EngineOilOverfill_FD3, system-signal=SystemSignal_COM_Tx_EngineOilOverfill_FD3}, {application-record-element=EngineOilTemperature_FD3, system-signal=SystemSignal_COM_Tx_EngineOilTemperature_FD3}, {application-record-element=FANStatus_FD3, system-signal=SystemSignal_COM_Tx_FANStatus_FD3}, {application-record-element=ISASts_FD3, system-signal=SystemSignal_COM_Tx_ISASts_FD3}, {application-record-element=OIL_IND_LMP_FLSH_FD3, system-signal=SystemSignal_COM_Tx_OIL_IND_LMP_FLSH_FD3}, {application-record-element=OIL_TEMP_CHM_RQ_FD3, system-signal=SystemSignal_COM_Tx_OIL_TEMP_CHM_RQ_FD3}, {application-record-element=OIL_TEMP_IND_RQ_FD3, system-signal=SystemSignal_COM_Tx_OIL_TEMP_IND_RQ_FD3}, {application-record-element=OilLifeLeftRst_FD3, system-signal=SystemSignal_COM_Tx_OilLifeLeftRst_FD3}, {application-record-element=OilLifeLeft_FD3, system-signal=SystemSignal_COM_Tx_OilLifeLeft_FD3}, {application-record-element=Override_FD3, system-signal=SystemSignal_COM_Tx_Override_FD3}, {application-record-element=PT_WorkSite_Invtr_Capacity_ECM, system-signal=SystemSignal_COM_Tx_PT_WorkSite_Invtr_Capacity_ECM}, {application-record-element=PT_WorkSite_Invtr_Sts_ECM_FD3, system-signal=SystemSignal_COM_Tx_PT_WorkSite_Invtr_Sts_ECM_FD3}, {application-record-element=SpeedLimitSts_FD3, system-signal=SystemSignal_COM_Tx_SpeedLimitSts_FD3}]}
        sender-receiver-to-signal-mapping={data-element=CPT_MDG1_FlatView.PP_COM_Tx_ENGINE_FD_6.VD_COM_Tx_CRC_ENGINE6, system-signal=SystemSignal_COM_Tx_CRC_ENGINE6}
        sender-receiver-to-signal-mapping={data-element=CPT_MDG1_FlatView.PP_COM_Tx_ENGINE_FD_6.VD_COM_Tx_DrvAway_Alert, system-signal=SystemSignal_COM_Tx_DrvAway_Alert}
        sender-receiver-to-signal-mapping={data-element=CPT_MDG1_FlatView.PP_COM_Tx_ENGINE_FD_6.VD_COM_Tx_DrvAway_Indications, system-signal=SystemSignal_COM_Tx_DrvAway_Indications}
        sender-receiver-to-signal-mapping={data-element=CPT_MDG1_FlatView.PP_COM_Tx_ENGINE_FD_6.VD_COM_Tx_DrvAway_Inhibit, system-signal=SystemSignal_COM_Tx_DrvAway_Inhibit}
        sender-receiver-to-signal-mapping={data-element=CPT_MDG1_FlatView.PP_COM_Tx_ENGINE_FD_6.VD_COM_Tx_ECM_FOTA_Conflict, system-signal=SystemSignal_COM_Tx_ECM_FOTA_Conflict}
        sender-receiver-to-signal-mapping={data-element=CPT_MDG1_FlatView.PP_COM_Tx_ENGINE_FD_6.VD_COM_Tx_ECM_MSG_RQ, system-signal=SystemSignal_COM_Tx_ECM_MSG_RQ}
        sender-receiver-to-signal-mapping={data-element=CPT_MDG1_FlatView.PP_COM_Tx_ENGINE_FD_6.VD_COM_Tx_EngineWaterTemp, system-signal=SystemSignal_COM_Tx_EngineWaterTemp}
        sender-receiver-to-signal-mapping={data-element=CPT_MDG1_FlatView.PP_COM_Tx_ENGINE_FD_6.VD_COM_Tx_FuelConsumption_GAG, system-signal=SystemSignal_COM_Tx_FuelConsumption_GAG}
        sender-receiver-to-signal-mapping={data-element=CPT_MDG1_FlatView.PP_COM_Tx_ENGINE_FD_6.VD_COM_Tx_GearShiftIndication, system-signal=SystemSignal_COM_Tx_GearShiftIndication}
        sender-receiver-to-signal-mapping={data-element=CPT_MDG1_FlatView.PP_COM_Tx_ENGINE_FD_6.VD_COM_Tx_HP_MODE_STS, system-signal=SystemSignal_COM_Tx_HP_MODE_STS}
        sender-receiver-to-signal-mapping={data-element=CPT_MDG1_FlatView.PP_COM_Tx_ENGINE_FD_6.VD_COM_Tx_LeakCheckTimerValue, system-signal=SystemSignal_COM_Tx_LeakCheckTimerValue}
        sender-receiver-to-signal-mapping={data-element=CPT_MDG1_FlatView.PP_COM_Tx_ENGINE_FD_6.VD_COM_Tx_LeakTestRequest, system-signal=SystemSignal_COM_Tx_LeakTestRequest}
        sender-receiver-to-signal-mapping={data-element=CPT_MDG1_FlatView.PP_COM_Tx_ENGINE_FD_6.VD_COM_Tx_LeakTestSts, system-signal=SystemSignal_COM_Tx_LeakTestSts}
        sender-receiver-to-signal-mapping={data-element=CPT_MDG1_FlatView.PP_COM_Tx_ENGINE_FD_6.VD_COM_Tx_MessageCounter_ENGINE6, system-signal=SystemSignal_COM_Tx_MessageCounter_ENGINE6}
        sender-receiver-to-signal-mapping={data-element=CPT_MDG1_FlatView.PP_COM_Tx_ENGINE_FD_6.VD_COM_Tx_SAMInfo, system-signal=SystemSignal_COM_Tx_SAMInfo}
        sender-receiver-to-signal-mapping={data-element=CPT_MDG1_FlatView.PP_COM_Tx_ENGINE_FD_6.VD_COM_Tx_Selector_SystemFailSts, system-signal=SystemSignal_COM_Tx_Selector_SystemFailSts}
        sender-receiver-to-signal-mapping={data-element=CPT_MDG1_FlatView.PP_COM_Tx_ENGINE_FD_6.VD_COM_Tx_StartProtectionInhibit, system-signal=SystemSignal_COM_Tx_StartProtectionInhibit}
        sender-receiver-to-signal-mapping={data-element=CPT_MDG1_FlatView.PP_COM_Tx_ENGINE_FD_6.VD_COM_Tx_StartRelayBCMFeedbackFault, system-signal=SystemSignal_COM_Tx_StartRelayBCMFeedbackFault}
        sender-receiver-to-signal-mapping={data-element=CPT_MDG1_FlatView.PP_COM_Tx_ENGINE_FD_6.VD_COM_Tx_StartRelayECMFeedbackFault, system-signal=SystemSignal_COM_Tx_StartRelayECMFeedbackFault}
        sender-receiver-to-signal-mapping={data-element=CPT_MDG1_FlatView.PP_COM_Tx_ENGINE_FD_6.VD_COM_Tx_StarterProtectionTime, system-signal=SystemSignal_COM_Tx_StarterProtectionTime}
        sender-receiver-to-signal-mapping={data-element=CPT_MDG1_FlatView.PP_COM_Tx_ENGINE_FD_6.VD_COM_Tx_TerrainModeDesiredStat, system-signal=SystemSignal_COM_Tx_TerrainModeDesiredStat}
        sender-receiver-to-signal-mapping={data-element=CPT_MDG1_FlatView.PP_COM_Tx_ENGINE_FD_6.VD_COM_Tx_TerrainModeInterfaceButton_ECM, system-signal=SystemSignal_COM_Tx_TerrainModeInterfaceButton_ECM}
        sender-receiver-to-signal-mapping={data-element=CPT_MDG1_FlatView.PP_COM_Tx_ENGINE_FD_6.VD_COM_Tx_TerrainModeStat_ECM, system-signal=SystemSignal_COM_Tx_TerrainModeStat_ECM}
        sender-receiver-to-signal-mapping={data-element=CPT_MDG1_FlatView.PP_COM_Tx_ENGINE_FD_6.VD_COM_Tx_Terrain_HMI_Rq_ECM, system-signal=SystemSignal_COM_Tx_Terrain_HMI_Rq_ECM}
        sender-receiver-to-signal-mapping={data-element=CPT_MDG1_FlatView.PP_COM_Tx_ENGINE_FD_6.VD_COM_Tx_Trns_DrvMdReq_ECM, system-signal=SystemSignal_COM_Tx_Trns_DrvMdReq_ECM}
        sender-receiver-to-signal-mapping={data-element=CPT_MDG1_FlatView.PP_COM_Tx_ENGINE_FD_6.VD_COM_Tx_Trns_DrvMd_CfgSts_ECM, system-signal=SystemSignal_COM_Tx_Trns_DrvMd_CfgSts_ECM}
        sender-receiver-to-signal-mapping={data-element=CPT_MDG1_FlatView.PP_COM_Tx_ENGINE_FD_7_FD3.VD_COM_Tx_CRC_ENGINE7_FD3, system-signal=SystemSignal_COM_Tx_CRC_ENGINE7_FD3}
        sender-receiver-to-signal-mapping={data-element=CPT_MDG1_FlatView.PP_COM_Tx_ENGINE_FD_7_FD3.VD_COM_Tx_MessageCounter_ENGINE7_FD3, system-signal=SystemSignal_COM_Tx_MessageCounter_ENGINE7_FD3}
        sender-receiver-to-signal-mapping={data-element=CPT_MDG1_FlatView.PP_COM_Tx_ENGINE_FD_7_FD3.VD_COM_Tx_PerfShftRq_HUD_FD3, system-signal=SystemSignal_COM_Tx_PerfShftRq_HUD_FD3}
        sender-receiver-to-signal-group-mapping={data-element=CPT_MDG1_FlatView.PP_COM_Tx_ENGINE_FD_7_FD3.VD_COM_Tx_ENGINE_FD_7_FD, signal-group=SystemSignalGroup_COM_Tx_ENGINE_FD_7_FD, type-mapping=sender-rec-record-type-mapping=record-element-mappings=[{application-record-element=CompressorSts_FD3, system-signal=SystemSignal_COM_Tx_CompressorSts_FD3}, {application-record-element=ECM_THA_Resp_FD3, system-signal=SystemSignal_COM_Tx_ECM_THA_Resp_FD3}, {application-record-element=ECM_TRSC_Resp_FD3, system-signal=SystemSignal_COM_Tx_ECM_TRSC_Resp_FD3}, {application-record-element=ECM_WARN_BTO_1_FD3, system-signal=SystemSignal_COM_Tx_ECM_WARN_BTO_1_FD3}, {application-record-element=ECM_WARN_BTO_FD3, system-signal=SystemSignal_COM_Tx_ECM_WARN_BTO_FD3}, {application-record-element=ECM_WARN_FD3, system-signal=SystemSignal_COM_Tx_ECM_WARN_FD3}, {application-record-element=EMSFailSts_FD3, system-signal=SystemSignal_COM_Tx_EMSFailSts_FD3}, {application-record-element=ETCFailSts_FD3, system-signal=SystemSignal_COM_Tx_ETCFailSts_FD3}, {application-record-element=EngineOperatingMode_FD3, system-signal=SystemSignal_COM_Tx_EngineOperatingMode_FD3}, {application-record-element=ExhaustTemperature_FD3, system-signal=SystemSignal_COM_Tx_ExhaustTemperature_FD3}, {application-record-element=FuelMM_Sts_FD3, system-signal=SystemSignal_COM_Tx_FuelMM_Sts_FD3}, {application-record-element=GPFServiceSts_FD3, system-signal=SystemSignal_COM_Tx_GPFServiceSts_FD3}, {application-record-element=HoursOilLifeRst_FD3, system-signal=SystemSignal_COM_Tx_HoursOilLifeRst_FD3}, {application-record-element=KNK_MG_TRIGGER_FD3, system-signal=SystemSignal_COM_Tx_KNK_MG_TRIGGER_FD3}, {application-record-element=MntncSts_FD3, system-signal=SystemSignal_COM_Tx_MntncSts_FD3}, {application-record-element=OilLifeSts_FD3, system-signal=SystemSignal_COM_Tx_OilLifeSts_FD3}, {application-record-element=OilPressureSts_FD3, system-signal=SystemSignal_COM_Tx_OilPressureSts_FD3}, {application-record-element=SpStDispstat_FD3, system-signal=SystemSignal_COM_Tx_SpStDispstat_FD3}, {application-record-element=SpStIndRq_FD3, system-signal=SystemSignal_COM_Tx_SpStIndRq_FD3}, {application-record-element=SpStSwStat_FD3, system-signal=SystemSignal_COM_Tx_SpStSwStat_FD3}]}
        sender-receiver-to-signal-mapping={data-element=CPT_MDG1_FlatView.PP_COM_Tx_ENGINE_FD_8.VD_COM_Tx_AFTER_RUN_STATUS, system-signal=SystemSignal_COM_Tx_AFTER_RUN_STATUS}
        sender-receiver-to-signal-mapping={data-element=CPT_MDG1_FlatView.PP_COM_Tx_ENGINE_FD_8.VD_COM_Tx_AM_ECM_Prsnt, system-signal=SystemSignal_COM_Tx_AM_ECM_Prsnt}
        sender-receiver-to-signal-mapping={data-element=CPT_MDG1_FlatView.PP_COM_Tx_ENGINE_FD_8.VD_COM_Tx_COOLING_REQUIRED_STATUS, system-signal=SystemSignal_COM_Tx_COOLING_REQUIRED_STATUS}
        sender-receiver-to-signal-mapping={data-element=CPT_MDG1_FlatView.PP_COM_Tx_ENGINE_FD_8.VD_COM_Tx_CRC_ENGINE8, system-signal=SystemSignal_COM_Tx_CRC_ENGINE8}
        sender-receiver-to-signal-mapping={data-element=CPT_MDG1_FlatView.PP_COM_Tx_ENGINE_FD_8.VD_COM_Tx_ENGINE_RESET, system-signal=SystemSignal_COM_Tx_ENGINE_RESET}
        sender-receiver-to-signal-mapping={data-element=CPT_MDG1_FlatView.PP_COM_Tx_ENGINE_FD_8.VD_COM_Tx_GF_Charge, system-signal=SystemSignal_COM_Tx_GF_Charge}
        sender-receiver-to-signal-mapping={data-element=CPT_MDG1_FlatView.PP_COM_Tx_ENGINE_FD_8.VD_COM_Tx_HOOD_AJAR_STATUS, system-signal=SystemSignal_COM_Tx_HOOD_AJAR_STATUS}
        sender-receiver-to-signal-mapping={data-element=CPT_MDG1_FlatView.PP_COM_Tx_ENGINE_FD_8.VD_COM_Tx_LTR_TARGET_TEMP, system-signal=SystemSignal_COM_Tx_LTR_TARGET_TEMP}
        sender-receiver-to-signal-mapping={data-element=CPT_MDG1_FlatView.PP_COM_Tx_ENGINE_FD_8.VD_COM_Tx_MAP_4_BAR, system-signal=SystemSignal_COM_Tx_MAP_4_BAR}
        sender-receiver-to-signal-mapping={data-element=CPT_MDG1_FlatView.PP_COM_Tx_ENGINE_FD_8.VD_COM_Tx_MdsAct, system-signal=SystemSignal_COM_Tx_MdsAct}
        sender-receiver-to-signal-mapping={data-element=CPT_MDG1_FlatView.PP_COM_Tx_ENGINE_FD_8.VD_COM_Tx_MdsActforANC, system-signal=SystemSignal_COM_Tx_MdsActforANC}
        sender-receiver-to-signal-mapping={data-element=CPT_MDG1_FlatView.PP_COM_Tx_ENGINE_FD_8.VD_COM_Tx_MessageCounter_ENGINE8, system-signal=SystemSignal_COM_Tx_MessageCounter_ENGINE8}
        sender-receiver-to-signal-mapping={data-element=CPT_MDG1_FlatView.PP_COM_Tx_ENGINE_FD_8.VD_COM_Tx_OIL_PRESS, system-signal=SystemSignal_COM_Tx_OIL_PRESS}
        sender-receiver-to-signal-mapping={data-element=CPT_MDG1_FlatView.PP_COM_Tx_ENGINE_FD_8.VD_COM_Tx_PCPM_PumpSpeedAct, system-signal=SystemSignal_COM_Tx_PCPM_PumpSpeedAct}
        sender-receiver-to-signal-mapping={data-element=CPT_MDG1_FlatView.PP_COM_Tx_ENGINE_FD_8.VD_COM_Tx_PSI_EnableSts, system-signal=SystemSignal_COM_Tx_PSI_EnableSts}
        sender-receiver-to-signal-mapping={data-element=CPT_MDG1_FlatView.PP_COM_Tx_ENGINE_FD_8.VD_COM_Tx_PSI_Gr{1..5}_RPM, system-signal=SystemSignal_COM_Tx_PSI_Gr{1..5}_RPM}
        sender-receiver-to-signal-mapping={data-element=CPT_MDG1_FlatView.PP_COM_Tx_ENGINE_FD_8.VD_COM_Tx_PSI_Max_RPM, system-signal=SystemSignal_COM_Tx_PSI_Max_RPM}
        sender-receiver-to-signal-mapping={data-element=CPT_MDG1_FlatView.PP_COM_Tx_ENGINE_FD_8.VD_COM_Tx_RACE_CLDWN_BATT_STAT, system-signal=SystemSignal_COM_Tx_RACE_CLDWN_BATT_STAT}
        sender-receiver-to-signal-mapping={data-element=CPT_MDG1_FlatView.PP_COM_Tx_ENGINE_FD_8.VD_COM_Tx_RACE_CLDWN_DEAC_TIME, system-signal=SystemSignal_COM_Tx_RACE_CLDWN_DEAC_TIME}
        sender-receiver-to-signal-mapping={data-element=CPT_MDG1_FlatView.PP_COM_Tx_ENGINE_FD_8.VD_COM_Tx_RACE_CLDWN_SEL, system-signal=SystemSignal_COM_Tx_RACE_CLDWN_SEL}
        sender-receiver-to-signal-mapping={data-element=CPT_MDG1_FlatView.PP_COM_Tx_ENGINE_FD_8.VD_COM_Tx_RefuelEvent, system-signal=SystemSignal_COM_Tx_RefuelEvent}
        sender-receiver-to-signal-mapping={data-element=CPT_MDG1_FlatView.PP_COM_Tx_ENGINE_FD_8.VD_COM_Tx_RefuelIndication, system-signal=SystemSignal_COM_Tx_RefuelIndication}
        sender-receiver-to-signal-mapping={data-element=CPT_MDG1_FlatView.PP_COM_Tx_ENGINE_FD_8.VD_COM_Tx_RevOilLifeRst, system-signal=SystemSignal_COM_Tx_RevOilLifeRst}
        sender-receiver-to-signal-mapping={data-element=CPT_MDG1_FlatView.PP_COM_Tx_ENGINE_FD_8.VD_COM_Tx_SYSTEM_STATUS, system-signal=SystemSignal_COM_Tx_SYSTEM_STATUS}
        sender-receiver-to-signal-mapping={data-element=CPT_MDG1_FlatView.PP_COM_Tx_ENGINE_FD_9.VD_COM_Tx_IdleShutDwnApply, system-signal=SystemSignal_COM_Tx_IdleShutDwnApply}
        sender-receiver-to-signal-mapping={data-element=CPT_MDG1_FlatView.PP_COM_Tx_ENGINE_FD_9.VD_COM_Tx_PTO_Acc_Intlk, system-signal=SystemSignal_COM_Tx_PTO_Acc_Intlk}
        sender-receiver-to-signal-mapping={data-element=CPT_MDG1_FlatView.PP_COM_Tx_ENGINE_FD_9.VD_COM_Tx_PTO_Active, system-signal=SystemSignal_COM_Tx_PTO_Active}
        sender-receiver-to-signal-mapping={data-element=CPT_MDG1_FlatView.PP_COM_Tx_ENGINE_FD_9.VD_COM_Tx_PTO_AutoRsm, system-signal=SystemSignal_COM_Tx_PTO_AutoRsm}
        sender-receiver-to-signal-mapping={data-element=CPT_MDG1_FlatView.PP_COM_Tx_ENGINE_FD_9.VD_COM_Tx_PTO_ENGD_RQ, system-signal=SystemSignal_COM_Tx_PTO_ENGD_RQ}
        sender-receiver-to-signal-mapping={data-element=CPT_MDG1_FlatView.PP_COM_Tx_ENGINE_FD_9.VD_COM_Tx_PTO_High_Idle_Enable, system-signal=SystemSignal_COM_Tx_PTO_High_Idle_Enable}
        sender-receiver-to-signal-mapping={data-element=CPT_MDG1_FlatView.PP_COM_Tx_ENGINE_FD_9.VD_COM_Tx_PTO_High_Idle_RPM, system-signal=SystemSignal_COM_Tx_PTO_High_Idle_RPM}
        sender-receiver-to-signal-mapping={data-element=CPT_MDG1_FlatView.PP_COM_Tx_ENGINE_FD_9.VD_COM_Tx_PTO_HornRq, system-signal=SystemSignal_COM_Tx_PTO_HornRq}
        sender-receiver-to-signal-mapping={data-element=CPT_MDG1_FlatView.PP_COM_Tx_ENGINE_FD_9.VD_COM_Tx_PTO_Incab, system-signal=SystemSignal_COM_Tx_PTO_Incab}
        sender-receiver-to-signal-mapping={data-element=CPT_MDG1_FlatView.PP_COM_Tx_ENGINE_FD_9.VD_COM_Tx_PTO_MaxVehSpd, system-signal=SystemSignal_COM_Tx_PTO_MaxVehSpd}
        sender-receiver-to-signal-mapping={data-element=CPT_MDG1_FlatView.PP_COM_Tx_ENGINE_FD_9.VD_COM_Tx_PTO_Md, system-signal=SystemSignal_COM_Tx_PTO_Md}
        sender-receiver-to-signal-mapping={data-element=CPT_MDG1_FlatView.PP_COM_Tx_ENGINE_FD_9.VD_COM_Tx_PTO_Park_Brk_Required, system-signal=SystemSignal_COM_Tx_PTO_Park_Brk_Required}
        sender-receiver-to-signal-mapping={data-element=CPT_MDG1_FlatView.PP_COM_Tx_ENGINE_FD_9.VD_COM_Tx_PTO_RPM{1..3}, system-signal=SystemSignal_COM_Tx_PTO_RPM{1..3}}
        sender-receiver-to-signal-mapping={data-element=CPT_MDG1_FlatView.PP_COM_Tx_ENGINE_FD_9.VD_COM_Tx_PTO_Ramp_Rate, system-signal=SystemSignal_COM_Tx_PTO_Ramp_Rate}
        sender-receiver-to-signal-mapping={data-element=CPT_MDG1_FlatView.PP_COM_Tx_ENGINE_FD_9.VD_COM_Tx_PTO_Remote_RPM_Method, system-signal=SystemSignal_COM_Tx_PTO_Remote_RPM_Method}
        sender-receiver-to-signal-mapping={data-element=CPT_MDG1_FlatView.PP_COM_Tx_ENGINE_FD_9.VD_COM_Tx_PTO_SingleRPM, system-signal=SystemSignal_COM_Tx_PTO_SingleRPM}
        sender-receiver-to-signal-mapping={data-element=CPT_MDG1_FlatView.PP_COM_Tx_ENGINE_FD_9.VD_COM_Tx_PTO_Sts, system-signal=SystemSignal_COM_Tx_PTO_Sts}
        sender-receiver-to-signal-mapping={data-element=CPT_MDG1_FlatView.PP_COM_Tx_ENGINE_FD_9.VD_COM_Tx_PTO_TYPES, system-signal=SystemSignal_COM_Tx_PTO_TYPES}
        sender-receiver-to-signal-mapping={data-element=CPT_MDG1_FlatView.PP_COM_Tx_ENGINE_FD_9.VD_COM_Tx_PTO_Target_Gear, system-signal=SystemSignal_COM_Tx_PTO_Target_Gear}
        sender-receiver-to-signal-mapping={data-element=CPT_MDG1_FlatView.PP_COM_Tx_ENGINE_FD_9.VD_COM_Tx_SEIU_Enbl, system-signal=SystemSignal_COM_Tx_SEIU_Enbl}
        sender-receiver-to-signal-mapping={data-element=CPT_MDG1_FlatView.PP_COM_Tx_ENGINE_FD_9.VD_COM_Tx_SEIU_RPM, system-signal=SystemSignal_COM_Tx_SEIU_RPM}
        sender-receiver-to-signal-mapping={data-element=CPT_MDG1_FlatView.PP_COM_Tx_ENGINE_FD_9.VD_COM_Tx_SEIU_Sts, system-signal=SystemSignal_COM_Tx_SEIU_Sts}
        sender-receiver-to-signal-group-mapping={data-element=CPT_MDG1_FlatView.PP_COM_Tx_ENGINE_FD_DIESEL.VD_COM_Tx_ENGINE_FD_DIESEL, signal-group=SystemSignalGroup_COM_Tx_ENGINE_FD_DIESEL, type-mapping=sender-rec-record-type-mapping=record-element-mappings=[{application-record-element=AdblueRemainDist, system-signal=SystemSignal_COM_Tx_AdblueRemainDist}, {application-record-element=Adblue_FL_LVL, system-signal=SystemSignal_COM_Tx_Adblue_FL_LVL}, {application-record-element=Adblue_Stat, system-signal=SystemSignal_COM_Tx_Adblue_Stat}, {application-record-element=CoolLo, system-signal=SystemSignal_COM_Tx_CoolLo}, {application-record-element=CountDown, system-signal=SystemSignal_COM_Tx_CountDown}, {application-record-element=DEF_LOW, system-signal=SystemSignal_COM_Tx_DEF_LOW}, {application-record-element=DPF_Man_Stat, system-signal=SystemSignal_COM_Tx_DPF_Man_Stat}, {application-record-element=EB_ACC_AVLBL, system-signal=SystemSignal_COM_Tx_EB_ACC_AVLBL}, {application-record-element=EB_Pwr, system-signal=SystemSignal_COM_Tx_EB_Pwr}, {application-record-element=EB_Stat3, system-signal=SystemSignal_COM_Tx_EB_Stat3}, {application-record-element=ECM_HMI_Timer_RQ, system-signal=SystemSignal_COM_Tx_ECM_HMI_Timer_RQ}, {application-record-element=EngBrkStat, system-signal=SystemSignal_COM_Tx_EngBrkStat}, {application-record-element=EngChmRq, system-signal=SystemSignal_COM_Tx_EngChmRq}, {application-record-element=FuelFltrAck, system-signal=SystemSignal_COM_Tx_FuelFltrAck}, {application-record-element=FuelFltrLeft, system-signal=SystemSignal_COM_Tx_FuelFltrLeft}, {application-record-element=FuelFltrRq, system-signal=SystemSignal_COM_Tx_FuelFltrRq}, {application-record-element=IdleShutDwnAppl, system-signal=SystemSignal_COM_Tx_IdleShutDwnAppl}, {application-record-element=Man_PFW_Stat, system-signal=SystemSignal_COM_Tx_Man_PFW_Stat}, {application-record-element=Man_PFW_Timer, system-signal=SystemSignal_COM_Tx_Man_PFW_Timer}, {application-record-element=PFW_Stat, system-signal=SystemSignal_COM_Tx_PFW_Stat}, {application-record-element=PF_RgnActv, system-signal=SystemSignal_COM_Tx_PF_RgnActv}, {application-record-element=PrcntCplt, system-signal=SystemSignal_COM_Tx_PrcntCplt}, {application-record-element=PreHtIndLmp_On_Rq, system-signal=SystemSignal_COM_Tx_PreHtIndLmp_On_Rq}, {application-record-element=PreHtlmpwithEVIC_On_Rq, system-signal=SystemSignal_COM_Tx_PreHtlmpwithEVIC_On_Rq}, {application-record-element=Rapid_Cabin_Warmup_Stat, system-signal=SystemSignal_COM_Tx_Rapid_Cabin_Warmup_Stat}, {application-record-element=RemainDistUnt, system-signal=SystemSignal_COM_Tx_RemainDistUnt}, {application-record-element=SRV_AIR_FLTR, system-signal=SystemSignal_COM_Tx_SRV_AIR_FLTR}, {application-record-element=SRV_CCV_FLTR, system-signal=SystemSignal_COM_Tx_SRV_CCV_FLTR}, {application-record-element=WtrFuelIndLmp_On_Rq, system-signal=SystemSignal_COM_Tx_WtrFuelIndLmp_On_Rq}]}
        sender-receiver-to-signal-mapping={data-element=CPT_MDG1_FlatView.PP_COM_Tx_ENGINE_HYBD_FD_3.VD_COM_Tx_AGSposn, system-signal=SystemSignal_COM_Tx_AGSposn}
        sender-receiver-to-signal-mapping={data-element=CPT_MDG1_FlatView.PP_COM_Tx_ENGINE_HYBD_FD_3.VD_COM_Tx_AfterRunReq, system-signal=SystemSignal_COM_Tx_AfterRunReq}
        sender-receiver-to-signal-mapping={data-element=CPT_MDG1_FlatView.PP_COM_Tx_ENGINE_HYBD_FD_3.VD_COM_Tx_CRC_ENGINE_HYBD_FD_3, system-signal=SystemSignal_COM_Tx_CRC_ENGINE_HYBD_FD_3}
        sender-receiver-to-signal-mapping={data-element=CPT_MDG1_FlatView.PP_COM_Tx_ENGINE_HYBD_FD_3.VD_COM_Tx_ECM_AirflowRequest, system-signal=SystemSignal_COM_Tx_ECM_AirflowRequest}
        sender-receiver-to-signal-mapping={data-element=CPT_MDG1_FlatView.PP_COM_Tx_ENGINE_HYBD_FD_3.VD_COM_Tx_ECM_WorkSite_Invtr_Sts, system-signal=SystemSignal_COM_Tx_ECM_WorkSite_Invtr_Sts}
        sender-receiver-to-signal-mapping={data-element=CPT_MDG1_FlatView.PP_COM_Tx_ENGINE_HYBD_FD_3.VD_COM_Tx_EngCltTmp, system-signal=SystemSignal_COM_Tx_EngCltTmp}
        sender-receiver-to-signal-mapping={data-element=CPT_MDG1_FlatView.PP_COM_Tx_ENGINE_HYBD_FD_3.VD_COM_Tx_EngCltTmpV, system-signal=SystemSignal_COM_Tx_EngCltTmpV}
        sender-receiver-to-signal-mapping={data-element=CPT_MDG1_FlatView.PP_COM_Tx_ENGINE_HYBD_FD_3.VD_COM_Tx_EngHalfCylSpdMaxLim, system-signal=SystemSignal_COM_Tx_EngHalfCylSpdMaxLim}
        sender-receiver-to-signal-mapping={data-element=CPT_MDG1_FlatView.PP_COM_Tx_ENGINE_HYBD_FD_3.VD_COM_Tx_EngHalfCylSpdMinLim, system-signal=SystemSignal_COM_Tx_EngHalfCylSpdMinLim}
        sender-receiver-to-signal-mapping={data-element=CPT_MDG1_FlatView.PP_COM_Tx_ENGINE_HYBD_FD_3.VD_COM_Tx_EngOutofFuel, system-signal=SystemSignal_COM_Tx_EngOutofFuel}
        sender-receiver-to-signal-mapping={data-element=CPT_MDG1_FlatView.PP_COM_Tx_ENGINE_HYBD_FD_3.VD_COM_Tx_EngSpd, system-signal=SystemSignal_COM_Tx_EngSpd}
        sender-receiver-to-signal-mapping={data-element=CPT_MDG1_FlatView.PP_COM_Tx_ENGINE_HYBD_FD_3.VD_COM_Tx_EngSpdStat, system-signal=SystemSignal_COM_Tx_EngSpdStat}
        sender-receiver-to-signal-mapping={data-element=CPT_MDG1_FlatView.PP_COM_Tx_ENGINE_HYBD_FD_3.VD_COM_Tx_Engine_Maintenance_Sts, system-signal=SystemSignal_COM_Tx_Engine_Maintenance_Sts}
        sender-receiver-to-signal-mapping={data-element=CPT_MDG1_FlatView.PP_COM_Tx_ENGINE_HYBD_FD_3.VD_COM_Tx_LTR_PumpSpeedAct, system-signal=SystemSignal_COM_Tx_LTR_PumpSpeedAct}
        sender-receiver-to-signal-mapping={data-element=CPT_MDG1_FlatView.PP_COM_Tx_ENGINE_HYBD_FD_3.VD_COM_Tx_MaxEngSpdCap, system-signal=SystemSignal_COM_Tx_MaxEngSpdCap}
        sender-receiver-to-signal-mapping={data-element=CPT_MDG1_FlatView.PP_COM_Tx_ENGINE_HYBD_FD_3.VD_COM_Tx_MessageCounter_ENGINE_HYBD_FD_3, system-signal=SystemSignal_COM_Tx_MessageCounter_ENGINE_HYBD_FD_3}
        sender-receiver-to-signal-mapping={data-element=CPT_MDG1_FlatView.PP_COM_Tx_ENGINE_HYBD_FD_3.VD_COM_Tx_MinEngSpdCap, system-signal=SystemSignal_COM_Tx_MinEngSpdCap}
        sender-receiver-to-signal-mapping={data-element=CPT_MDG1_FlatView.PP_COM_Tx_ENGINE_HYBD_FD_3.VD_COM_Tx_PECP_PumpFlowReq, system-signal=SystemSignal_COM_Tx_PECP_PumpFlowReq}
        sender-receiver-to-signal-mapping={data-element=CPT_MDG1_FlatView.PP_COM_Tx_ENGINE_HYBD_FD_3.VD_COM_Tx_RadFanReq, system-signal=SystemSignal_COM_Tx_RadFanReq}
        sender-receiver-to-signal-mapping={data-element=CPT_MDG1_FlatView.PP_COM_Tx_ENGINE_HYBD_FD_3.VD_COM_Tx_ServiceHybSys, system-signal=SystemSignal_COM_Tx_ServiceHybSys}
        sender-receiver-to-signal-mapping={data-element=CPT_MDG1_FlatView.PP_COM_Tx_ENGINE_HYBD_FD_4.VD_COM_Tx_CRC_ENGINE_HYBD_FD_4, system-signal=SystemSignal_COM_Tx_CRC_ENGINE_HYBD_FD_4}
        sender-receiver-to-signal-mapping={data-element=CPT_MDG1_FlatView.PP_COM_Tx_ENGINE_HYBD_FD_4.VD_COM_Tx_CatHtgStateActive, system-signal=SystemSignal_COM_Tx_CatHtgStateActive}
        sender-receiver-to-signal-mapping={data-element=CPT_MDG1_FlatView.PP_COM_Tx_ENGINE_HYBD_FD_4.VD_COM_Tx_CatTempMaint, system-signal=SystemSignal_COM_Tx_CatTempMaint}
        sender-receiver-to-signal-mapping={data-element=CPT_MDG1_FlatView.PP_COM_Tx_ENGINE_HYBD_FD_4.VD_COM_Tx_EngTorqACCCapability, system-signal=SystemSignal_COM_Tx_EngTorqACCCapability}
        sender-receiver-to-signal-mapping={data-element=CPT_MDG1_FlatView.PP_COM_Tx_ENGINE_HYBD_FD_4.VD_COM_Tx_EngTorqCapbltyEngOpMd, system-signal=SystemSignal_COM_Tx_EngTorqCapbltyEngOpMd}
        sender-receiver-to-signal-mapping={data-element=CPT_MDG1_FlatView.PP_COM_Tx_ENGINE_HYBD_FD_4.VD_COM_Tx_EngTorqCapbltyFrmCntr, system-signal=SystemSignal_COM_Tx_EngTorqCapbltyFrmCntr}
        sender-receiver-to-signal-mapping={data-element=CPT_MDG1_FlatView.PP_COM_Tx_ENGINE_HYBD_FD_4.VD_COM_Tx_EngTorqCapbltyMaxOffTorq, system-signal=SystemSignal_COM_Tx_EngTorqCapbltyMaxOffTorq}
        sender-receiver-to-signal-mapping={data-element=CPT_MDG1_FlatView.PP_COM_Tx_ENGINE_HYBD_FD_4.VD_COM_Tx_EngTorqCapbltyMaxTorq, system-signal=SystemSignal_COM_Tx_EngTorqCapbltyMaxTorq}
        sender-receiver-to-signal-mapping={data-element=CPT_MDG1_FlatView.PP_COM_Tx_ENGINE_HYBD_FD_4.VD_COM_Tx_EngTorqCapbltyMinRunTorq, system-signal=SystemSignal_COM_Tx_EngTorqCapbltyMinRunTorq}
        sender-receiver-to-signal-mapping={data-element=CPT_MDG1_FlatView.PP_COM_Tx_ENGINE_HYBD_FD_4.VD_COM_Tx_EngTorqCapbltyMinTorq, system-signal=SystemSignal_COM_Tx_EngTorqCapbltyMinTorq}
        sender-receiver-to-signal-mapping={data-element=CPT_MDG1_FlatView.PP_COM_Tx_ENGINE_HYBD_FD_4.VD_COM_Tx_EngTorqCapbltyRefEngSpd, system-signal=SystemSignal_COM_Tx_EngTorqCapbltyRefEngSpd}
        sender-receiver-to-signal-mapping={data-element=CPT_MDG1_FlatView.PP_COM_Tx_ENGINE_HYBD_FD_4.VD_COM_Tx_MessageCounter_ENGINE_HYBD_FD_4, system-signal=SystemSignal_COM_Tx_MessageCounter_ENGINE_HYBD_FD_4}
        sender-receiver-to-signal-mapping={data-element=CPT_MDG1_FlatView.PP_COM_Tx_OBD_CONTENT_FRAME.VD_COM_Tx_AccelPdlPosn_OBD, system-signal=SystemSignal_COM_Tx_AccelPdlPosn_OBD}
        sender-receiver-to-signal-mapping={data-element=CPT_MDG1_FlatView.PP_COM_Tx_OBD_CONTENT_FRAME.VD_COM_Tx_BarPrsAbs, system-signal=SystemSignal_COM_Tx_BarPrsAbs}
        sender-receiver-to-signal-mapping={data-element=CPT_MDG1_FlatView.PP_COM_Tx_OBD_CONTENT_FRAME.VD_COM_Tx_BarPrsAbsV, system-signal=SystemSignal_COM_Tx_BarPrsAbsV}
        sender-receiver-to-signal-mapping={data-element=CPT_MDG1_FlatView.PP_COM_Tx_OBD_CONTENT_FRAME.VD_COM_Tx_CARB_PERM, system-signal=SystemSignal_COM_Tx_CARB_PERM}
        sender-receiver-to-signal-mapping={data-element=CPT_MDG1_FlatView.PP_COM_Tx_OBD_CONTENT_FRAME.VD_COM_Tx_CRC_OBDCONTENTFRAME, system-signal=SystemSignal_COM_Tx_CRC_OBDCONTENTFRAME}
        sender-receiver-to-signal-mapping={data-element=CPT_MDG1_FlatView.PP_COM_Tx_OBD_CONTENT_FRAME.VD_COM_Tx_CarbWarmUp, system-signal=SystemSignal_COM_Tx_CarbWarmUp}
        sender-receiver-to-signal-mapping={data-element=CPT_MDG1_FlatView.PP_COM_Tx_OBD_CONTENT_FRAME.VD_COM_Tx_CldStrtDenominator, system-signal=SystemSignal_COM_Tx_CldStrtDenominator}
        sender-receiver-to-signal-mapping={data-element=CPT_MDG1_FlatView.PP_COM_Tx_OBD_CONTENT_FRAME.VD_COM_Tx_ECM_HoodAjar, system-signal=SystemSignal_COM_Tx_ECM_HoodAjar}
        sender-receiver-to-signal-mapping={data-element=CPT_MDG1_FlatView.PP_COM_Tx_OBD_CONTENT_FRAME.VD_COM_Tx_EngIntAirTmp, system-signal=SystemSignal_COM_Tx_EngIntAirTmp}
        sender-receiver-to-signal-mapping={data-element=CPT_MDG1_FlatView.PP_COM_Tx_OBD_CONTENT_FRAME.VD_COM_Tx_EngIntAirTmpV, system-signal=SystemSignal_COM_Tx_EngIntAirTmpV}
        sender-receiver-to-signal-mapping={data-element=CPT_MDG1_FlatView.PP_COM_Tx_OBD_CONTENT_FRAME.VD_COM_Tx_EngLoad_OBD_ePT, system-signal=SystemSignal_COM_Tx_EngLoad_OBD_ePT}
        sender-receiver-to-signal-mapping={data-element=CPT_MDG1_FlatView.PP_COM_Tx_OBD_CONTENT_FRAME.VD_COM_Tx_EngOffTmPT, system-signal=SystemSignal_COM_Tx_EngOffTmPT}
        sender-receiver-to-signal-mapping={data-element=CPT_MDG1_FlatView.PP_COM_Tx_OBD_CONTENT_FRAME.VD_COM_Tx_EngOffTmPTV, system-signal=SystemSignal_COM_Tx_EngOffTmPTV}
        sender-receiver-to-signal-mapping={data-element=CPT_MDG1_FlatView.PP_COM_Tx_OBD_CONTENT_FRAME.VD_COM_Tx_EngineOFFTime, system-signal=SystemSignal_COM_Tx_EngineOFFTime}
        sender-receiver-to-signal-mapping={data-element=CPT_MDG1_FlatView.PP_COM_Tx_OBD_CONTENT_FRAME.VD_COM_Tx_EstCatCnvTmp, system-signal=SystemSignal_COM_Tx_EstCatCnvTmp}
        sender-receiver-to-signal-mapping={data-element=CPT_MDG1_FlatView.PP_COM_Tx_OBD_CONTENT_FRAME.VD_COM_Tx_GenDenominator, system-signal=SystemSignal_COM_Tx_GenDenominator}
        sender-receiver-to-signal-mapping={data-element=CPT_MDG1_FlatView.PP_COM_Tx_OBD_CONTENT_FRAME.VD_COM_Tx_IgnCntrFuelEngTrue, system-signal=SystemSignal_COM_Tx_IgnCntrFuelEngTrue}
        sender-receiver-to-signal-mapping={data-element=CPT_MDG1_FlatView.PP_COM_Tx_OBD_CONTENT_FRAME.VD_COM_Tx_IgnCntrTrue, system-signal=SystemSignal_COM_Tx_IgnCntrTrue}
        sender-receiver-to-signal-mapping={data-element=CPT_MDG1_FlatView.PP_COM_Tx_OBD_CONTENT_FRAME.VD_COM_Tx_InpICCFuelEng_Fail, system-signal=SystemSignal_COM_Tx_InpICCFuelEng_Fail}
        sender-receiver-to-signal-mapping={data-element=CPT_MDG1_FlatView.PP_COM_Tx_OBD_CONTENT_FRAME.VD_COM_Tx_Inp_ICC_Fail, system-signal=SystemSignal_COM_Tx_Inp_ICC_Fail}
        sender-receiver-to-signal-mapping={data-element=CPT_MDG1_FlatView.PP_COM_Tx_OBD_CONTENT_FRAME.VD_COM_Tx_InputsGDFail, system-signal=SystemSignal_COM_Tx_InputsGDFail}
        sender-receiver-to-signal-mapping={data-element=CPT_MDG1_FlatView.PP_COM_Tx_OBD_CONTENT_FRAME.VD_COM_Tx_LgsDiagCldStrtCndFltPr, system-signal=SystemSignal_COM_Tx_LgsDiagCldStrtCndFltPr}
        sender-receiver-to-signal-mapping={data-element=CPT_MDG1_FlatView.PP_COM_Tx_OBD_CONTENT_FRAME.VD_COM_Tx_LgsDiagCldStrtCndMet, system-signal=SystemSignal_COM_Tx_LgsDiagCldStrtCndMet}
        sender-receiver-to-signal-mapping={data-element=CPT_MDG1_FlatView.PP_COM_Tx_OBD_CONTENT_FRAME.VD_COM_Tx_LgsDiagStndCondFltPrs, system-signal=SystemSignal_COM_Tx_LgsDiagStndCondFltPrs}
        sender-receiver-to-signal-mapping={data-element=CPT_MDG1_FlatView.PP_COM_Tx_OBD_CONTENT_FRAME.VD_COM_Tx_LgsDiagStndCondMet, system-signal=SystemSignal_COM_Tx_LgsDiagStndCondMet}
        sender-receiver-to-signal-mapping={data-element=CPT_MDG1_FlatView.PP_COM_Tx_OBD_CONTENT_FRAME.VD_COM_Tx_LoadOBD, system-signal=SystemSignal_COM_Tx_LoadOBD}
        sender-receiver-to-signal-mapping={data-element=CPT_MDG1_FlatView.PP_COM_Tx_OBD_CONTENT_FRAME.VD_COM_Tx_MessageCounter_OBDCONTENTFRAME, system-signal=SystemSignal_COM_Tx_MessageCounter_OBDCONTENTFRAME}
        sender-receiver-to-signal-mapping={data-element=CPT_MDG1_FlatView.PP_COM_Tx_OBD_CONTENT_FRAME.VD_COM_Tx_OAT_PT_Est, system-signal=SystemSignal_COM_Tx_OAT_PT_Est}
        sender-receiver-to-signal-mapping={data-element=CPT_MDG1_FlatView.PP_COM_Tx_OBD_CONTENT_FRAME.VD_COM_Tx_OAT_PT_EstV, system-signal=SystemSignal_COM_Tx_OAT_PT_EstV}
        sender-receiver-to-signal-mapping={data-element=CPT_MDG1_FlatView.PP_COM_Tx_PDC_INFO_FD_ECM.VD_COM_Tx_CurrentCanNMState_FD03_ECM, system-signal=SystemSignal_COM_Tx_CurrentCanNMState_FD03_ECM}
        sender-receiver-to-signal-mapping={data-element=CPT_MDG1_FlatView.PP_COM_Tx_PDC_INFO_FD_ECM.VD_COM_Tx_DES_FD03_ECM, system-signal=SystemSignal_COM_Tx_DES_FD03_ECM}
        sender-receiver-to-signal-mapping={data-element=CPT_MDG1_FlatView.PP_COM_Tx_PDC_INFO_FD_ECM.VD_COM_Tx_EOL_FD03_ECM, system-signal=SystemSignal_COM_Tx_EOL_FD03_ECM}
        sender-receiver-to-signal-mapping={data-element=CPT_MDG1_FlatView.PP_COM_Tx_PDC_INFO_FD_ECM.VD_COM_Tx_PreviousCanNMState_FD03_ECM, system-signal=SystemSignal_COM_Tx_PreviousCanNMState_FD03_ECM}
        sender-receiver-to-signal-mapping={data-element=CPT_MDG1_FlatView.RP_COM_Rx_ADAS_FD_HMI_FD14.VD_COM_Rx_CRC_ADAS_FD_HMI_FD14, system-signal=SystemSignal_COM_Rx_CRC_ADAS_FD_HMI_FD14}
        sender-receiver-to-signal-mapping={data-element=CPT_MDG1_FlatView.RP_COM_Rx_ADAS_FD_HMI_FD14.VD_COM_Rx_MessageCounter_ADAS_FD_HMI_FD14, system-signal=SystemSignal_COM_Rx_MessageCounter_ADAS_FD_HMI_FD14}
        sender-receiver-to-signal-mapping={data-element=CPT_MDG1_FlatView.RP_COM_Rx_ADAS_FD_HMI_FD14.VD_COM_Rx_Set_Speed_KPH_FD14, system-signal=SystemSignal_COM_Rx_Set_Speed_KPH_FD14}
        sender-receiver-to-signal-mapping={data-element=CPT_MDG1_FlatView.RP_COM_Rx_ADAS_FD_HMI_FD14.VD_COM_Rx_Set_Speed_MPH_FD14, system-signal=SystemSignal_COM_Rx_Set_Speed_MPH_FD14}
        sender-receiver-to-signal-mapping={data-element=CPT_MDG1_FlatView.RP_COM_Rx_BRAKE_FD_1_FD14.VD_COM_Rx_SelectSpdSts_FD14, system-signal=SystemSignal_COM_Rx_SelectSpdSts_FD14}
        sender-receiver-to-signal-mapping={data-element=CPT_MDG1_FlatView.RP_COM_Rx_HYBRID_POWERTRAIN1_FD14.VD_COM_Rx_PropulsionSystemActive_FD14, system-signal=SystemSignal_COM_Rx_PropulsionSystemActive_FD14}
        sender-receiver-to-signal-mapping={data-element=CPT_MDG1_FlatView.PP_COM_Tx_ENGINE_FD_1_FD14.VD_COM_Tx_CRC_ENGINE1_FD14, system-signal=SystemSignal_COM_Tx_CRC_ENGINE1_FD14}
        sender-receiver-to-signal-mapping={data-element=CPT_MDG1_FlatView.PP_COM_Tx_ENGINE_FD_1_FD14.VD_COM_Tx_MessageCounter_ENGINE1_FD14, system-signal=SystemSignal_COM_Tx_MessageCounter_ENGINE1_FD14}
        sender-receiver-to-signal-mapping={data-element=CPT_MDG1_FlatView.PP_COM_Tx_ENGINE_FD_1_FD14.VD_COM_Tx_ThermalManagementActive_W_FD14, system-signal=SystemSignal_COM_Tx_ThermalManagementActive_W_FD14}
        sender-receiver-to-signal-mapping={data-element=CPT_MDG1_FlatView.PP_COM_Tx_ENGINE_FD_3_FD14.VD_COM_Tx_CRC_ENGINE3_FD14, system-signal=SystemSignal_COM_Tx_CRC_ENGINE3_FD14}
        sender-receiver-to-signal-mapping={data-element=CPT_MDG1_FlatView.PP_COM_Tx_ENGINE_FD_3_FD14.VD_COM_Tx_MessageCounter_ENGINE3_FD14, system-signal=SystemSignal_COM_Tx_MessageCounter_ENGINE3_FD14}
        sender-receiver-to-signal-group-mapping={data-element=CPT_MDG1_FlatView.PP_COM_Tx_ENGINE_FD_3_FD14.VD_COM_Tx_ENGINE_FD_3_FD14, signal-group=SystemSignalGroup_COM_Tx_ENGINE_FD_3_FD14, type-mapping=sender-rec-record-type-mapping=record-element-mappings=[{application-record-element=ISASts_FD14, system-signal=SystemSignal_COM_Tx_ISASts_FD14}, {application-record-element=Override_FD14, system-signal=SystemSignal_COM_Tx_Override_FD14}, {application-record-element=SpeedLimitSts_FD14, system-signal=SystemSignal_COM_Tx_SpeedLimitSts_FD14}]}
        sender-receiver-to-signal-mapping={data-element=CPT_MDG1_FlatView.PP_COM_Tx_ENGINE_FD_7_FD14.VD_COM_Tx_CRC_ENGINE7_FD14, system-signal=SystemSignal_COM_Tx_CRC_ENGINE7_FD14}
        sender-receiver-to-signal-mapping={data-element=CPT_MDG1_FlatView.PP_COM_Tx_ENGINE_FD_7_FD14.VD_COM_Tx_MessageCounter_ENGINE7_FD14, system-signal=SystemSignal_COM_Tx_MessageCounter_ENGINE7_FD14}
        sender-receiver-to-signal-group-mapping={data-element=CPT_MDG1_FlatView.PP_COM_Tx_ENGINE_FD_7_FD14.VD_COM_Tx_ENGINE_FD_7_FD14, signal-group=SystemSignalGroup_COM_Tx_ENGINE_FD_7_FD14, type-mapping=sender-rec-record-type-mapping=record-element-mappings=[{application-record-element=ECM_THA_Resp_FD14, system-signal=SystemSignal_COM_Tx_ECM_THA_Resp_FD14}, {application-record-element=ECM_TRSC_Resp_FD14, system-signal=SystemSignal_COM_Tx_ECM_TRSC_Resp_FD14}]}
        sender-receiver-to-signal-mapping={data-element=CPT_MDG1_FlatView.RP_COM_Rx_HYBRID_THERMAL_COMMAND_FD16.VD_COM_Rx_CRC_HYBRID_THERMAL_COMMAND, system-signal=SystemSignal_COM_Rx_CRC_HYBRID_THERMAL_COMMAND}
        sender-receiver-to-signal-mapping={data-element=CPT_MDG1_FlatView.RP_COM_Rx_HYBRID_THERMAL_COMMAND_FD16.VD_COM_Rx_MC_HYBRID_THERMAL_COMMAND, system-signal=SystemSignal_COM_Rx_MC_HYBRID_THERMAL_COMMAND}
        sender-receiver-to-signal-mapping={data-element=CPT_MDG1_FlatView.PP_COM_Tx_ENGINE_FD_1_FD16.VD_COM_Tx_AtmosphericPressureFailSts_WFD16, system-signal=SystemSignal_COM_Tx_AtmosphericPressureFailSts_WFD16}
        sender-receiver-to-signal-mapping={data-element=CPT_MDG1_FlatView.PP_COM_Tx_ENGINE_FD_1_FD16.VD_COM_Tx_AtmosphericPressure_W_FD16, system-signal=SystemSignal_COM_Tx_AtmosphericPressure_W_FD16}
        sender-receiver-to-signal-mapping={data-element=CPT_MDG1_FlatView.PP_COM_Tx_ENGINE_FD_1_FD16.VD_COM_Tx_CRC_ENGINE1_FD16, system-signal=SystemSignal_COM_Tx_CRC_ENGINE1_FD16}
        sender-receiver-to-signal-mapping={data-element=CPT_MDG1_FlatView.PP_COM_Tx_ENGINE_FD_1_FD16.VD_COM_Tx_EngMaxRPM_W_FD16, system-signal=SystemSignal_COM_Tx_EngMaxRPM_W_FD16}
        sender-receiver-to-signal-mapping={data-element=CPT_MDG1_FlatView.PP_COM_Tx_ENGINE_FD_1_FD16.VD_COM_Tx_MessageCounter_ENGINE1_FD16, system-signal=SystemSignal_COM_Tx_MessageCounter_ENGINE1_FD16}
        sender-receiver-to-signal-mapping={data-element=CPT_MDG1_FlatView.PP_COM_Tx_ENGINE_FD_1_FD16.VD_COM_Tx_ThermalManagementActive_W_FD16, system-signal=SystemSignal_COM_Tx_ThermalManagementActive_W_FD16}
        sender-receiver-to-signal-mapping={data-element=CPT_MDG1_FlatView.PP_COM_Tx_ENGINE_FD_1_FD16.VD_COM_Tx_TransWarmUpMin_RPM_FD16, system-signal=SystemSignal_COM_Tx_TransWarmUpMin_RPM_FD16}
        sender-receiver-to-signal-mapping={data-element=CPT_MDG1_FlatView.PP_COM_Tx_ENGINE_FD_1_FD16.VD_COM_Tx_TransWarmUpReq_FD16, system-signal=SystemSignal_COM_Tx_TransWarmUpReq_FD16}
        sender-receiver-to-signal-mapping={data-element=CPT_MDG1_FlatView.PP_COM_Tx_ENGINE_FD_1_FD16.VD_COM_Tx_VehicleSetSpeed_W_FD16, system-signal=SystemSignal_COM_Tx_VehicleSetSpeed_W_FD16}
        sender-receiver-to-signal-mapping={data-element=CPT_MDG1_FlatView.PP_COM_Tx_ENGINE_FD_3_FD16.VD_COM_Tx_CRC_ENGINE3_FD16, system-signal=SystemSignal_COM_Tx_CRC_ENGINE3_FD16}
        sender-receiver-to-signal-mapping={data-element=CPT_MDG1_FlatView.PP_COM_Tx_ENGINE_FD_3_FD16.VD_COM_Tx_MessageCounter_ENGINE3_FD16, system-signal=SystemSignal_COM_Tx_MessageCounter_ENGINE3_FD16}
        sender-receiver-to-signal-group-mapping={data-element=CPT_MDG1_FlatView.PP_COM_Tx_ENGINE_FD_3_FD16.VD_COM_Tx_ENGINE_FD_3_FD16, signal-group=SystemSignalGroup_COM_Tx_ENGINE_FD_3_FD16, type-mapping=sender-rec-record-type-mapping=record-element-mappings=[{application-record-element=CruiseControlLampSts_FD16, system-signal=SystemSignal_COM_Tx_CruiseControlLampSts_FD16}, {application-record-element=CruiseControlSts_FD16, system-signal=SystemSignal_COM_Tx_CruiseControlSts_FD16}, {application-record-element=EngineOilTemperature_FD16, system-signal=SystemSignal_COM_Tx_EngineOilTemperature_FD16}]}
        sender-receiver-to-signal-mapping={data-element=CPT_MDG1_FlatView.PP_COM_Tx_ENGINE_FD_6_FD16.VD_COM_Tx_CRC_ENGINE6_FD16, system-signal=SystemSignal_COM_Tx_CRC_ENGINE6_FD16}
        sender-receiver-to-signal-mapping={data-element=CPT_MDG1_FlatView.PP_COM_Tx_ENGINE_FD_6_FD16.VD_COM_Tx_EngineWaterTemp_FD16, system-signal=SystemSignal_COM_Tx_EngineWaterTemp_FD16}
        sender-receiver-to-signal-mapping={data-element=CPT_MDG1_FlatView.PP_COM_Tx_ENGINE_FD_6_FD16.VD_COM_Tx_MessageCounter_ENGINE6_FD16, system-signal=SystemSignal_COM_Tx_MessageCounter_ENGINE6_FD16}
        sender-receiver-to-signal-mapping={data-element=CPT_MDG1_FlatView.PP_COM_Tx_ENGINE_FD_6_FD16.VD_COM_Tx_Selector_SystemFailSts_FD16, system-signal=SystemSignal_COM_Tx_Selector_SystemFailSts_FD16}
        sender-receiver-to-signal-mapping={data-element=CPT_MDG1_FlatView.PP_COM_Tx_ENGINE_FD_6_FD16.VD_COM_Tx_StartRelayECMFeedbackFault_FD16, system-signal=SystemSignal_COM_Tx_StartRelayECMFeedbackFault_FD16}
        sender-receiver-to-signal-mapping={data-element=CPT_MDG1_FlatView.PP_COM_Tx_ENGINE_FD_6_FD16.VD_COM_Tx_TerrainModeDesiredStat_FD16, system-signal=SystemSignal_COM_Tx_TerrainModeDesiredStat_FD16}
        sender-receiver-to-signal-mapping={data-element=CPT_MDG1_FlatView.PP_COM_Tx_ENGINE_FD_6_FD16.VD_COM_Tx_TerrainModeStat_ECM_FD16, system-signal=SystemSignal_COM_Tx_TerrainModeStat_ECM_FD16}
        sender-receiver-to-signal-mapping={data-element=CPT_MDG1_FlatView.PP_COM_Tx_ENGINE_FD_6_FD16.VD_COM_Tx_Terrain_HMI_Rq_ECM_FD16, system-signal=SystemSignal_COM_Tx_Terrain_HMI_Rq_ECM_FD16}
        sender-receiver-to-signal-mapping={data-element=CPT_MDG1_FlatView.PP_COM_Tx_ENGINE_FD_6_FD16.VD_COM_Tx_Trns_DrvMdReq_ECM_FD16, system-signal=SystemSignal_COM_Tx_Trns_DrvMdReq_ECM_FD16}
        sender-receiver-to-signal-mapping={data-element=CPT_MDG1_FlatView.PP_COM_Tx_ENGINE_FD_7_FD16.VD_COM_Tx_CRC_ENGINE7_FD16, system-signal=SystemSignal_COM_Tx_CRC_ENGINE7_FD16}
        sender-receiver-to-signal-mapping={data-element=CPT_MDG1_FlatView.PP_COM_Tx_ENGINE_FD_7_FD16.VD_COM_Tx_MessageCounter_ENGINE7_FD16, system-signal=SystemSignal_COM_Tx_MessageCounter_ENGINE7_FD16}
        sender-receiver-to-signal-group-mapping={data-element=CPT_MDG1_FlatView.PP_COM_Tx_ENGINE_FD_7_FD16.VD_COM_Tx_ENGINE_FD_7_FD16, signal-group=SystemSignalGroup_COM_Tx_ENGINE_FD_7_FD16, type-mapping=sender-rec-record-type-mapping=record-element-mappings=[{application-record-element=CompressorSts_FD16, system-signal=SystemSignal_COM_Tx_CompressorSts_FD16}, {application-record-element=SpStDispstat_FD16, system-signal=SystemSignal_COM_Tx_SpStDispstat_FD16}, {application-record-element=SpStSwStat_FD16, system-signal=SystemSignal_COM_Tx_SpStSwStat_FD16}]}
        sender-receiver-to-signal-mapping={data-element=CPT_MDG1_FlatView.PP_COM_Tx_ENGINE_FD_8_FD16.VD_COM_Tx_CRC_ENGINE8_FD16, system-signal=SystemSignal_COM_Tx_CRC_ENGINE8_FD16}
        sender-receiver-to-signal-mapping={data-element=CPT_MDG1_FlatView.PP_COM_Tx_ENGINE_FD_8_FD16.VD_COM_Tx_MdsAct_FD16, system-signal=SystemSignal_COM_Tx_MdsAct_FD16}
        sender-receiver-to-signal-mapping={data-element=CPT_MDG1_FlatView.PP_COM_Tx_ENGINE_FD_8_FD16.VD_COM_Tx_MessageCounter_ENGINE8_FD16, system-signal=SystemSignal_COM_Tx_MessageCounter_ENGINE8_FD16}
        sender-receiver-to-signal-mapping={data-element=CPT_MDG1_FlatView.PP_COM_Tx_ENGINE_HYBD_FD_3_FD16.VD_COM_Tx_CRC_ENGINE_HYBD_FD_3_FD16, system-signal=SystemSignal_COM_Tx_CRC_ENGINE_HYBD_FD_3_FD16}
        sender-receiver-to-signal-mapping={data-element=CPT_MDG1_FlatView.PP_COM_Tx_ENGINE_HYBD_FD_3_FD16.VD_COM_Tx_EngCltTmpV_FD16, system-signal=SystemSignal_COM_Tx_EngCltTmpV_FD16}
        sender-receiver-to-signal-mapping={data-element=CPT_MDG1_FlatView.PP_COM_Tx_ENGINE_HYBD_FD_3_FD16.VD_COM_Tx_EngCltTmp_FD16, system-signal=SystemSignal_COM_Tx_EngCltTmp_FD16}
        sender-receiver-to-signal-mapping={data-element=CPT_MDG1_FlatView.PP_COM_Tx_ENGINE_HYBD_FD_3_FD16.VD_COM_Tx_EngSpd_FD16, system-signal=SystemSignal_COM_Tx_EngSpd_FD16}
        sender-receiver-to-signal-mapping={data-element=CPT_MDG1_FlatView.PP_COM_Tx_ENGINE_HYBD_FD_3_FD16.VD_COM_Tx_MC_ENGINE_HYBD_FD_3_FD16, system-signal=SystemSignal_COM_Tx_MC_ENGINE_HYBD_FD_3_FD16}
        sender-receiver-to-signal-mapping={data-element=CPT_MDG1_FlatView.PP_COM_Tx_ENGINE_HYBD_FD_3_FD16.VD_COM_Tx_MaxEngSpdCap_FD16, system-signal=SystemSignal_COM_Tx_MaxEngSpdCap_FD16}
        sender-receiver-to-signal-mapping={data-element=CPT_MDG1_FlatView.PP_COM_Tx_ENGINE_HYBD_FD_3_FD16.VD_COM_Tx_MinEngSpdCap_FD16, system-signal=SystemSignal_COM_Tx_MinEngSpdCap_FD16}
        sender-receiver-to-signal-mapping={data-element=CPT_MDG1_FlatView.PP_COM_Tx_ENGINE_HYBD_FD_3_FD16.VD_COM_Tx_ServiceHybSys_FD16, system-signal=SystemSignal_COM_Tx_ServiceHybSys_FD16}
        sender-receiver-to-signal-mapping={data-element=CPT_MDG1_FlatView.PP_COM_Tx_ENGINE_HYBD_FD_4_FD16.VD_COM_Tx_CRC_ENGINE_HYBD_FD_4_FD16, system-signal=SystemSignal_COM_Tx_CRC_ENGINE_HYBD_FD_4_FD16}
        sender-receiver-to-signal-mapping={data-element=CPT_MDG1_FlatView.PP_COM_Tx_ENGINE_HYBD_FD_4_FD16.VD_COM_Tx_EngTorqACCCapability_FD16, system-signal=SystemSignal_COM_Tx_EngTorqACCCapability_FD16}
        sender-receiver-to-signal-mapping={data-element=CPT_MDG1_FlatView.PP_COM_Tx_ENGINE_HYBD_FD_4_FD16.VD_COM_Tx_EngTorqCapbltyEngOpMd_FD16, system-signal=SystemSignal_COM_Tx_EngTorqCapbltyEngOpMd_FD16}
        sender-receiver-to-signal-mapping={data-element=CPT_MDG1_FlatView.PP_COM_Tx_ENGINE_HYBD_FD_4_FD16.VD_COM_Tx_EngTorqCapbltyFrmCntr_FD16, system-signal=SystemSignal_COM_Tx_EngTorqCapbltyFrmCntr_FD16}
        sender-receiver-to-signal-mapping={data-element=CPT_MDG1_FlatView.PP_COM_Tx_ENGINE_HYBD_FD_4_FD16.VD_COM_Tx_EngTorqCapbltyMaxOffTorq_FD16, system-signal=SystemSignal_COM_Tx_EngTorqCapbltyMaxOffTorq_FD16}
        sender-receiver-to-signal-mapping={data-element=CPT_MDG1_FlatView.PP_COM_Tx_ENGINE_HYBD_FD_4_FD16.VD_COM_Tx_EngTorqCapbltyMaxTorq_FD16, system-signal=SystemSignal_COM_Tx_EngTorqCapbltyMaxTorq_FD16}
        sender-receiver-to-signal-mapping={data-element=CPT_MDG1_FlatView.PP_COM_Tx_ENGINE_HYBD_FD_4_FD16.VD_COM_Tx_EngTorqCapbltyMinRunTorq_FD16, system-signal=SystemSignal_COM_Tx_EngTorqCapbltyMinRunTorq_FD16}
        sender-receiver-to-signal-mapping={data-element=CPT_MDG1_FlatView.PP_COM_Tx_ENGINE_HYBD_FD_4_FD16.VD_COM_Tx_EngTorqCapbltyMinTorq_FD16, system-signal=SystemSignal_COM_Tx_EngTorqCapbltyMinTorq_FD16}
        sender-receiver-to-signal-mapping={data-element=CPT_MDG1_FlatView.PP_COM_Tx_ENGINE_HYBD_FD_4_FD16.VD_COM_Tx_EngTorqCapbltyRefEngSpd_FD16, system-signal=SystemSignal_COM_Tx_EngTorqCapbltyRefEngSpd_FD16}
        sender-receiver-to-signal-mapping={data-element=CPT_MDG1_FlatView.PP_COM_Tx_ENGINE_HYBD_FD_4_FD16.VD_COM_Tx_MC_ENGINE_HYBD_FD_4_FD16, system-signal=SystemSignal_COM_Tx_MC_ENGINE_HYBD_FD_4_FD16}
        sender-receiver-to-signal-mapping={data-element=CPT_MDG1_FlatView.PP_COM_Tx_OBD_CONTENT_FRAME_FD16.VD_COM_Tx_AccelPdlPosn_OBD_FD16, system-signal=SystemSignal_COM_Tx_AccelPdlPosn_OBD_FD16}
        sender-receiver-to-signal-mapping={data-element=CPT_MDG1_FlatView.PP_COM_Tx_OBD_CONTENT_FRAME_FD16.VD_COM_Tx_CARB_PERM_FD16, system-signal=SystemSignal_COM_Tx_CARB_PERM_FD16}
        sender-receiver-to-signal-mapping={data-element=CPT_MDG1_FlatView.PP_COM_Tx_OBD_CONTENT_FRAME_FD16.VD_COM_Tx_CRC_OBDCONTENTFRAME_FD16, system-signal=SystemSignal_COM_Tx_CRC_OBDCONTENTFRAME_FD16}
        sender-receiver-to-signal-mapping={data-element=CPT_MDG1_FlatView.PP_COM_Tx_OBD_CONTENT_FRAME_FD16.VD_COM_Tx_CarbWarmUp_FD16, system-signal=SystemSignal_COM_Tx_CarbWarmUp_FD16}
        sender-receiver-to-signal-mapping={data-element=CPT_MDG1_FlatView.PP_COM_Tx_OBD_CONTENT_FRAME_FD16.VD_COM_Tx_CldStrtDenominator_FD16, system-signal=SystemSignal_COM_Tx_CldStrtDenominator_FD16}
        sender-receiver-to-signal-mapping={data-element=CPT_MDG1_FlatView.PP_COM_Tx_OBD_CONTENT_FRAME_FD16.VD_COM_Tx_EngOffTmPTV_FD16, system-signal=SystemSignal_COM_Tx_EngOffTmPTV_FD16}
        sender-receiver-to-signal-mapping={data-element=CPT_MDG1_FlatView.PP_COM_Tx_OBD_CONTENT_FRAME_FD16.VD_COM_Tx_EngOffTmPT_FD16, system-signal=SystemSignal_COM_Tx_EngOffTmPT_FD16}
        sender-receiver-to-signal-mapping={data-element=CPT_MDG1_FlatView.PP_COM_Tx_OBD_CONTENT_FRAME_FD16.VD_COM_Tx_EngineOFFTime_FD16, system-signal=SystemSignal_COM_Tx_EngineOFFTime_FD16}
        sender-receiver-to-signal-mapping={data-element=CPT_MDG1_FlatView.PP_COM_Tx_OBD_CONTENT_FRAME_FD16.VD_COM_Tx_GenDenominator_FD16, system-signal=SystemSignal_COM_Tx_GenDenominator_FD16}
        sender-receiver-to-signal-mapping={data-element=CPT_MDG1_FlatView.PP_COM_Tx_OBD_CONTENT_FRAME_FD16.VD_COM_Tx_IgnCntrTrue_FD16, system-signal=SystemSignal_COM_Tx_IgnCntrTrue_FD16}
        sender-receiver-to-signal-mapping={data-element=CPT_MDG1_FlatView.PP_COM_Tx_OBD_CONTENT_FRAME_FD16.VD_COM_Tx_Inp_ICC_Fail_FD16, system-signal=SystemSignal_COM_Tx_Inp_ICC_Fail_FD16}
        sender-receiver-to-signal-mapping={data-element=CPT_MDG1_FlatView.PP_COM_Tx_OBD_CONTENT_FRAME_FD16.VD_COM_Tx_InputsGDFail_FD16, system-signal=SystemSignal_COM_Tx_InputsGDFail_FD16}
        sender-receiver-to-signal-mapping={data-element=CPT_MDG1_FlatView.PP_COM_Tx_OBD_CONTENT_FRAME_FD16.VD_COM_Tx_LoadOBD_FD16, system-signal=SystemSignal_COM_Tx_LoadOBD_FD16}
        sender-receiver-to-signal-mapping={data-element=CPT_MDG1_FlatView.PP_COM_Tx_OBD_CONTENT_FRAME_FD16.VD_COM_Tx_MC_OBDCONTENTFRAME_FD16, system-signal=SystemSignal_COM_Tx_MC_OBDCONTENTFRAME_FD16}
        sender-receiver-to-signal-mapping={data-element=CPT_MDG1_FlatView.PP_COM_Tx_OBD_CONTENT_FRAME_FD16.VD_COM_Tx_OAT_PT_EstV_FD16, system-signal=SystemSignal_COM_Tx_OAT_PT_EstV_FD16}
        sender-receiver-to-signal-mapping={data-element=CPT_MDG1_FlatView.PP_COM_Tx_OBD_CONTENT_FRAME_FD16.VD_COM_Tx_OAT_PT_Est_FD16, system-signal=SystemSignal_COM_Tx_OAT_PT_Est_FD16}
      sw-mappings:
        swc to ecu mapping SwcToEcuMapping_0: ecu-instance=MDG1
          component:
            CPT_MDG1_FlatView.AC_CluRlyDigOutp
            CPT_MDG1_FlatView.AirCdngPSnsrAdcInpSwc
            CPT_MDG1_FlatView.AllGrPosnSnsr1PwmInp
            CPT_MDG1_FlatView.AllGrPosnSnsr2PwmInp
            CPT_MDG1_FlatView.AlterFieCtrlPwmOutp
            CPT_MDG1_FlatView.BoostTemp1AdcInpSwc
            CPT_MDG1_FlatView.BoostTemp2AdcInpSwc
            CPT_MDG1_FlatView.BrkPdlPosnSnsrAdcInp
            CPT_MDG1_FlatView.BrkSwDigInp
            CPT_MDG1_FlatView.CEGR_PosnSns
            CPT_MDG1_FlatView.CPT_BswM
            CPT_MDG1_FlatView.CPT_ComCIL_Adapt
            CPT_MDG1_FlatView.CPT_ComDia_Dcm_Rte_Adapter
            CPT_MDG1_FlatView.CPT_ComM
            CPT_MDG1_FlatView.CPT_ComScl_EngLin
            CPT_MDG1_FlatView.CPT_ComScl_EngLin_Scl
            CPT_MDG1_FlatView.CPT_ComScl_NetMtrx
            CPT_MDG1_FlatView.CPT_ComScl_NetMtrx2
            CPT_MDG1_FlatView.CPT_ComScl_NetMtrx2_Scl
            CPT_MDG1_FlatView.CPT_ComScl_NetMtrx3
            CPT_MDG1_FlatView.CPT_ComScl_NetMtrx3_Scl
            CPT_MDG1_FlatView.CPT_ComScl_NetMtrx_Scl
            CPT_MDG1_FlatView.CPT_Csm
            CPT_MDG1_FlatView.CPT_Dcm
            CPT_MDG1_FlatView.CPT_Dem
            CPT_MDG1_FlatView.CPT_Det
            CPT_MDG1_FlatView.CPT_ESC_EveCfg
            CPT_MDG1_FlatView.CPT_ESC_HwIntrptEveGen
            CPT_MDG1_FlatView.CPT_ESC_Ladp
            CPT_MDG1_FlatView.CPT_ESC_OsTskActvnHndlr
            CPT_MDG1_FlatView.CPT_EcuM
            CPT_MDG1_FlatView.CPT_Epm_Ladp
            CPT_MDG1_FlatView.CPT_FiM
            CPT_MDG1_FlatView.CPT_IoSigAdc_SwSStellantisParm
            CPT_MDG1_FlatView.CPT_IoSigDioInp_SwSStellantisParam
            CPT_MDG1_FlatView.CPT_IoSigDioOutp_SwSStellantisParam
            CPT_MDG1_FlatView.CPT_IoSigPwmInp_SwSStellantisParm
            CPT_MDG1_FlatView.CPT_IoSigPwmOutp_SwSStellantisParm
            CPT_MDG1_FlatView.CPT_KeyM
            CPT_MDG1_FlatView.CPT_NvM
            CPT_MDG1_FlatView.CPT_SWC_VcodProxi
            CPT_MDG1_FlatView.CPT_SecOC
            CPT_MDG1_FlatView.CPT_SentStack_SwSStellantisParm
            CPT_MDG1_FlatView.CPT_SysC_Ladp
            CPT_MDG1_FlatView.CPT_WdgM
            CPT_MDG1_FlatView.CPT_esc_stack
            CPT_MDG1_FlatView.CPT_esc_tasklink
            CPT_MDG1_FlatView.CPT_rba_DiagLib
            CPT_MDG1_FlatView.CPT_rba_IoDiagHbr
            CPT_MDG1_FlatView.CPT_rba_IoDiagHlfBr
            CPT_MDG1_FlatView.CPT_rba_IoDiagPs
            CPT_MDG1_FlatView.CPT_rba_IoDiagPwr
            CPT_MDG1_FlatView.CPT_rba_IoSigAdc
            CPT_MDG1_FlatView.CPT_rba_IoSigDio
            CPT_MDG1_FlatView.CPT_rba_IoSigHlfBr
            CPT_MDG1_FlatView.CPT_rba_IoSigIcu
            CPT_MDG1_FlatView.CPT_rba_IoSigObs
            CPT_MDG1_FlatView.CPT_rba_IoSigPwm
            CPT_MDG1_FlatView.CPT_rba_IoSigPwr
            CPT_MDG1_FlatView.CPT_rba_IoSigRtc
            CPT_MDG1_FlatView.CPT_rba_OsArSchedExtn_OS
            CPT_MDG1_FlatView.CPT_rba_OsShell
            CPT_MDG1_FlatView.CPT_rba_SyC_States
            CPT_MDG1_FlatView.CPT_rba_SyC_States_Cfg_0_Q_1
            CPT_MDG1_FlatView.CPT_rba_SyC_States_Cfg_1_B_1
            CPT_MDG1_FlatView.CPT_rba_SyC_States_Cfg_{1..3}_Q_1
            CPT_MDG1_FlatView.CPT_rbf_SftyHw_ErrMngtModl
            CPT_MDG1_FlatView.CPT_rbf_SftyHw_ProgFlowChk
            CPT_MDG1_FlatView.CPT_rbf_SftyHw_ShtOffPahPwrStg
            CPT_MDG1_FlatView.CPT_rbm_DSM_Conf
            CPT_MDG1_FlatView.CPT_rbm_MilHndlr
            CPT_MDG1_FlatView.CalInp1AdcInpSwc
            CPT_MDG1_FlatView.CalInp2AdcInpSwc
            CPT_MDG1_FlatView.CluInterLockSwDigInp
            CPT_MDG1_FlatView.CluSnsAdcInp
            CPT_MDG1_FlatView.CmprInletTempAdcInp
            CPT_MDG1_FlatView.CoEng_SwSStellantis
            CPT_MDG1_FlatView.ColdCrkCasePSnsrAdcInpSwc
            CPT_MDG1_FlatView.CoolEgrTAdcInpSwc
            CPT_MDG1_FlatView.Coolt3WayVlvAdcInpSwc
            CPT_MDG1_FlatView.CooltInletTempAdcInpSwc
            CPT_MDG1_FlatView.CrkBattMonrAdcInpSwc
            CPT_MDG1_FlatView.DMTLLkPmpDigOutp
            CPT_MDG1_FlatView.DP_VlvPosnSns
            CPT_MDG1_FlatView.DSM_SwSStellantis
            CPT_MDG1_FlatView.DualFuTankEnblRlyDigOutp
            CPT_MDG1_FlatView.DynoFuDsblReqSwDigInp
            CPT_MDG1_FlatView.ECM_WakeUpDigInp
            CPT_MDG1_FlatView.EGRCoolr_DeltAbsPresSnsr
            CPT_MDG1_FlatView.ELCM_ChgOvrVlvDigOutp
            CPT_MDG1_FlatView.ELCM_VacPmpPwmOutp
            CPT_MDG1_FlatView.ElecPhsrDiagPwmInp
            CPT_MDG1_FlatView.ElecPhsrMtrCmdOutpPwmOutp
            CPT_MDG1_FlatView.ElectcVacPmpRlyDigOutp
            CPT_MDG1_FlatView.EngCooltTAdcInpSwc
            CPT_MDG1_FlatView.EngSwtBattAdcInpSwc
            CPT_MDG1_FlatView.EnvP_SwSStellantis
            CPT_MDG1_FlatView.Epm_SwSStellantis
            CPT_MDG1_FlatView.Epm_SwSStellantis_PSwc
            CPT_MDG1_FlatView.EvapLkChkMonSnsAdcInpSwc
            CPT_MDG1_FlatView.FPCMFb1PwmInp
            CPT_MDG1_FlatView.FiveVoltAuxAdcInpSwc
            CPT_MDG1_FlatView.FiveVoltOutpAdcInpSwc
            CPT_MDG1_FlatView.FiveVoltSnsAdcInpSwc
            CPT_MDG1_FlatView.FuDoorDigOutp
            CPT_MDG1_FlatView.FuDoorSwDigInp
            CPT_MDG1_FlatView.FuPmpCtlMdul2CmdPwmOutp
            CPT_MDG1_FlatView.FuPmpCtlMdulCmdPwmOutp
            CPT_MDG1_FlatView.FuTankIsolnVlvDigOutp
            CPT_MDG1_FlatView.FuTankPSnsrAdcInpSwc
            CPT_MDG1_FlatView.GEVlv_SwSStellantis
            CPT_MDG1_FlatView.GPF_DeltAbsPresSnsr1
            CPT_MDG1_FlatView.GPF_DeltAbsPresSnsr2
            CPT_MDG1_FlatView.GdiFuRailP1AdcInpSwc
            CPT_MDG1_FlatView.GdiFuRailP2AdcInpSwc
            CPT_MDG1_FlatView.HTR_MeclWtrPmpActrPwmOutp
            CPT_MDG1_FlatView.HTR_TempCtrlVlvSolnPwmOutp
            CPT_MDG1_FlatView.Hbrdg_Coold_EGR
            CPT_MDG1_FlatView.Hbrdg_DP
            CPT_MDG1_FlatView.Hbrdg_ETC_Motor
            CPT_MDG1_FlatView.Hbrdg_VarGeomTrb
            CPT_MDG1_FlatView.Hbrdg_Wg1
            CPT_MDG1_FlatView.HiTRadrOutlTSnsrAdcInpSwc
            CPT_MDG1_FlatView.HoodAjarAdcInpSwc
            CPT_MDG1_FlatView.IgnCl_SwSStellantis
            CPT_MDG1_FlatView.IgnRunStrtSwDigInp
            CPT_MDG1_FlatView.InjSyG_SwSStellantis
            CPT_MDG1_FlatView.InjVvGPfi_SwSStellantis
            CPT_MDG1_FlatView.InjVvG_SwSStellantis
            CPT_MDG1_FlatView.InrushCircRlyDigOutp
            CPT_MDG1_FlatView.IntkAirTAdcInpSwc
            CPT_MDG1_FlatView.IoSigAdc_SwSStellantisParm
            CPT_MDG1_FlatView.IoSigDioInp_SwSStellantisParam
            CPT_MDG1_FlatView.IoSigDioOutp_SwSStellantisParam
            CPT_MDG1_FlatView.IoSigHbrdg_SwSStellantisParam
            CPT_MDG1_FlatView.IoSigIfAdapt_SwSStellantis
            CPT_MDG1_FlatView.IoSigPwmInp_SwSStellantisParm
            CPT_MDG1_FlatView.IoSigPwmOutp_SwSStellantisParm
            CPT_MDG1_FlatView.IoSigPwr_SwSStellantis
            CPT_MDG1_FlatView.KnDet_SwSStellantis
            CPT_MDG1_FlatView.LoPFuSnsrAdcInpSwc
            CPT_MDG1_FlatView.LoPresFuPmpRlyDigOutp
            CPT_MDG1_FlatView.MAF_Hum_Snsr
            CPT_MDG1_FlatView.MFVlv_SwSStellantis
            CPT_MDG1_FlatView.MaiRlyDigOutp
            CPT_MDG1_FlatView.MakeUpAirVlvDigOutp
            CPT_MDG1_FlatView.MnfldAirPAdcInpSwc
            CPT_MDG1_FlatView.MnfldGasTAdcInpSwc
            CPT_MDG1_FlatView.NVLD_SwDigInp
            CPT_MDG1_FlatView.O2Snsr_SwSStellantis
            CPT_MDG1_FlatView.OBD_PurgVentVlvDigOutp
            CPT_MDG1_FlatView.OilLvlSnsrPwmInp
            CPT_MDG1_FlatView.OilPSnsrAdcInpSwc
            CPT_MDG1_FlatView.OilShutOffValveFbAdcInp
            CPT_MDG1_FlatView.OilShutOffVlvDigOutp
            CPT_MDG1_FlatView.OilTSnsrAdcInpSwc
            CPT_MDG1_FlatView.PFIFuRailPressAdcInp
            CPT_MDG1_FlatView.PFIFuRailTempAdcInp
            CPT_MDG1_FlatView.PedlValSnsr1AdcInpSwc
            CPT_MDG1_FlatView.PedlValSnsr2AdcInpSwc
            CPT_MDG1_FlatView.PedlValSnsr2AuxAdcInpSwc
            CPT_MDG1_FlatView.PurgSoln2PwmOutp
            CPT_MDG1_FlatView.PurgSolnPwmOutp
            CPT_MDG1_FlatView.RadrFanCtrlPwmPwmOutp
            CPT_MDG1_FlatView.RadrFanRlyHiSpdDigOutp
            CPT_MDG1_FlatView.ReAxleTempSnsrAdcInp
            CPT_MDG1_FlatView.SecdAirPmpRlyDigOutp
            CPT_MDG1_FlatView.SecdAirShutOffSoln1DigOutp
            CPT_MDG1_FlatView.SentStack_SwSStellantisParm
            CPT_MDG1_FlatView.SrgSoln1DigOutp
            CPT_MDG1_FlatView.SrgSoln2DigOutp
            CPT_MDG1_FlatView.StrtrRlyDigOutp
            CPT_MDG1_FlatView.StrtrRlyFbDigInp
            CPT_MDG1_FlatView.SwilEngMnt1DigOutp
            CPT_MDG1_FlatView.SwilEngMnt2DigOutp
            CPT_MDG1_FlatView.SysU12VoltAdcInpSwc
            CPT_MDG1_FlatView.TOH_ShutOffVlvDigOutp
            CPT_MDG1_FlatView.ThrIntkGasTAdcInpSwc
            CPT_MDG1_FlatView.ThrIntkPAdcInpSwc
            CPT_MDG1_FlatView.ThrPosnSnsr1AdcInpSwc
            CPT_MDG1_FlatView.ThrPosnSnsr2AdcInpSwc
            CPT_MDG1_FlatView.VapBlockingVlvDigOutp
            CPT_MDG1_FlatView.VarGeomTrbFb
            CPT_MDG1_FlatView.VarOilSolnPwmOutp
            CPT_MDG1_FlatView.VvtExh1PwmOutp
            CPT_MDG1_FlatView.VvtIntk1PwmOutp
            CPT_MDG1_FlatView.WgPosn1AdcInpSwc
            CPT_MDG1_FlatView.WgPosn2AdcInpSwc
            CPT_MDG1_FlatView.WgSolnPwmOutp
    root-software-compositions:
      root sw composition prototype CPT_MDG1_FlatView: flat-map=MDG1_FlatMap, software-composition=MDG1_FlatView
