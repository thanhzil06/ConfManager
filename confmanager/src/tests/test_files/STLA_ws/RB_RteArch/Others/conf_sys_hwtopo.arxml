AUTOSAR XML (schema 4-0-2)
package /RB/PT/PCFG_SYS/EcuInstances
  ecu instance MDG1
