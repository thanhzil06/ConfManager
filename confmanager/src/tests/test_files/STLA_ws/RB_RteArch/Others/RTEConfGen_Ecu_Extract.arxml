AUTOSAR XML (schema 00050)
package /RB/PT/PCFG_ECU
  system MDG1_EXTR: category=ECU_EXTRACT
    system mapping SYSMPG_MDG1
      sw-impl-mappings:
        144 x swc to impl mapping:
          SwcToImplMapping_ATS_Std: component-implementation=Impl_ATS_Std, component=CPT_MDG1_FlatView.CPT_ATS_Std
          SwcToImplMapping_AVS_Std: component-implementation=Impl_AVS_Std, component=CPT_MDG1_FlatView.CPT_AVS_Std
          SwcToImplMapping_BGTHDEV: component-implementation=Impl_BGTHDEV, component=CPT_MDG1_FlatView.CPT_BGTHDEV
          SwcToImplMapping_CDShdG_GTMLib: component-implementation=Impl_CDShdG_GTMLib, component=CPT_MDG1_FlatView.CPT_CDShdG_GTMLib
          SwcToImplMapping_CoEng_ObdSig: component-implementation=Impl_CoEng_ObdSig, component=CPT_MDG1_FlatView.CPT_CoEng_ObdSig
          SwcToImplMapping_CoEng_StAdpr: component-implementation=Impl_CoEng_StAdpr, component=CPT_MDG1_FlatView.CPT_CoEng_StAdpr
          SwcToImplMapping_CoEng_StEng: component-implementation=Impl_CoEng_StEng, component=CPT_MDG1_FlatView.CPT_CoEng_StEng
          SwcToImplMapping_ComCo_Lyr: component-implementation=Impl_ComCo_Lyr, component=CPT_MDG1_FlatView.CPT_ComCo_Lyr
          SwcToImplMapping_ComPtc: component-implementation=Impl_ComPtc, component=CPT_MDG1_FlatView.CPT_ComPtc
          SwcToImplMapping_ComScl_Appl: component-implementation=Impl_ComScl_Appl, component=CPT_MDG1_FlatView.CPT_ComScl_Appl
          SwcToImplMapping_DEVE: component-implementation=Impl_DEVE, component=CPT_MDG1_FlatView.CPT_DEVE
          SwcToImplMapping_DSM_Conf: component-implementation=Impl_DSM_Conf, component=CPT_MDG1_FlatView.CPT_DSM_Conf
          SwcToImplMapping_DcmDspUDS_DID: component-implementation=Impl_DcmDspUDS_DID, component=CPT_MDG1_FlatView.CPT_DcmDspUDS_DID
          SwcToImplMapping_DcmDspUDS_SecA: component-implementation=Impl_DcmDspUDS_SecA, component=CPT_MDG1_FlatView.CPT_DcmDspUDS_SecA
          SwcToImplMapping_DevLib_PwrStgState: component-implementation=Impl_DevLib_PwrStgState, component=CPT_MDG1_FlatView.CPT_DevLib_PwrStgState
          SwcToImplMapping_EGSHeatr_Acttn: component-implementation=Impl_EGSHeatr_Acttn, component=CPT_MDG1_FlatView.CPT_EGSHeatr_Acttn
          SwcToImplMapping_EGSHeatr_Ctrl: component-implementation=Impl_EGSHeatr_Ctrl, component=CPT_MDG1_FlatView.CPT_EGSHeatr_Ctrl
          SwcToImplMapping_EGSHeatr_DiagPrfmnc: component-implementation=Impl_EGSHeatr_DiagPrfmnc, component=CPT_MDG1_FlatView.CPT_EGSHeatr_DiagPrfmnc
          SwcToImplMapping_EGSHeatr_DiagWire: component-implementation=Impl_EGSHeatr_DiagWire, component=CPT_MDG1_FlatView.CPT_EGSHeatr_DiagWire
          SwcToImplMapping_EGSHeatr_SnsrCoorn: component-implementation=Impl_EGSHeatr_SnsrCoorn, component=CPT_MDG1_FlatView.CPT_EGSHeatr_SnsrCoorn
          SwcToImplMapping_EGSHeatr_SnsrTMdl: component-implementation=Impl_EGSHeatr_SnsrTMdl, component=CPT_MDG1_FlatView.CPT_EGSHeatr_SnsrTMdl
          SwcToImplMapping_EGSHeatr_TiHeatrOff: component-implementation=Impl_EGSHeatr_TiHeatrOff, component=CPT_MDG1_FlatView.CPT_EGSHeatr_TiHeatrOff
          SwcToImplMapping_ETC_Std: component-implementation=Impl_ETC_Std, component=CPT_MDG1_FlatView.CPT_ETC_Std
          SwcToImplMapping_EngDa_PwrEng: component-implementation=Impl_EngDa_PwrEng, component=CPT_MDG1_FlatView.CPT_EngDa_PwrEng
          SwcToImplMapping_EnvP_DD: component-implementation=Impl_EnvP_DD, component=CPT_MDG1_FlatView.CPT_EnvP_DD
          SwcToImplMapping_EnvP_VDDiag: component-implementation=Impl_EnvP_VDDiag, component=CPT_MDG1_FlatView.CPT_EnvP_VDDiag
          SwcToImplMapping_EpmBCr_IntrCo: component-implementation=Impl_EpmBCr_IntrCo, component=CPT_MDG1_FlatView.CPT_EpmBCr_IntrCo
          SwcToImplMapping_EpmBCr_Pos: component-implementation=Impl_EpmBCr_Pos, component=CPT_MDG1_FlatView.CPT_EpmBCr_Pos
          SwcToImplMapping_EpmCaS_Adap: component-implementation=Impl_EpmCaS_Adap, component=CPT_MDG1_FlatView.CPT_EpmCaS_Adap
          SwcToImplMapping_EpmCaS_Diag: component-implementation=Impl_EpmCaS_Diag, component=CPT_MDG1_FlatView.CPT_EpmCaS_Diag
          SwcToImplMapping_EpmCaS_Meas: component-implementation=Impl_EpmCaS_Meas, component=CPT_MDG1_FlatView.CPT_EpmCaS_Meas
          SwcToImplMapping_EpmCaS_OfsDiag: component-implementation=Impl_EpmCaS_OfsDiag, component=CPT_MDG1_FlatView.CPT_EpmCaS_OfsDiag
          SwcToImplMapping_EpmCaS_RelsSigEvln: component-implementation=Impl_EpmCaS_RelsSigEvln, component=CPT_MDG1_FlatView.CPT_EpmCaS_RelsSigEvln
          SwcToImplMapping_EpmCaS_Seg: component-implementation=Impl_EpmCaS_Seg, component=CPT_MDG1_FlatView.CPT_EpmCaS_Seg
          SwcToImplMapping_EpmCaS_Spd: component-implementation=Impl_EpmCaS_Spd, component=CPT_MDG1_FlatView.CPT_EpmCaS_Spd
          SwcToImplMapping_EpmCaS_SyncnPatTi: component-implementation=Impl_EpmCaS_SyncnPatTi, component=CPT_MDG1_FlatView.CPT_EpmCaS_SyncnPatTi
          SwcToImplMapping_EpmCrS_Diag: component-implementation=Impl_EpmCrS_Diag, component=CPT_MDG1_FlatView.CPT_EpmCrS_Diag
          SwcToImplMapping_EpmCrS_RevCnt: component-implementation=Impl_EpmCrS_RevCnt, component=CPT_MDG1_FlatView.CPT_EpmCrS_RevCnt
          SwcToImplMapping_EpmCrS_Seg: component-implementation=Impl_EpmCrS_Seg, component=CPT_MDG1_FlatView.CPT_EpmCrS_Seg
          SwcToImplMapping_EpmCrS_Spd: component-implementation=Impl_EpmCrS_Spd, component=CPT_MDG1_FlatView.CPT_EpmCrS_Spd
          SwcToImplMapping_EpmErr_Trace: component-implementation=Impl_EpmErr_Trace, component=CPT_MDG1_FlatView.CPT_EpmErr_Trace
          SwcToImplMapping_EpmHAgClk_Gen: component-implementation=Impl_EpmHAgClk_Gen, component=CPT_MDG1_FlatView.CPT_EpmHAgClk_Gen
          SwcToImplMapping_EpmHCaS_SigEval: component-implementation=Impl_EpmHCaS_SigEval, component=CPT_MDG1_FlatView.CPT_EpmHCaS_SigEval
          SwcToImplMapping_EpmHCrS_IntHndlr: component-implementation=Impl_EpmHCrS_IntHndlr, component=CPT_MDG1_FlatView.CPT_EpmHCrS_IntHndlr
          SwcToImplMapping_EpmIf_Imprt: component-implementation=Impl_EpmIf_Imprt, component=CPT_MDG1_FlatView.CPT_EpmIf_Imprt
          SwcToImplMapping_EpmRRS_AgDetect: component-implementation=Impl_EpmRRS_AgDetect, component=CPT_MDG1_FlatView.CPT_EpmRRS_AgDetect
          SwcToImplMapping_EpmRRS_StopDetect: component-implementation=Impl_EpmRRS_StopDetect, component=CPT_MDG1_FlatView.CPT_EpmRRS_StopDetect
          SwcToImplMapping_EpmSeq_EveHndlr: component-implementation=Impl_EpmSeq_EveHndlr, component=CPT_MDG1_FlatView.CPT_EpmSeq_EveHndlr
          SwcToImplMapping_EpmSeq_StateMn: component-implementation=Impl_EpmSeq_StateMn, component=CPT_MDG1_FlatView.CPT_EpmSeq_StateMn
          SwcToImplMapping_EpmSrv_Lib: component-implementation=Impl_EpmSrv_Lib, component=CPT_MDG1_FlatView.CPT_EpmSrv_Lib
          SwcToImplMapping_EpmSyn_CaSPos: component-implementation=Impl_EpmSyn_CaSPos, component=CPT_MDG1_FlatView.CPT_EpmSyn_CaSPos
          SwcToImplMapping_EpmSyn_CrSPos: component-implementation=Impl_EpmSyn_CrSPos, component=CPT_MDG1_FlatView.CPT_EpmSyn_CrSPos
          SwcToImplMapping_EpmTDC_Corrn: component-implementation=Impl_EpmTDC_Corrn, component=CPT_MDG1_FlatView.CPT_EpmTDC_Corrn
          SwcToImplMapping_Epm_CustAdp: component-implementation=Impl_Epm_CustAdp, component=CPT_MDG1_FlatView.CPT_Epm_CustAdp
          SwcToImplMapping_Epm_Ini: component-implementation=Impl_Epm_Ini, component=CPT_MDG1_FlatView.CPT_Epm_Ini
          SwcToImplMapping_Epm_OpMode: component-implementation=Impl_Epm_OpMode, component=CPT_MDG1_FlatView.CPT_Epm_OpMode
          SwcToImplMapping_Epm_Spd: component-implementation=Impl_Epm_Spd, component=CPT_MDG1_FlatView.CPT_Epm_Spd
          SwcToImplMapping_Epm_SpdFeat: component-implementation=Impl_Epm_SpdFeat, component=CPT_MDG1_FlatView.CPT_Epm_SpdFeat
          SwcToImplMapping_Epm_SpdGrd: component-implementation=Impl_Epm_SpdGrd, component=CPT_MDG1_FlatView.CPT_Epm_SpdGrd
          SwcToImplMapping_FEL_EvapSysIfAdp: component-implementation=Impl_FEL_EvapSysIfAdp, component=CPT_MDG1_FlatView.CPT_FEL_EvapSysIfAdp
          SwcToImplMapping_GlbDaAdapt_Adapt: component-implementation=Impl_GlbDaAdapt_Adapt, component=CPT_MDG1_FlatView.CPT_GlbDaAdapt_Adapt
          SwcToImplMapping_GlbDa_ECUOnTime: component-implementation=Impl_GlbDa_ECUOnTime, component=CPT_MDG1_FlatView.CPT_GlbDa_ECUOnTime
          SwcToImplMapping_GlbDa_VinMngt: component-implementation=Impl_GlbDa_VinMngt, component=CPT_MDG1_FlatView.CPT_GlbDa_VinMngt
          SwcToImplMapping_HEGO_Htg: component-implementation=Impl_HEGO_Htg, component=CPT_MDG1_FlatView.CPT_HEGO_Htg
          SwcToImplMapping_HEGO_OBDElec: component-implementation=Impl_HEGO_OBDElec, component=CPT_MDG1_FlatView.CPT_HEGO_OBDElec
          SwcToImplMapping_HEGO_Sens: component-implementation=Impl_HEGO_Sens, component=CPT_MDG1_FlatView.CPT_HEGO_Sens
          SwcToImplMapping_IVGdiCtl_CvoAdpn: component-implementation=Impl_IVGdiCtl_CvoAdpn, component=CPT_MDG1_FlatView.CPT_IVGdiCtl_CvoAdpn
          SwcToImplMapping_IVGdiCtl_CvoCsersPlausyDiag: component-implementation=Impl_IVGdiCtl_CvoCsersPlausyDiag, component=CPT_MDG1_FlatView.CPT_IVGdiCtl_CvoCsersPlausyDiag
          SwcToImplMapping_IVGdiCtl_CvoDiag: component-implementation=Impl_IVGdiCtl_CvoDiag, component=CPT_MDG1_FlatView.CPT_IVGdiCtl_CvoDiag
          SwcToImplMapping_IVGdiCtl_CvoSigAcq: component-implementation=Impl_IVGdiCtl_CvoSigAcq, component=CPT_MDG1_FlatView.CPT_IVGdiCtl_CvoSigAcq
          SwcToImplMapping_IVGdiCtl_CvoSigEvln: component-implementation=Impl_IVGdiCtl_CvoSigEvln, component=CPT_MDG1_FlatView.CPT_IVGdiCtl_CvoSigEvln
          SwcToImplMapping_IVGdiCtl_CvoSimnErr: component-implementation=Impl_IVGdiCtl_CvoSimnErr, component=CPT_MDG1_FlatView.CPT_IVGdiCtl_CvoSimnErr
          SwcToImplMapping_IgCPrimI_AcqnAdc: component-implementation=Impl_IgCPrimI_AcqnAdc, component=CPT_MDG1_FlatView.CPT_IgCPrimI_AcqnAdc
          SwcToImplMapping_IgnClPs_Dia: component-implementation=Impl_IgnClPs_Dia, component=CPT_MDG1_FlatView.CPT_IgnClPs_Dia
          SwcToImplMapping_IgnCoilDiagCoorn: component-implementation=Impl_IgnCoilDiagCoorn, component=CPT_MDG1_FlatView.CPT_IgnCoilDiagCoorn
          SwcToImplMapping_IgnDD_Calcn: component-implementation=Impl_IgnDD_Calcn, component=CPT_MDG1_FlatView.CPT_IgnDD_Calcn
          SwcToImplMapping_IgnDD_ModCtrlr: component-implementation=Impl_IgnDD_ModCtrlr, component=CPT_MDG1_FlatView.CPT_IgnDD_ModCtrlr
          SwcToImplMapping_InjDDGdi: component-implementation=Impl_InjDDGdi, component=CPT_MDG1_FlatView.CPT_InjDDGdi
          SwcToImplMapping_InjDDPfi: component-implementation=Impl_InjDDPfi, component=CPT_MDG1_FlatView.CPT_InjDDPfi
          SwcToImplMapping_InjSyG_AdpnCdnCvo: component-implementation=Impl_InjSyG_AdpnCdnCvo, component=CPT_MDG1_FlatView.CPT_InjSyG_AdpnCdnCvo
          SwcToImplMapping_InjSyG_CalcCnvnFac: component-implementation=Impl_InjSyG_CalcCnvnFac, component=CPT_MDG1_FlatView.CPT_InjSyG_CalcCnvnFac
          SwcToImplMapping_InjSyG_CoCvo: component-implementation=Impl_InjSyG_CoCvo, component=CPT_MDG1_FlatView.CPT_InjSyG_CoCvo
          SwcToImplMapping_InjSyG_DdIf: component-implementation=Impl_InjSyG_DdIf, component=CPT_MDG1_FlatView.CPT_InjSyG_DdIf
          SwcToImplMapping_InjSyG_InjTi: component-implementation=Impl_InjSyG_InjTi, component=CPT_MDG1_FlatView.CPT_InjSyG_InjTi
          SwcToImplMapping_InjSyG_InjTmngAdpr: component-implementation=Impl_InjSyG_InjTmngAdpr, component=CPT_MDG1_FlatView.CPT_InjSyG_InjTmngAdpr
          SwcToImplMapping_InjSyG_SpCvo: component-implementation=Impl_InjSyG_SpCvo, component=CPT_MDG1_FlatView.CPT_InjSyG_SpCvo
          SwcToImplMapping_InjVlvPs_ConCJ: component-implementation=Impl_InjVlvPs_ConCJ, component=CPT_MDG1_FlatView.CPT_InjVlvPs_ConCJ
          SwcToImplMapping_InjVlvPs_Dia: component-implementation=Impl_InjVlvPs_Dia, component=CPT_MDG1_FlatView.CPT_InjVlvPs_Dia
          SwcToImplMapping_Inm_MonNode: component-implementation=Impl_Inm_MonNode, component=CPT_MDG1_FlatView.CPT_Inm_MonNode
          SwcToImplMapping_IoSigSwAdpr_SwSStellantis: component-implementation=Impl_IoSigSwAdpr_SwSStellantis, component=CPT_MDG1_FlatView.CPT_IoSigSwAdpr_SwSStellantis
          SwcToImplMapping_KONCW: component-implementation=Impl_KONCW, component=CPT_MDG1_FlatView.CPT_KONCW
          SwcToImplMapping_KnDetControl: component-implementation=Impl_KnDetControl, component=CPT_MDG1_FlatView.CPT_KnDetControl
          SwcToImplMapping_KnDetLTest: component-implementation=Impl_KnDetLTest, component=CPT_MDG1_FlatView.CPT_KnDetLTest
          SwcToImplMapping_KnDetSigEval: component-implementation=Impl_KnDetSigEval, component=CPT_MDG1_FlatView.CPT_KnDetSigEval
          SwcToImplMapping_MRly_Vld2Lcy: component-implementation=Impl_MRly_Vld2Lcy, component=CPT_MDG1_FlatView.CPT_MRly_Vld2Lcy
          SwcToImplMapping_MfDD: component-implementation=Impl_MfDD, component=CPT_MDG1_FlatView.CPT_MfDD
          SwcToImplMapping_MfPsDia: component-implementation=Impl_MfPsDia, component=CPT_MDG1_FlatView.CPT_MfPsDia
          SwcToImplMapping_MfPs_ConCY: component-implementation=Impl_MfPs_ConCY, component=CPT_MDG1_FlatView.CPT_MfPs_ConCY
          SwcToImplMapping_MoCADC_Co: component-implementation=Impl_MoCADC_Co, component=CPT_MDG1_FlatView.CPT_MoCADC_Co
          SwcToImplMapping_MoCMPU_Co: component-implementation=Impl_MoCMPU_Co, component=CPT_MDG1_FlatView.CPT_MoCMPU_Co
          SwcToImplMapping_MoExe_Co: component-implementation=Impl_MoExe_Co, component=CPT_MDG1_FlatView.CPT_MoExe_Co
          SwcToImplMapping_MoXEMM_Co: component-implementation=Impl_MoXEMM_Co, component=CPT_MDG1_FlatView.CPT_MoXEMM_Co
          SwcToImplMapping_OCWDA_Co: component-implementation=Impl_OCWDA_Co, component=CPT_MDG1_FlatView.CPT_OCWDA_Co
          SwcToImplMapping_OilCmbdSen_DD: component-implementation=Impl_OilCmbdSen_DD, component=CPT_MDG1_FlatView.CPT_OilCmbdSen_DD
          SwcToImplMapping_Reset_CallBack: component-implementation=Impl_Reset_CallBack, component=CPT_MDG1_FlatView.CPT_Reset_CallBack
          SwcToImplMapping_SWAdp: component-implementation=Impl_SWAdp, component=CPT_MDG1_FlatView.CPT_SWAdp
          SwcToImplMapping_SWC_ComCIL_Adapt: component-implementation=IMPL_ComCIL_Adapt, component=CPT_MDG1_FlatView.CPT_ComCIL_Adapt
          SwcToImplMapping_SYNTIZW: component-implementation=Impl_SYNTIZW, component=CPT_MDG1_FlatView.CPT_SYNTIZW
          SwcToImplMapping_SrvB: component-implementation=Impl_SrvB, component=CPT_MDG1_FlatView.CPT_SrvB
          SwcToImplMapping_SyC_Vld2Lcy: component-implementation=Impl_SyC_Vld2Lcy, component=CPT_MDG1_FlatView.CPT_SyC_Vld2Lcy
          SwcToImplMapping_T15_Vld2Lcy: component-implementation=Impl_T15_Vld2Lcy, component=CPT_MDG1_FlatView.CPT_T15_Vld2Lcy
          SwcToImplMapping_UEGO_Dac: component-implementation=Impl_UEGO_Dac, component=CPT_MDG1_FlatView.CPT_UEGO_Dac
          SwcToImplMapping_UEGO_DiagRels: component-implementation=Impl_UEGO_DiagRels, component=CPT_MDG1_FlatView.CPT_UEGO_DiagRels
          SwcToImplMapping_UEGO_DiagSigEcuAsic: component-implementation=Impl_UEGO_DiagSigEcuAsic, component=CPT_MDG1_FlatView.CPT_UEGO_DiagSigEcuAsic
          SwcToImplMapping_UEGO_DiagSigOperPlaus: component-implementation=Impl_UEGO_DiagSigOperPlaus, component=CPT_MDG1_FlatView.CPT_UEGO_DiagSigOperPlaus
          SwcToImplMapping_UEGO_DiagSigSnsr: component-implementation=Impl_UEGO_DiagSigSnsr, component=CPT_MDG1_FlatView.CPT_UEGO_DiagSigSnsr
          SwcToImplMapping_UEGO_DiagSigWireOl: component-implementation=Impl_UEGO_DiagSigWireOl, component=CPT_MDG1_FlatView.CPT_UEGO_DiagSigWireOl
          SwcToImplMapping_UEGO_DiagSigWireSc: component-implementation=Impl_UEGO_DiagSigWireSc, component=CPT_MDG1_FlatView.CPT_UEGO_DiagSigWireSc
          SwcToImplMapping_UEGO_ICntct: component-implementation=Impl_UEGO_ICntct, component=CPT_MDG1_FlatView.CPT_UEGO_ICntct
          SwcToImplMapping_UEGO_IPmpPck: component-implementation=Impl_UEGO_IPmpPck, component=CPT_MDG1_FlatView.CPT_UEGO_IPmpPck
          SwcToImplMapping_UEGO_IPmpRef: component-implementation=Impl_UEGO_IPmpRef, component=CPT_MDG1_FlatView.CPT_UEGO_IPmpRef
          SwcToImplMapping_UEGO_IPmpSeg: component-implementation=Impl_UEGO_IPmpSeg, component=CPT_MDG1_FlatView.CPT_UEGO_IPmpSeg
          SwcToImplMapping_UEGO_ISrc: component-implementation=Impl_UEGO_ISrc, component=CPT_MDG1_FlatView.CPT_UEGO_ISrc
          SwcToImplMapping_UEGO_ModCtrl: component-implementation=Impl_UEGO_ModCtrl, component=CPT_MDG1_FlatView.CPT_UEGO_ModCtrl
          SwcToImplMapping_UEGO_O2: component-implementation=Impl_UEGO_O2, component=CPT_MDG1_FlatView.CPT_UEGO_O2
          SwcToImplMapping_UEGO_O2Ref: component-implementation=Impl_UEGO_O2Ref, component=CPT_MDG1_FlatView.CPT_UEGO_O2Ref
          SwcToImplMapping_UEGO_OperRels: component-implementation=Impl_UEGO_OperRels, component=CPT_MDG1_FlatView.CPT_UEGO_OperRels
          SwcToImplMapping_UEGO_OperRelsExtInhb: component-implementation=Impl_UEGO_OperRelsExtInhb, component=CPT_MDG1_FlatView.CPT_UEGO_OperRelsExtInhb
          SwcToImplMapping_UEGO_RCmp: component-implementation=Impl_UEGO_RCmp, component=CPT_MDG1_FlatView.CPT_UEGO_RCmp
          SwcToImplMapping_UEGO_RNernst: component-implementation=Impl_UEGO_RNernst, component=CPT_MDG1_FlatView.CPT_UEGO_RNernst
          SwcToImplMapping_UEGO_RPmp: component-implementation=Impl_UEGO_RPmp, component=CPT_MDG1_FlatView.CPT_UEGO_RPmp
          SwcToImplMapping_UEGO_TCeramic: component-implementation=Impl_UEGO_TCeramic, component=CPT_MDG1_FlatView.CPT_UEGO_TCeramic
          SwcToImplMapping_UEGO_Tstr: component-implementation=Impl_UEGO_Tstr, component=CPT_MDG1_FlatView.CPT_UEGO_Tstr
          SwcToImplMapping_UEGO_UNernst: component-implementation=Impl_UEGO_UNernst, component=CPT_MDG1_FlatView.CPT_UEGO_UNernst
          SwcToImplMapping_UEGO_UPmp: component-implementation=Impl_UEGO_UPmp, component=CPT_MDG1_FlatView.CPT_UEGO_UPmp
          SwcToImplMapping_XcpAppl: component-implementation=Impl_XcpAppl, component=CPT_MDG1_FlatView.CPT_XcpAppl
          SwcToImplMapping_dcmcore_dsldsd_appl: component-implementation=Impl_dcmcore_dsldsd_appl, component=CPT_MDG1_FlatView.CPT_dcmcore_dsldsd_appl
          SwcToImplMapping_rba_EepAdaptDGS: component=CPT_MDG1_FlatView.CPT_rba_EepAdaptDGS
          SwcToImplMapping_rba_MemDiag: component=CPT_MDG1_FlatView.CPT_rba_MemDiag
          SwcToImplMapping_rba_OsArSchedExtn: component=CPT_MDG1_FlatView.CPT_rba_OsArSchedExtn
          SwcToImplMapping_rba_OsArSchedExtn_OS: component=CPT_MDG1_FlatView.CPT_rba_OsArSchedExtn_OS
          SwcToImplMapping_rba_OsArSchedExtn_mcop: component-implementation=Impl_rba_OsArSchedExtn_mcop, component=CPT_MDG1_FlatView.CPT_rba_OsArSchedExtn_mcop
          SwcToImplMapping_rba_OsShell_Event: component-implementation=Impl_rba_OsShell_Event, component=CPT_MDG1_FlatView.CPT_rba_OsShell_Event
          SwcToImplMapping_rba_Svbb: component-implementation=Impl_rba_Svbb, component=CPT_MDG1_FlatView.CPT_rba_Svbb
      sw-mappings:
        swc to ecu mapping SwcToEcuMapping_MSR2AR: ecu-instance=MDG1
          component:
            CPT_MDG1_FlatView.CPT_ATS_Std
            CPT_MDG1_FlatView.CPT_AVS_Std
            CPT_MDG1_FlatView.CPT_BGTHDEV
            CPT_MDG1_FlatView.CPT_CDShdG_GTMLib
            CPT_MDG1_FlatView.CPT_CoEng_ObdSig
            CPT_MDG1_FlatView.CPT_CoEng_StAdpr
            CPT_MDG1_FlatView.CPT_CoEng_StEng
            CPT_MDG1_FlatView.CPT_ComCo_Lyr
            CPT_MDG1_FlatView.CPT_ComPtc
            CPT_MDG1_FlatView.CPT_ComScl_Appl
            CPT_MDG1_FlatView.CPT_DEVE
            CPT_MDG1_FlatView.CPT_DSM_Conf
            CPT_MDG1_FlatView.CPT_DcmDspUDS_DID
            CPT_MDG1_FlatView.CPT_DcmDspUDS_SecA
            CPT_MDG1_FlatView.CPT_DevLib_PwrStgState
            CPT_MDG1_FlatView.CPT_EGSHeatr_Acttn
            CPT_MDG1_FlatView.CPT_EGSHeatr_Ctrl
            CPT_MDG1_FlatView.CPT_EGSHeatr_DiagPrfmnc
            CPT_MDG1_FlatView.CPT_EGSHeatr_DiagWire
            CPT_MDG1_FlatView.CPT_EGSHeatr_SnsrCoorn
            CPT_MDG1_FlatView.CPT_EGSHeatr_SnsrTMdl
            CPT_MDG1_FlatView.CPT_EGSHeatr_TiHeatrOff
            CPT_MDG1_FlatView.CPT_ETC_Std
            CPT_MDG1_FlatView.CPT_EngDa_PwrEng
            CPT_MDG1_FlatView.CPT_EnvP_DD
            CPT_MDG1_FlatView.CPT_EnvP_VDDiag
            CPT_MDG1_FlatView.CPT_EpmBCr_IntrCo
            CPT_MDG1_FlatView.CPT_EpmBCr_Pos
            CPT_MDG1_FlatView.CPT_EpmCaS_Adap
            CPT_MDG1_FlatView.CPT_EpmCaS_Diag
            CPT_MDG1_FlatView.CPT_EpmCaS_Meas
            CPT_MDG1_FlatView.CPT_EpmCaS_OfsDiag
            CPT_MDG1_FlatView.CPT_EpmCaS_RelsSigEvln
            CPT_MDG1_FlatView.CPT_EpmCaS_Seg
            CPT_MDG1_FlatView.CPT_EpmCaS_Spd
            CPT_MDG1_FlatView.CPT_EpmCaS_SyncnPatTi
            CPT_MDG1_FlatView.CPT_EpmCrS_Diag
            CPT_MDG1_FlatView.CPT_EpmCrS_RevCnt
            CPT_MDG1_FlatView.CPT_EpmCrS_Seg
            CPT_MDG1_FlatView.CPT_EpmCrS_Spd
            CPT_MDG1_FlatView.CPT_EpmErr_Trace
            CPT_MDG1_FlatView.CPT_EpmHAgClk_Gen
            CPT_MDG1_FlatView.CPT_EpmHCaS_SigEval
            CPT_MDG1_FlatView.CPT_EpmHCrS_IntHndlr
            CPT_MDG1_FlatView.CPT_EpmIf_Imprt
            CPT_MDG1_FlatView.CPT_EpmRRS_AgDetect
            CPT_MDG1_FlatView.CPT_EpmRRS_StopDetect
            CPT_MDG1_FlatView.CPT_EpmSeq_EveHndlr
            CPT_MDG1_FlatView.CPT_EpmSeq_StateMn
            CPT_MDG1_FlatView.CPT_EpmSrv_Lib
            CPT_MDG1_FlatView.CPT_EpmSyn_CaSPos
            CPT_MDG1_FlatView.CPT_EpmSyn_CrSPos
            CPT_MDG1_FlatView.CPT_EpmTDC_Corrn
            CPT_MDG1_FlatView.CPT_Epm_CustAdp
            CPT_MDG1_FlatView.CPT_Epm_Ini
            CPT_MDG1_FlatView.CPT_Epm_OpMode
            CPT_MDG1_FlatView.CPT_Epm_Spd
            CPT_MDG1_FlatView.CPT_Epm_SpdFeat
            CPT_MDG1_FlatView.CPT_Epm_SpdGrd
            CPT_MDG1_FlatView.CPT_FEL_EvapSysIfAdp
            CPT_MDG1_FlatView.CPT_GlbDaAdapt_Adapt
            CPT_MDG1_FlatView.CPT_GlbDa_ECUOnTime
            CPT_MDG1_FlatView.CPT_GlbDa_VinMngt
            CPT_MDG1_FlatView.CPT_HEGO_Htg
            CPT_MDG1_FlatView.CPT_HEGO_OBDElec
            CPT_MDG1_FlatView.CPT_HEGO_Sens
            CPT_MDG1_FlatView.CPT_IVGdiCtl_CvoAdpn
            CPT_MDG1_FlatView.CPT_IVGdiCtl_CvoCsersPlausyDiag
            CPT_MDG1_FlatView.CPT_IVGdiCtl_CvoDiag
            CPT_MDG1_FlatView.CPT_IVGdiCtl_CvoSigAcq
            CPT_MDG1_FlatView.CPT_IVGdiCtl_CvoSigEvln
            CPT_MDG1_FlatView.CPT_IVGdiCtl_CvoSimnErr
            CPT_MDG1_FlatView.CPT_IgCPrimI_AcqnAdc
            CPT_MDG1_FlatView.CPT_IgnClPs_Dia
            CPT_MDG1_FlatView.CPT_IgnCoilDiagCoorn
            CPT_MDG1_FlatView.CPT_IgnDD_Calcn
            CPT_MDG1_FlatView.CPT_IgnDD_ModCtrlr
            CPT_MDG1_FlatView.CPT_InjDDGdi
            CPT_MDG1_FlatView.CPT_InjDDPfi
            CPT_MDG1_FlatView.CPT_InjSyG_AdpnCdnCvo
            CPT_MDG1_FlatView.CPT_InjSyG_CalcCnvnFac
            CPT_MDG1_FlatView.CPT_InjSyG_CoCvo
            CPT_MDG1_FlatView.CPT_InjSyG_DdIf
            CPT_MDG1_FlatView.CPT_InjSyG_InjTi
            CPT_MDG1_FlatView.CPT_InjSyG_InjTmngAdpr
            CPT_MDG1_FlatView.CPT_InjSyG_SpCvo
            CPT_MDG1_FlatView.CPT_InjVlvPs_ConCJ
            CPT_MDG1_FlatView.CPT_InjVlvPs_Dia
            CPT_MDG1_FlatView.CPT_Inm_MonNode
            CPT_MDG1_FlatView.CPT_IoSigSwAdpr_SwSStellantis
            CPT_MDG1_FlatView.CPT_KONCW
            CPT_MDG1_FlatView.CPT_KnDetControl
            CPT_MDG1_FlatView.CPT_KnDetLTest
            CPT_MDG1_FlatView.CPT_KnDetSigEval
            CPT_MDG1_FlatView.CPT_MRly_Vld2Lcy
            CPT_MDG1_FlatView.CPT_MfDD
            CPT_MDG1_FlatView.CPT_MfPsDia
            CPT_MDG1_FlatView.CPT_MfPs_ConCY
            CPT_MDG1_FlatView.CPT_MoCADC_Co
            CPT_MDG1_FlatView.CPT_MoCMPU_Co
            CPT_MDG1_FlatView.CPT_MoExe_Co
            CPT_MDG1_FlatView.CPT_MoXEMM_Co
            CPT_MDG1_FlatView.CPT_OCWDA_Co
            CPT_MDG1_FlatView.CPT_OilCmbdSen_DD
            CPT_MDG1_FlatView.CPT_Reset_CallBack
            CPT_MDG1_FlatView.CPT_SWAdp
            CPT_MDG1_FlatView.CPT_SYNTIZW
            CPT_MDG1_FlatView.CPT_SrvB
            CPT_MDG1_FlatView.CPT_SyC_Vld2Lcy
            CPT_MDG1_FlatView.CPT_T15_Vld2Lcy
            CPT_MDG1_FlatView.CPT_UEGO_Dac
            CPT_MDG1_FlatView.CPT_UEGO_DiagRels
            CPT_MDG1_FlatView.CPT_UEGO_DiagSigEcuAsic
            CPT_MDG1_FlatView.CPT_UEGO_DiagSigOperPlaus
            CPT_MDG1_FlatView.CPT_UEGO_DiagSigSnsr
            CPT_MDG1_FlatView.CPT_UEGO_DiagSigWireOl
            CPT_MDG1_FlatView.CPT_UEGO_DiagSigWireSc
            CPT_MDG1_FlatView.CPT_UEGO_ICntct
            CPT_MDG1_FlatView.CPT_UEGO_IPmpPck
            CPT_MDG1_FlatView.CPT_UEGO_IPmpRef
            CPT_MDG1_FlatView.CPT_UEGO_IPmpSeg
            CPT_MDG1_FlatView.CPT_UEGO_ISrc
            CPT_MDG1_FlatView.CPT_UEGO_ModCtrl
            CPT_MDG1_FlatView.CPT_UEGO_O2
            CPT_MDG1_FlatView.CPT_UEGO_O2Ref
            CPT_MDG1_FlatView.CPT_UEGO_OperRels
            CPT_MDG1_FlatView.CPT_UEGO_OperRelsExtInhb
            CPT_MDG1_FlatView.CPT_UEGO_RCmp
            CPT_MDG1_FlatView.CPT_UEGO_RNernst
            CPT_MDG1_FlatView.CPT_UEGO_RPmp
            CPT_MDG1_FlatView.CPT_UEGO_TCeramic
            CPT_MDG1_FlatView.CPT_UEGO_Tstr
            CPT_MDG1_FlatView.CPT_UEGO_UNernst
            CPT_MDG1_FlatView.CPT_UEGO_UPmp
            CPT_MDG1_FlatView.CPT_XcpAppl
            CPT_MDG1_FlatView.CPT_dcmcore_dsldsd_appl
            CPT_MDG1_FlatView.CPT_rba_EepAdaptDGS
            CPT_MDG1_FlatView.CPT_rba_MemDiag
            CPT_MDG1_FlatView.CPT_rba_OsArSchedExtn
            CPT_MDG1_FlatView.CPT_rba_OsArSchedExtn_mcop
            CPT_MDG1_FlatView.CPT_rba_OsShell_Event
            CPT_MDG1_FlatView.CPT_rba_Svbb
