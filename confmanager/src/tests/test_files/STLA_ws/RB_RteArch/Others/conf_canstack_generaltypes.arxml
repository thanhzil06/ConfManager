AUTOSAR XML (schema 4-2-2)
package /AUTOSAR_Can_GeneralTypes/ImplementationDataTypes
  7 x impl type, all with type-emitter=HEADER_FILE:
    Can_IdType: category=VALUE, base-type=uint32, compu {0..0x400007FF=Standard32Bit, 0..0xDFFFFFFF=Extended32Bit}  # Represents the Identifier of an L-PDU. The two most significant bits specify the frame type: 00 CAN message with Standard CAN ID 01 CAN FD frame with Standard CAN ID 10 CAN message with Extended CAN ID 11 CAN FD frame with Extended CAN ID
    Can_PduType: category=STRUCTURE  # This type unites PduId (swPduHandle), SduLength (length), SduData (sdu), and CanId (id) for any CAN L-SDU.
      4 x element:
        sdu: category=DATA_REFERENCE, sw-pointer-target-props={target-category=VALUE, base-type=uint8}
        id: implementation-data-type=Can_IdType
        swPduHandle: implementation-data-type=PduIdType
        length: implementation-data-type=uint8
    Can_ControllerStateType: compu {0=CANIF_CS_SLEEP (The CAN controller is in SLEEP mode and can be woken up by an internal(SW) request or by a network event(This must be supported by CAN hardware.).), 1=CANIF_CS_STARTED (The CAN controller is in full-operational mode.), 2=CANIF_CS_STOPPED (The CAN controller is halted and does not operate on the network.), 3=CANIF_CS_UNINIT (UNINIT mode. Default mode of each CAN controller after power on.)}, implementation-data-type=uint8  # Operating modes of a CAN controller.
    Can_StateTransitionType: category=VALUE, base-type=uint8, compu {0=CAN_T_START (CAN controller transition value to request state STARTED.), 1=CAN_T_STOP (CAN controller transition value to request state STOPPED.), 2..0=CAN_T_SLEEP (CAN controller transition value to request state SLEEP.), 3=CAN_T_WAKEUP (CAN controller transition value to request state STOPPED from state SLEEP.)}  # State transitions that are used by the function CAN_SetControllerMode
    Can_ReturnType: category=VALUE, base-type=uint8, compu {0=CAN_OK (success.), 1=CAN_NOT_OK (error occurred or wakeup event occurred during sleep transition.), 2=CAN_BUSY (transmit request could not be processed because no transmit object was available.)}  # Return values of CAN driver API .
    Can_HwHandleType: category=VALUE, base-type=uint32, compu {0..0x0FF=Standard, 0..0xFFFF=Extended}  # Represents the hardware object handles of a CAN hardware unit. For CAN hardware units with more than 255 HW objects use extended range.
    Can_HwType: category=STRUCTURE  # This type defines a data structure which clearly provides an Hardware Object Handle including its corresponding CAN Controller and therefore CanDrv as well as the specific CanId.
      element CanId: implementation-data-type=Can_IdType
      element Hoh: implementation-data-type=Can_HwHandleType
      element ControllerId: implementation-data-type=uint8
