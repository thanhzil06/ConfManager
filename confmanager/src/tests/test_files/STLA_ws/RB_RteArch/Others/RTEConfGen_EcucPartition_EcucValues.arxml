AUTOSAR XML (schema 00050)
package /RB/UBK/Project/EcucModuleConfigurationValuess
  module config EcuC
    EcucPartitionCollection
      10 x EcucPartition, all with EcucPartitionSoftwareComponentInstanceRef=CPT_rba_OsArSchedExtn:
        EcucPartition_OsApp_0_A_1: EcucPartitionSoftwareComponentInstanceRef=CPT_rba_OsArSchedExtn_OS, EcucPartitionSoftwareComponentInstanceRef=CPT_rba_OsArSchedExtn_mcop
        EcucPartition_OsApp_0_B_1: EcucPartitionSoftwareComponentInstanceRef=CPT_SWAdp, EcucPartitionSoftwareComponentInstanceRef=CPT_MoExe_Co, EcucPartitionSoftwareComponentInstanceRef=CPT_FiM, EcucPartitionSoftwareComponentInstanceRef=CPT_rba_OsArSchedExtn_OS, EcucPartitionSoftwareComponentInstanceRef=CPT_Dem, EcucPartitionSoftwareComponentInstanceRef=CPT_rba_OsArSchedExtn_mcop
        EcucPartition_OsApp_0_Q_1: EcucPartitionSoftwareComponentInstanceRef=CPT_rba_EepAdaptDGS, EcucPartitionSoftwareComponentInstanceRef=CPT_SWAdp, EcucPartitionSoftwareComponentInstanceRef=CPT_esc_stack, EcucPartitionSoftwareComponentInstanceRef=CPT_MoExe_Co, EcucPartitionSoftwareComponentInstanceRef=CPT_ComScl_NetMtrx2_Scl, EcucPartitionSoftwareComponentInstanceRef=CPT_rba_OsArSchedExtn_OS, EcucPartitionSoftwareComponentInstanceRef=CPT_Dem, EcucPartitionSoftwareComponentInstanceRef=CPT_rba_Svbb, EcucPartitionSoftwareComponentInstanceRef=CPT_rba_SyC_States_Cfg_0_Q_1, EcucPartitionSoftwareComponentInstanceRef=CPT_Epm_SpdFeat, EcucPartitionSoftwareComponentInstanceRef=CPT_ComScl_NetMtrx3_Scl, EcucPartitionSoftwareComponentInstanceRef=CPT_ATS_Std, EcucPartitionSoftwareComponentInstanceRef=CPT_rba_OsArSchedExtn_mcop, EcucPartitionSoftwareComponentInstanceRef=CPT_MoCMPU_Co, EcucPartitionSoftwareComponentInstanceRef=CPT_T15_Vld2Lcy, EcucPartitionSoftwareComponentInstanceRef=CPT_ComCIL_Adapt, EcucPartitionSoftwareComponentInstanceRef=CPT_ComScl_NetMtrx_Scl, EcucPartitionSoftwareComponentInstanceRef=CPT_Epm_CustAdp, EcucPartitionSoftwareComponentInstanceRef=CPT_ComPtc
        EcucPartition_OsApp_1_A_1
        EcucPartition_OsApp_1_B_1: EcucPartitionSoftwareComponentInstanceRef=CPT_rba_SyC_States_Cfg_1_B_1, EcucPartitionSoftwareComponentInstanceRef=CPT_rbf_SftyHw_ErrMngtModl, EcucPartitionSoftwareComponentInstanceRef=CPT_MoExe_Co, EcucPartitionSoftwareComponentInstanceRef=CPT_Dem, EcucPartitionSoftwareComponentInstanceRef=CPT_rba_OsArSchedExtn_mcop, EcucPartitionSoftwareComponentInstanceRef=CPT_MoCMPU_Co, EcucPartitionSoftwareComponentInstanceRef=CPT_MoCADC_Co, EcucPartitionSoftwareComponentInstanceRef=CPT_rba_OsShell
        EcucPartition_OsApp_1_Q_1: EcucPartitionSoftwareComponentInstanceRef=CPT_UEGO_ISrc, EcucPartitionSoftwareComponentInstanceRef=DualFuTankEnblRlyDigOutp, EcucPartitionSoftwareComponentInstanceRef=AllGrPosnSnsr2PwmInp, EcucPartitionSoftwareComponentInstanceRef=CPT_CoEng_StEng, EcucPartitionSoftwareComponentInstanceRef=CPT_UEGO_DiagSigWireOl, EcucPartitionSoftwareComponentInstanceRef=CPT_ComScl_EngLin_Scl, EcucPartitionSoftwareComponentInstanceRef=CPT_EpmHAgClk_Gen, EcucPartitionSoftwareComponentInstanceRef=CPT_rba_EepAdaptDGS, EcucPartitionSoftwareComponentInstanceRef=CluInterLockSwDigInp, EcucPartitionSoftwareComponentInstanceRef=CPT_EGSHeatr_SnsrCoorn, EcucPartitionSoftwareComponentInstanceRef=CPT_EpmCaS_Spd, EcucPartitionSoftwareComponentInstanceRef=CPT_esc_tasklink, EcucPartitionSoftwareComponentInstanceRef=SwilEngMnt2DigOutp, EcucPartitionSoftwareComponentInstanceRef=SecdAirPmpRlyDigOutp, EcucPartitionSoftwareComponentInstanceRef=FiveVoltOutpAdcInpSwc, EcucPartitionSoftwareComponentInstanceRef=HiTRadrOutlTSnsrAdcInpSwc, EcucPartitionSoftwareComponentInstanceRef=PFIFuRailTempAdcInp, EcucPartitionSoftwareComponentInstanceRef=MnfldGasTAdcInpSwc, EcucPartitionSoftwareComponentInstanceRef=DynoFuDsblReqSwDigInp, EcucPartitionSoftwareComponentInstanceRef=CPT_Inm_MonNode, EcucPartitionSoftwareComponentInstanceRef=CPT_EpmCaS_Meas, EcucPartitionSoftwareComponentInstanceRef=CPT_IgCPrimI_AcqnAdc, EcucPartitionSoftwareComponentInstanceRef=CPT_rba_MemDiag, EcucPartitionSoftwareComponentInstanceRef=CPT_InjSyG_InjTi, EcucPartitionSoftwareComponentInstanceRef=CPT_EpmCaS_RelsSigEvln, EcucPartitionSoftwareComponentInstanceRef=CPT_EpmSyn_CaSPos, EcucPartitionSoftwareComponentInstanceRef=CPT_BGTHDEV, EcucPartitionSoftwareComponentInstanceRef=FuDoorDigOutp, EcucPartitionSoftwareComponentInstanceRef=CPT_XcpAppl, EcucPartitionSoftwareComponentInstanceRef=CrkBattMonrAdcInpSwc, EcucPartitionSoftwareComponentInstanceRef=CPT_DEVE, EcucPartitionSoftwareComponentInstanceRef=GdiFuRailP1AdcInpSwc, EcucPartitionSoftwareComponentInstanceRef=CPT_EpmCrS_RevCnt, EcucPartitionSoftwareComponentInstanceRef=VvtExh1PwmOutp, EcucPartitionSoftwareComponentInstanceRef=FPCMFb1PwmInp, EcucPartitionSoftwareComponentInstanceRef=IoSigPwr_SwSStellantis, EcucPartitionSoftwareComponentInstanceRef=CPT_HEGO_OBDElec, EcucPartitionSoftwareComponentInstanceRef=HTR_TempCtrlVlvSolnPwmOutp, EcucPartitionSoftwareComponentInstanceRef=CPT_Epm_SpdGrd, EcucPartitionSoftwareComponentInstanceRef=CPT_ESC_HwIntrptEveGen, EcucPartitionSoftwareComponentInstanceRef=CPT_CoEng_ObdSig, EcucPartitionSoftwareComponentInstanceRef=ElecPhsrMtrCmdOutpPwmOutp, EcucPartitionSoftwareComponentInstanceRef=HoodAjarAdcInpSwc, EcucPartitionSoftwareComponentInstanceRef=PedlValSnsr2AuxAdcInpSwc, EcucPartitionSoftwareComponentInstanceRef=CPT_SWAdp, EcucPartitionSoftwareComponentInstanceRef=CPT_EpmBCr_Pos, EcucPartitionSoftwareComponentInstanceRef=CPT_UEGO_UNernst, EcucPartitionSoftwareComponentInstanceRef=CPT_EnvP_DD, EcucPartitionSoftwareComponentInstanceRef=CPT_HEGO_Htg, EcucPartitionSoftwareComponentInstanceRef=Hbrdg_Coold_EGR, EcucPartitionSoftwareComponentInstanceRef=CPT_EpmIf_Imprt, EcucPartitionSoftwareComponentInstanceRef=MaiRlyDigOutp, EcucPartitionSoftwareComponentInstanceRef=BoostTemp1AdcInpSwc, EcucPartitionSoftwareComponentInstanceRef=Hbrdg_Wg1, EcucPartitionSoftwareComponentInstanceRef=CPT_CDShdG_GTMLib, EcucPartitionSoftwareComponentInstanceRef=PedlValSnsr2AdcInpSwc, EcucPartitionSoftwareComponentInstanceRef=MakeUpAirVlvDigOutp, EcucPartitionSoftwareComponentInstanceRef=GEVlv_SwSStellantis, EcucPartitionSoftwareComponentInstanceRef=PurgSoln2PwmOutp, EcucPartitionSoftwareComponentInstanceRef=DSM_SwSStellantis, EcucPartitionSoftwareComponentInstanceRef=RadrFanRlyHiSpdDigOutp, EcucPartitionSoftwareComponentInstanceRef=OilLvlSnsrPwmInp, EcucPartitionSoftwareComponentInstanceRef=ECM_WakeUpDigInp, EcucPartitionSoftwareComponentInstanceRef=CPT_EpmTDC_Corrn, EcucPartitionSoftwareComponentInstanceRef=CalInp2AdcInpSwc, EcucPartitionSoftwareComponentInstanceRef=CPT_InjSyG_CoCvo, EcucPartitionSoftwareComponentInstanceRef=CPT_esc_stack, EcucPartitionSoftwareComponentInstanceRef=CPT_MoExe_Co, EcucPartitionSoftwareComponentInstanceRef=AirCdngPSnsrAdcInpSwc, EcucPartitionSoftwareComponentInstanceRef=PedlValSnsr1AdcInpSwc, EcucPartitionSoftwareComponentInstanceRef=OilShutOffVlvDigOutp, EcucPartitionSoftwareComponentInstanceRef=PFIFuRailPressAdcInp, EcucPartitionSoftwareComponentInstanceRef=CPT_EpmRRS_AgDetect, EcucPartitionSoftwareComponentInstanceRef=ELCM_ChgOvrVlvDigOutp, EcucPartitionSoftwareComponentInstanceRef=CPT_EpmCaS_Diag, EcucPartitionSoftwareComponentInstanceRef=CPT_Epm_OpMode, EcucPartitionSoftwareComponentInstanceRef=CPT_ESC_OsTskActvnHndlr, EcucPartitionSoftwareComponentInstanceRef=CPT_IgnDD_Calcn, EcucPartitionSoftwareComponentInstanceRef=CPT_KONCW, EcucPartitionSoftwareComponentInstanceRef=CPT_MoXEMM_Co, EcucPartitionSoftwareComponentInstanceRef=ElectcVacPmpRlyDigOutp, EcucPartitionSoftwareComponentInstanceRef=InrushCircRlyDigOutp, EcucPartitionSoftwareComponentInstanceRef=ElecPhsrDiagPwmInp, EcucPartitionSoftwareComponentInstanceRef=CPT_rba_OsArSchedExtn_OS, EcucPartitionSoftwareComponentInstanceRef=HTR_MeclWtrPmpActrPwmOutp, EcucPartitionSoftwareComponentInstanceRef=CPT_UEGO_DiagSigWireSc, EcucPartitionSoftwareComponentInstanceRef=CalInp1AdcInpSwc, EcucPartitionSoftwareComponentInstanceRef=IgnRunStrtSwDigInp, EcucPartitionSoftwareComponentInstanceRef=NVLD_SwDigInp, EcucPartitionSoftwareComponentInstanceRef=CPT_Dem, EcucPartitionSoftwareComponentInstanceRef=CPT_rba_SyC_States_Cfg_1_Q_1, EcucPartitionSoftwareComponentInstanceRef=CPT_InjVlvPs_Dia, EcucPartitionSoftwareComponentInstanceRef=CPT_EGSHeatr_DiagPrfmnc, EcucPartitionSoftwareComponentInstanceRef=CPT_SYNTIZW, EcucPartitionSoftwareComponentInstanceRef=EngSwtBattAdcInpSwc, EcucPartitionSoftwareComponentInstanceRef=OilPSnsrAdcInpSwc, EcucPartitionSoftwareComponentInstanceRef=CPT_GlbDa_VinMngt, EcucPartitionSoftwareComponentInstanceRef=OilTSnsrAdcInpSwc, EcucPartitionSoftwareComponentInstanceRef=IgnCl_SwSStellantis, EcucPartitionSoftwareComponentInstanceRef=CPT_DcmDspUDS_SecA, EcucPartitionSoftwareComponentInstanceRef=CPT_UEGO_OperRelsExtInhb, EcucPartitionSoftwareComponentInstanceRef=LoPresFuPmpRlyDigOutp, EcucPartitionSoftwareComponentInstanceRef=CPT_IoSigSwAdpr_SwSStellantis, EcucPartitionSoftwareComponentInstanceRef=AllGrPosnSnsr1PwmInp, EcucPartitionSoftwareComponentInstanceRef=InjSyG_SwSStellantis, EcucPartitionSoftwareComponentInstanceRef=WgSolnPwmOutp, EcucPartitionSoftwareComponentInstanceRef=BrkPdlPosnSnsrAdcInp, EcucPartitionSoftwareComponentInstanceRef=CPT_InjDDGdi, EcucPartitionSoftwareComponentInstanceRef=CPT_Reset_CallBack, EcucPartitionSoftwareComponentInstanceRef=FiveVoltSnsAdcInpSwc, EcucPartitionSoftwareComponentInstanceRef=CmprInletTempAdcInp, EcucPartitionSoftwareComponentInstanceRef=CPT_rba_OsShell_Event, EcucPartitionSoftwareComponentInstanceRef=CPT_rba_Svbb, EcucPartitionSoftwareComponentInstanceRef=InjVvGPfi_SwSStellantis, EcucPartitionSoftwareComponentInstanceRef=CPT_DcmDspUDS_DID, EcucPartitionSoftwareComponentInstanceRef=CPT_EpmCaS_Adap, EcucPartitionSoftwareComponentInstanceRef=InjVvG_SwSStellantis, EcucPartitionSoftwareComponentInstanceRef=CPT_IVGdiCtl_CvoAdpn, EcucPartitionSoftwareComponentInstanceRef=CPT_IVGdiCtl_CvoDiag, EcucPartitionSoftwareComponentInstanceRef=CPT_IgnDD_ModCtrlr, EcucPartitionSoftwareComponentInstanceRef=AlterFieCtrlPwmOutp, EcucPartitionSoftwareComponentInstanceRef=CPT_GlbDa_ECUOnTime, EcucPartitionSoftwareComponentInstanceRef=Hbrdg_VarGeomTrb, EcucPartitionSoftwareComponentInstanceRef=CPT_DevLib_PwrStgState, EcucPartitionSoftwareComponentInstanceRef=VarGeomTrbFb, EcucPartitionSoftwareComponentInstanceRef=CPT_EpmCrS_Seg, EcucPartitionSoftwareComponentInstanceRef=Coolt3WayVlvAdcInpSwc, EcucPartitionSoftwareComponentInstanceRef=FuPmpCtlMdulCmdPwmOutp, EcucPartitionSoftwareComponentInstanceRef=CPT_Epm_SpdFeat, EcucPartitionSoftwareComponentInstanceRef=RadrFanCtrlPwmPwmOutp, EcucPartitionSoftwareComponentInstanceRef=CPT_EpmBCr_IntrCo, EcucPartitionSoftwareComponentInstanceRef=OilShutOffValveFbAdcInp, EcucPartitionSoftwareComponentInstanceRef=EvapLkChkMonSnsAdcInpSwc, EcucPartitionSoftwareComponentInstanceRef=CPT_EpmHCrS_IntHndlr, EcucPartitionSoftwareComponentInstanceRef=CPT_InjSyG_DdIf, EcucPartitionSoftwareComponentInstanceRef=FuTankIsolnVlvDigOutp, EcucPartitionSoftwareComponentInstanceRef=CPT_InjDDPfi, EcucPartitionSoftwareComponentInstanceRef=CPT_EpmRRS_StopDetect, EcucPartitionSoftwareComponentInstanceRef=CPT_FEL_EvapSysIfAdp, EcucPartitionSoftwareComponentInstanceRef=WgPosn2AdcInpSwc, EcucPartitionSoftwareComponentInstanceRef=CPT_IVGdiCtl_CvoSigAcq, EcucPartitionSoftwareComponentInstanceRef=MnfldAirPAdcInpSwc, EcucPartitionSoftwareComponentInstanceRef=StrtrRlyDigOutp, EcucPartitionSoftwareComponentInstanceRef=ReAxleTempSnsrAdcInp, EcucPartitionSoftwareComponentInstanceRef=SwilEngMnt1DigOutp, EcucPartitionSoftwareComponentInstanceRef=WgPosn1AdcInpSwc, EcucPartitionSoftwareComponentInstanceRef=CPT_EGSHeatr_Ctrl, EcucPartitionSoftwareComponentInstanceRef=BoostTemp2AdcInpSwc, EcucPartitionSoftwareComponentInstanceRef=CPT_dcmcore_dsldsd_appl, EcucPartitionSoftwareComponentInstanceRef=EngCooltTAdcInpSwc, EcucPartitionSoftwareComponentInstanceRef=CPT_UEGO_O2Ref, EcucPartitionSoftwareComponentInstanceRef=ThrIntkGasTAdcInpSwc, EcucPartitionSoftwareComponentInstanceRef=CEGR_PosnSns, EcucPartitionSoftwareComponentInstanceRef=CPT_SyC_Vld2Lcy, EcucPartitionSoftwareComponentInstanceRef=CPT_IgnCoilDiagCoorn, EcucPartitionSoftwareComponentInstanceRef=SecdAirShutOffSoln1DigOutp, EcucPartitionSoftwareComponentInstanceRef=CPT_ESC_EveCfg, EcucPartitionSoftwareComponentInstanceRef=CPT_InjSyG_SpCvo, EcucPartitionSoftwareComponentInstanceRef=CPT_UEGO_O2, EcucPartitionSoftwareComponentInstanceRef=GdiFuRailP2AdcInpSwc, EcucPartitionSoftwareComponentInstanceRef=ThrPosnSnsr1AdcInpSwc, EcucPartitionSoftwareComponentInstanceRef=CPT_MfDD, EcucPartitionSoftwareComponentInstanceRef=CPT_OilCmbdSen_DD, EcucPartitionSoftwareComponentInstanceRef=CPT_InjSyG_InjTmngAdpr, EcucPartitionSoftwareComponentInstanceRef=CPT_UEGO_DiagSigSnsr, EcucPartitionSoftwareComponentInstanceRef=CPT_MfPsDia, EcucPartitionSoftwareComponentInstanceRef=CPT_Epm_Spd, EcucPartitionSoftwareComponentInstanceRef=FiveVoltAuxAdcInpSwc, EcucPartitionSoftwareComponentInstanceRef=CPT_EpmSeq_StateMn, EcucPartitionSoftwareComponentInstanceRef=VapBlockingVlvDigOutp, EcucPartitionSoftwareComponentInstanceRef=CPT_ESC_Ladp, EcucPartitionSoftwareComponentInstanceRef=CPT_CoEng_StAdpr, EcucPartitionSoftwareComponentInstanceRef=CPT_EpmHCaS_SigEval, EcucPartitionSoftwareComponentInstanceRef=FuPmpCtlMdul2CmdPwmOutp, EcucPartitionSoftwareComponentInstanceRef=CPT_EngDa_PwrEng, EcucPartitionSoftwareComponentInstanceRef=CPT_IVGdiCtl_CvoSimnErr, EcucPartitionSoftwareComponentInstanceRef=CPT_UEGO_ModCtrl, EcucPartitionSoftwareComponentInstanceRef=LoPFuSnsrAdcInpSwc, EcucPartitionSoftwareComponentInstanceRef=ThrIntkPAdcInpSwc, EcucPartitionSoftwareComponentInstanceRef=CPT_EpmCaS_Seg, EcucPartitionSoftwareComponentInstanceRef=CPT_SysC_Ladp, EcucPartitionSoftwareComponentInstanceRef=CPT_HEGO_Sens, EcucPartitionSoftwareComponentInstanceRef=DMTLLkPmpDigOutp, EcucPartitionSoftwareComponentInstanceRef=CPT_ATS_Std, EcucPartitionSoftwareComponentInstanceRef=CPT_ComCo_Lyr, EcucPartitionSoftwareComponentInstanceRef=CPT_GlbDaAdapt_Adapt, EcucPartitionSoftwareComponentInstanceRef=CPT_DSM_Conf, EcucPartitionSoftwareComponentInstanceRef=SysU12VoltAdcInpSwc, EcucPartitionSoftwareComponentInstanceRef=CPT_rbm_MilHndlr, EcucPartitionSoftwareComponentInstanceRef=SrgSoln2DigOutp, EcucPartitionSoftwareComponentInstanceRef=CPT_Epm_Ini, EcucPartitionSoftwareComponentInstanceRef=OBD_PurgVentVlvDigOutp, EcucPartitionSoftwareComponentInstanceRef=Hbrdg_ETC_Motor, EcucPartitionSoftwareComponentInstanceRef=MAF_Hum_Snsr, EcucPartitionSoftwareComponentInstanceRef=CPT_rba_OsArSchedExtn_mcop, EcucPartitionSoftwareComponentInstanceRef=Epm_SwSStellantis, EcucPartitionSoftwareComponentInstanceRef=Hbrdg_DP, EcucPartitionSoftwareComponentInstanceRef=CPT_UEGO_OperRels, EcucPartitionSoftwareComponentInstanceRef=CPT_UEGO_Tstr, EcucPartitionSoftwareComponentInstanceRef=VvtIntk1PwmOutp, EcucPartitionSoftwareComponentInstanceRef=CooltInletTempAdcInpSwc, EcucPartitionSoftwareComponentInstanceRef=CPT_Epm_Ladp, EcucPartitionSoftwareComponentInstanceRef=CPT_KnDetSigEval, EcucPartitionSoftwareComponentInstanceRef=CPT_EpmSyn_CrSPos, EcucPartitionSoftwareComponentInstanceRef=CPT_KnDetControl, EcucPartitionSoftwareComponentInstanceRef=CPT_AVS_Std, EcucPartitionSoftwareComponentInstanceRef=IntkAirTAdcInpSwc, EcucPartitionSoftwareComponentInstanceRef=CPT_EpmCrS_Diag, EcucPartitionSoftwareComponentInstanceRef=IoSigIfAdapt_SwSStellantis, EcucPartitionSoftwareComponentInstanceRef=GPF_DeltAbsPresSnsr1, EcucPartitionSoftwareComponentInstanceRef=CluSnsAdcInp, EcucPartitionSoftwareComponentInstanceRef=GPF_DeltAbsPresSnsr2, EcucPartitionSoftwareComponentInstanceRef=PurgSolnPwmOutp, EcucPartitionSoftwareComponentInstanceRef=CPT_SrvB, EcucPartitionSoftwareComponentInstanceRef=CPT_UEGO_DiagRels, EcucPartitionSoftwareComponentInstanceRef=O2Snsr_SwSStellantis, EcucPartitionSoftwareComponentInstanceRef=ELCM_VacPmpPwmOutp, EcucPartitionSoftwareComponentInstanceRef=CPT_UEGO_UPmp, EcucPartitionSoftwareComponentInstanceRef=ColdCrkCasePSnsrAdcInpSwc, EcucPartitionSoftwareComponentInstanceRef=CPT_IgnClPs_Dia, EcucPartitionSoftwareComponentInstanceRef=CPT_MoCMPU_Co, EcucPartitionSoftwareComponentInstanceRef=CPT_OCWDA_Co, EcucPartitionSoftwareComponentInstanceRef=CPT_EpmCrS_Spd, EcucPartitionSoftwareComponentInstanceRef=CPT_MoCADC_Co, EcucPartitionSoftwareComponentInstanceRef=CPT_T15_Vld2Lcy, EcucPartitionSoftwareComponentInstanceRef=AC_CluRlyDigOutp, EcucPartitionSoftwareComponentInstanceRef=CPT_InjVlvPs_ConCJ, EcucPartitionSoftwareComponentInstanceRef=TOH_ShutOffVlvDigOutp, EcucPartitionSoftwareComponentInstanceRef=EGRCoolr_DeltAbsPresSnsr, EcucPartitionSoftwareComponentInstanceRef=CPT_UEGO_DiagSigEcuAsic, EcucPartitionSoftwareComponentInstanceRef=ThrPosnSnsr2AdcInpSwc, EcucPartitionSoftwareComponentInstanceRef=CoEng_SwSStellantis, EcucPartitionSoftwareComponentInstanceRef=CPT_ComScl_Appl, EcucPartitionSoftwareComponentInstanceRef=FuTankPSnsrAdcInpSwc, EcucPartitionSoftwareComponentInstanceRef=KnDet_SwSStellantis, EcucPartitionSoftwareComponentInstanceRef=MFVlv_SwSStellantis, EcucPartitionSoftwareComponentInstanceRef=CPT_EpmCaS_SyncnPatTi, EcucPartitionSoftwareComponentInstanceRef=CPT_EnvP_VDDiag, EcucPartitionSoftwareComponentInstanceRef=VarOilSolnPwmOutp, EcucPartitionSoftwareComponentInstanceRef=CPT_IVGdiCtl_CvoCsersPlausyDiag, EcucPartitionSoftwareComponentInstanceRef=FuDoorSwDigInp, EcucPartitionSoftwareComponentInstanceRef=CoolEgrTAdcInpSwc, EcucPartitionSoftwareComponentInstanceRef=CPT_Epm_CustAdp, EcucPartitionSoftwareComponentInstanceRef=CPT_UEGO_DiagSigOperPlaus, EcucPartitionSoftwareComponentInstanceRef=SrgSoln1DigOutp, EcucPartitionSoftwareComponentInstanceRef=CPT_IVGdiCtl_CvoSigEvln, EcucPartitionSoftwareComponentInstanceRef=CPT_EpmSeq_EveHndlr, EcucPartitionSoftwareComponentInstanceRef=BrkSwDigInp, EcucPartitionSoftwareComponentInstanceRef=CPT_EpmSrv_Lib, EcucPartitionSoftwareComponentInstanceRef=CPT_InjSyG_AdpnCdnCvo, EcucPartitionSoftwareComponentInstanceRef=StrtrRlyFbDigInp, EcucPartitionSoftwareComponentInstanceRef=CPT_SWC_VcodProxi, EcucPartitionSoftwareComponentInstanceRef=DP_VlvPosnSns, EcucPartitionSoftwareComponentInstanceRef=CPT_UEGO_TCeramic, EcucPartitionSoftwareComponentInstanceRef=CPT_EpmCaS_OfsDiag, EcucPartitionSoftwareComponentInstanceRef=CPT_MRly_Vld2Lcy, EcucPartitionSoftwareComponentInstanceRef=CPT_rba_IoSigRtc, EcucPartitionSoftwareComponentInstanceRef=CPT_KeyM, EcucPartitionSoftwareComponentInstanceRef=CPT_rba_OsShell, EcucPartitionSoftwareComponentInstanceRef=CPT_Dcm, EcucPartitionSoftwareComponentInstanceRef=CPT_rba_IoDiagPwr, EcucPartitionSoftwareComponentInstanceRef=CPT_NvM, EcucPartitionSoftwareComponentInstanceRef=CPT_ComM, EcucPartitionSoftwareComponentInstanceRef=CPT_BswM
        EcucPartition_OsApp_2_A_1: EcucPartitionSoftwareComponentInstanceRef=CPT_rba_OsArSchedExtn_mcop
        EcucPartition_OsApp_2_Q_1: EcucPartitionSoftwareComponentInstanceRef=CPT_rba_EepAdaptDGS, EcucPartitionSoftwareComponentInstanceRef=CPT_EGSHeatr_SnsrCoorn, EcucPartitionSoftwareComponentInstanceRef=CPT_KnDetLTest, EcucPartitionSoftwareComponentInstanceRef=CPT_IgCPrimI_AcqnAdc, EcucPartitionSoftwareComponentInstanceRef=CPT_rba_MemDiag, EcucPartitionSoftwareComponentInstanceRef=CPT_InjSyG_InjTi, EcucPartitionSoftwareComponentInstanceRef=CPT_EpmCaS_RelsSigEvln, EcucPartitionSoftwareComponentInstanceRef=CPT_BGTHDEV, EcucPartitionSoftwareComponentInstanceRef=CPT_XcpAppl, EcucPartitionSoftwareComponentInstanceRef=CPT_DEVE, EcucPartitionSoftwareComponentInstanceRef=CPT_rba_SyC_States_Cfg_2_Q_1, EcucPartitionSoftwareComponentInstanceRef=CPT_HEGO_OBDElec, EcucPartitionSoftwareComponentInstanceRef=CPT_SWAdp, EcucPartitionSoftwareComponentInstanceRef=CPT_EnvP_DD, EcucPartitionSoftwareComponentInstanceRef=CPT_HEGO_Htg, EcucPartitionSoftwareComponentInstanceRef=CPT_EpmIf_Imprt, EcucPartitionSoftwareComponentInstanceRef=CPT_InjSyG_CoCvo, EcucPartitionSoftwareComponentInstanceRef=CPT_esc_stack, EcucPartitionSoftwareComponentInstanceRef=CPT_MoExe_Co, EcucPartitionSoftwareComponentInstanceRef=CPT_EpmRRS_AgDetect, EcucPartitionSoftwareComponentInstanceRef=CPT_FiM, EcucPartitionSoftwareComponentInstanceRef=CPT_KONCW, EcucPartitionSoftwareComponentInstanceRef=CPT_rba_OsArSchedExtn_OS, EcucPartitionSoftwareComponentInstanceRef=CPT_Dem, EcucPartitionSoftwareComponentInstanceRef=CPT_InjVlvPs_Dia, EcucPartitionSoftwareComponentInstanceRef=CPT_EGSHeatr_DiagPrfmnc, EcucPartitionSoftwareComponentInstanceRef=CPT_ComDia_Dcm_Rte_Adapter, EcucPartitionSoftwareComponentInstanceRef=CPT_rba_Svbb, EcucPartitionSoftwareComponentInstanceRef=CPT_EpmCaS_Adap, EcucPartitionSoftwareComponentInstanceRef=CPT_IVGdiCtl_CvoDiag, EcucPartitionSoftwareComponentInstanceRef=CPT_GlbDa_ECUOnTime, EcucPartitionSoftwareComponentInstanceRef=CPT_DevLib_PwrStgState, EcucPartitionSoftwareComponentInstanceRef=CPT_EGSHeatr_DiagWire, EcucPartitionSoftwareComponentInstanceRef=CPT_MfPs_ConCY, EcucPartitionSoftwareComponentInstanceRef=CPT_EpmHCrS_IntHndlr, EcucPartitionSoftwareComponentInstanceRef=CPT_InjDDPfi, EcucPartitionSoftwareComponentInstanceRef=CPT_EGSHeatr_Ctrl, EcucPartitionSoftwareComponentInstanceRef=CPT_ETC_Std, EcucPartitionSoftwareComponentInstanceRef=CPT_rbm_DSM_Conf, EcucPartitionSoftwareComponentInstanceRef=CPT_MfDD, EcucPartitionSoftwareComponentInstanceRef=CPT_OilCmbdSen_DD, EcucPartitionSoftwareComponentInstanceRef=CPT_EpmErr_Trace, EcucPartitionSoftwareComponentInstanceRef=CPT_EGSHeatr_SnsrTMdl, EcucPartitionSoftwareComponentInstanceRef=CPT_UEGO_DiagSigSnsr, EcucPartitionSoftwareComponentInstanceRef=CPT_MfPsDia, EcucPartitionSoftwareComponentInstanceRef=CPT_Epm_Spd, EcucPartitionSoftwareComponentInstanceRef=CPT_EpmCaS_Seg, EcucPartitionSoftwareComponentInstanceRef=CPT_HEGO_Sens, EcucPartitionSoftwareComponentInstanceRef=CPT_ATS_Std, EcucPartitionSoftwareComponentInstanceRef=CPT_GlbDaAdapt_Adapt, EcucPartitionSoftwareComponentInstanceRef=CPT_DSM_Conf, EcucPartitionSoftwareComponentInstanceRef=CPT_rba_OsArSchedExtn_mcop, EcucPartitionSoftwareComponentInstanceRef=CPT_KnDetControl, EcucPartitionSoftwareComponentInstanceRef=CPT_EpmCrS_Diag, EcucPartitionSoftwareComponentInstanceRef=CPT_EGSHeatr_Acttn, EcucPartitionSoftwareComponentInstanceRef=CPT_EGSHeatr_TiHeatrOff, EcucPartitionSoftwareComponentInstanceRef=CPT_IgnClPs_Dia, EcucPartitionSoftwareComponentInstanceRef=CPT_MoCMPU_Co, EcucPartitionSoftwareComponentInstanceRef=CPT_InjSyG_CalcCnvnFac, EcucPartitionSoftwareComponentInstanceRef=CPT_OCWDA_Co, EcucPartitionSoftwareComponentInstanceRef=CPT_MoCADC_Co, EcucPartitionSoftwareComponentInstanceRef=CPT_UEGO_DiagSigEcuAsic, EcucPartitionSoftwareComponentInstanceRef=CPT_ComScl_Appl, EcucPartitionSoftwareComponentInstanceRef=CPT_EnvP_VDDiag, EcucPartitionSoftwareComponentInstanceRef=CPT_IVGdiCtl_CvoCsersPlausyDiag, EcucPartitionSoftwareComponentInstanceRef=CPT_Epm_CustAdp, EcucPartitionSoftwareComponentInstanceRef=CPT_UEGO_DiagSigOperPlaus, EcucPartitionSoftwareComponentInstanceRef=CPT_InjSyG_AdpnCdnCvo, EcucPartitionSoftwareComponentInstanceRef=CPT_EpmCaS_OfsDiag, EcucPartitionSoftwareComponentInstanceRef=EnvP_SwSStellantis
        EcucPartition_OsApp_3_A_1: EcucPartitionSoftwareComponentInstanceRef=CPT_rba_OsArSchedExtn_mcop
        EcucPartition_OsApp_3_Q_1: EcucPartitionSoftwareComponentInstanceRef=CPT_UEGO_ISrc, EcucPartitionSoftwareComponentInstanceRef=CPT_EpmHAgClk_Gen, EcucPartitionSoftwareComponentInstanceRef=CPT_UEGO_Dac, EcucPartitionSoftwareComponentInstanceRef=CPT_UEGO_IPmpRef, EcucPartitionSoftwareComponentInstanceRef=CPT_SWAdp, EcucPartitionSoftwareComponentInstanceRef=CPT_UEGO_UNernst, EcucPartitionSoftwareComponentInstanceRef=CPT_UEGO_IPmpPck, EcucPartitionSoftwareComponentInstanceRef=CPT_esc_stack, EcucPartitionSoftwareComponentInstanceRef=CPT_UEGO_ICntct, EcucPartitionSoftwareComponentInstanceRef=CPT_FiM, EcucPartitionSoftwareComponentInstanceRef=CPT_rba_OsArSchedExtn_OS, EcucPartitionSoftwareComponentInstanceRef=CPT_UEGO_RPmp, EcucPartitionSoftwareComponentInstanceRef=CPT_Dem, EcucPartitionSoftwareComponentInstanceRef=CPT_rba_Svbb, EcucPartitionSoftwareComponentInstanceRef=CPT_Epm_SpdFeat, EcucPartitionSoftwareComponentInstanceRef=CPT_EpmHCrS_IntHndlr, EcucPartitionSoftwareComponentInstanceRef=CPT_UEGO_O2, EcucPartitionSoftwareComponentInstanceRef=CPT_EpmHCaS_SigEval, EcucPartitionSoftwareComponentInstanceRef=CPT_UEGO_ModCtrl, EcucPartitionSoftwareComponentInstanceRef=CPT_rba_OsArSchedExtn_mcop, EcucPartitionSoftwareComponentInstanceRef=CPT_rba_SyC_States_Cfg_3_Q_1, EcucPartitionSoftwareComponentInstanceRef=CPT_EGSHeatr_Acttn, EcucPartitionSoftwareComponentInstanceRef=CPT_UEGO_UPmp, EcucPartitionSoftwareComponentInstanceRef=CPT_MoCMPU_Co, EcucPartitionSoftwareComponentInstanceRef=CPT_UEGO_RCmp, EcucPartitionSoftwareComponentInstanceRef=CPT_Epm_CustAdp, EcucPartitionSoftwareComponentInstanceRef=CPT_UEGO_RNernst, EcucPartitionSoftwareComponentInstanceRef=CPT_UEGO_IPmpSeg, EcucPartitionSoftwareComponentInstanceRef=CPT_UEGO_TCeramic
