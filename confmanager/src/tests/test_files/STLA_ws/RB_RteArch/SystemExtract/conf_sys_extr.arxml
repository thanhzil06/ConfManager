AUTOSAR XML (schema 4-0-3)
package /RB/PT/PCFG_SYS/Systems
  system SystemExtract: category=SYSTEM_EXTRACT
    system mapping SystemExtractMapping
      sw-impl-mappings:
        12 x swc to impl mapping:
          SwcToImplMapping_NvM: component-implementation=NvM, component=RootProject.CPT_NvM
          SwcToImplMapping_Dcm: component-implementation=Impl_Dcm, component=RootProject.CPT_Dcm
          SwcToImplMapping_IoDiagPs: component-implementation=rba_IoDiagPs, component=RootProject.CPT_rba_IoDiagPs
          SwcToImplMapping_IoDiagPwr: component-implementation=rba_IoDiagPwr, component=RootProject.CPT_rba_IoDiagPwr
          SwcToImplMapping_IoSigAdc: component-implementation=rba_IoSigAdc, component=RootProject.CPT_rba_IoSigAdc
          SwcToImplMapping_IoSigDio: component-implementation=rba_IoSigDio, component=RootProject.CPT_rba_IoSigDio
          SwcToImplMapping_IoSigIcu: component-implementation=rba_IoSigIcu, component=RootProject.CPT_rba_IoSigIcu
          SwcToImplMapping_IoSigObs: component-implementation=rba_IoSigObs, component=RootProject.CPT_rba_IoSigObs
          SwcToImplMapping_IoSigPwm: component-implementation=rba_IoSigPwm, component=RootProject.CPT_rba_IoSigPwm
          SwcToImplMapping_IoSigPwr: component-implementation=rba_IoSigPwr, component=RootProject.CPT_rba_IoSigPwr
          SwcToImplMapping_IoSigRtc: component-implementation=rba_IoSigRtc, component=RootProject.CPT_rba_IoSigRtc
          SwcToImplMapping_ComM: component-implementation=ComM_Imp, component=RootProject.CPT_ComM
      sw-mappings:
        swc to ecu mapping SwcToMDG1Mapping: component=RootProject.TopLvlComposition, ecu-instance=MDG1
    root-software-compositions:
      root sw composition prototype RootProject: software-composition=RootProject
