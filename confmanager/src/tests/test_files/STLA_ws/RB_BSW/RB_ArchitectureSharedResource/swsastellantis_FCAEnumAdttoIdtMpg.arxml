AUTOSAR XML (schema 4-2-2)
package /AdtToIdtMpgEnum
  data type mapping set EnumDataTypeMpgSet
    data-type-maps:
      application-data-type=ADTSFuRailLoPRatlyReqModEnum, implementation-data-type=uint8
      application-data-type=ADTSEssEngStEnum, implementation-data-type=uint8
      application-data-type=ADTSEssStrtReqdActrEnum, implementation-data-type=uint8
      application-data-type=ADTSEssEngModReqEnum, implementation-data-type=uint8
      application-data-type=ADTSTqLossAdpnStEnum, implementation-data-type=uint8
      application-data-type=ADTSFuRailHeatrCtrlStEnum, implementation-data-type=uint8
      application-data-type=ADTSFuRailHeatrCtrlStsEnum, implementation-data-type=uint8
      application-data-type=ADTSFuRailHeatrCtrlStCanEnum, implementation-data-type=uint8
      application-data-type=ADTSFuRailHeatrLstAuxTestFailReasonEnum, implementation-data-type=uint8
      application-data-type=ADTSFuRailHeatrAuxTestStsEnum, implementation-data-type=uint8
      application-data-type=ADTSFuRailHeatrAuxTestToolReqEnum, implementation-data-type=uint8
      application-data-type=ADTSStrtrMotCtrlStEnum, implementation-data-type=uint8
