AUTOSAR XML (schema 4-2-2)
package /AUTOSAR_BswM/SwComponentTypes
  service sw component type BswM
    behavior IB_BswM
package /AUTOSAR_BswM/SwcImplementations
  swc implementation SWCIMPL_BswM: programming-language=C, sw-version=1.0.0, swc-bsw-mapping=BswM, behavior=IB_BswM
    code-descriptors:
      code CodeDescriptor: artifact-descriptors=autosar-engineering-object={short-label=ArEngObj, category=SWSRC}
package /AUTOSAR_BswM/SwcBswMappings
  swc bsw mapping BswM: bsw-behavior=IB_BswM, swc-behavior=IB_BswM
