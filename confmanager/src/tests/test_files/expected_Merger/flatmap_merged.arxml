AUTOSAR XML (schema 4-3-0)
package /RB/PT/PCT_MDG1_FlatMap/FlatMaps
  flat map MDG1_FlatMap
    6 x flat instance descriptor:
      AC_CluRlyDigOutp: upstream-reference=RootProject.TopLvlComposition.CPT_IoSigDioOutp_SwSStellantisCmpstn.AC_CluRlyDigOutp, ecu-extract-reference=CPT_MDG1_FlatView.AC_CluRlyDigOutp
      FiM_InhLim_OxSnsrHtrUsBnk2CircLoFlt_calibarr: ecu-extract-reference=BSWIB_FiM.FiM_InhLim_OxSnsrHtrUsBnk2CircLoFlt_calibarr
      tiEveE1IsrTrig: upstream-reference=RootProject.TopLvlComposition.CPT_ESC_EveCfg.tiEveE1IsrTrig, ecu-extract-reference=CPT_MDG1_FlatView.CPT_ESC_EveCfg.tiEveE1IsrTrig, variation-point={short-label=VP_ESC_NRTSKAGEVE_SC_GREATER_EQ_2, sw-syscond=( /RB/PT/Common/SwSystemconsts/Adjustables/ESC_NRTSKAGEVE_SC >=2)}
      FiM_InhLim_OxSnsrRefVoltCircLoFlt_calibarr: ecu-extract-reference=BSWIB_FiM.FiM_InhLim_OxSnsrRefVoltCircLoFlt_calibarr
      ESC_dataSyncS0MaxTskLoad: ecu-extract-reference=CPT_MDG1_FlatView.CPT_esc_tasklink.ESC_dataSyncS0MaxTskLoad, variation-point={short-label=ESC_SWTSYNRTMEASMT_SC_EQ_1, sw-syscond=( ( /RB/PT/Common/SwSystemconsts/Adjustables/ESC_SWTSYNRTMEASMT_SC ==1) )}
      ESC_agEveE0TskStrt:
        upstream-reference=RootProject.TopLvlComposition.CPT_esc_stack.PP_ESC_agEveE0TskStrt.ESC_agEveE0TskStrt
        ecu-extract-reference=CPT_MDG1_FlatView.CPT_esc_stack.PP_ESC_agEveE0TskStrt.ESC_agEveE0TskStrt
        variation-point={short-label=ESC_NRAGEVEWCYC_SC_NEQ_0_AND_ESC_NRTSKAGEVE_SC_NEQ_0, sw-syscond=( (( /RB/PT/Common/SwSystemconsts/Adjustables/ESC_NRAGEVEWCYC_SC !=0) && ( /RB/PT/Common/SwSystemconsts/Adjustables/ESC_NRTSKAGEVE_SC !=0)) )}
