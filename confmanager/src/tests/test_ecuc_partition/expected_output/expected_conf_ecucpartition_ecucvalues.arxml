AUTOSAR XML (schema 4-3-0)
package /RB/UBK/Project/EcucModuleConfigurationValuess
  module config EcuC
    EcucPartitionCollection
      4 x EcucPartition:
        EcucPartition_OsApp_A: EcucPartitionBswModuleExecution=false, PartitionCanBeRestarted=false, EcucPartitionSoftwareComponentInstanceRef=CPT_MDG1_FlatView.CPT_A1, EcucPartitionSoftwareComponentInstanceRef=CPT_MDG1_FlatView.CPT_A2, EcucPartitionSoftwareComponentInstanceRef=CPT_MDG1_FlatView.CPT_A3, EcucPartitionSoftwareComponentInstanceRef=CPT_MDG1_FlatView.CPT_A6, EcucPartitionSoftwareComponentInstanceRef=CPT_MDG1_FlatView.CPT_A7, EcucPartitionSoftwareComponentInstanceRef=CPT_A8
        EcucPartition_OsApp_B: EcucPartitionBswModuleExecution=false, PartitionCanBeRestarted=false, EcucPartitionSoftwareComponentInstanceRef=CPT_MDG1_FlatView.CPT_B1, EcucPartitionSoftwareComponentInstanceRef=CPT_MDG1_FlatView.CPT_B2, EcucPartitionSoftwareComponentInstanceRef=CPT_MDG1_FlatView.CPT_B3, EcucPartitionSoftwareComponentInstanceRef=CPT_B5, EcucPartitionSoftwareComponentInstanceRef=CPT_MDG1_FlatView.CPT_B6, EcucPartitionSoftwareComponentInstanceRef=CPT_MDG1_FlatView.CPT_B7
        EcucPartition_OsApp_C: EcucPartitionBswModuleExecution=false, PartitionCanBeRestarted=false, EcucPartitionSoftwareComponentInstanceRef=CPT_MDG1_FlatView.CPT_C1, EcucPartitionSoftwareComponentInstanceRef=CPT_MDG1_FlatView.CPT_C2, EcucPartitionSoftwareComponentInstanceRef=CPT_C4
        EcucPartition_OsApp_D: EcucPartitionSoftwareComponentInstanceRef=CPT_D2
