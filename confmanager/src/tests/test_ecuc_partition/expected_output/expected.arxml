AUTOSAR XML (schema 4-3-0)
package /RB/UBK/Project/EcucModuleConfigurationValuess
  module config EcuC
    EcucPartitionCollection
      4 x EcucPartition, all with EcucPartitionBswModuleExecution=false, PartitionCanBeRestarted=false:
        EcucPartition_OsApp_0_A_1: EcucPartitionSoftwareComponentInstanceRef=CPT_rba_OsArSchedExtn_mcop
        EcucPartition_OsApp_0_B_1: EcucPartitionSoftwareComponentInstanceRef=CPT_Dem, EcucPartitionSoftwareComponentInstanceRef=CPT_rba_OsArSchedExtn_OS, EcucPartitionSoftwareComponentInstanceRef=CPT_rba_OsArSchedExtn_mcop
        EcucPartition_OsApp_1_A_1: EcucPartitionSoftwareComponentInstanceRef=CPT_rba_OsArSchedExtn_mcop
        EcucPartition_OsApp_1_B_1: EcucPartitionSoftwareComponentInstanceRef=CPT_esc_stack, EcucPartitionSoftwareComponentInstanceRef=Lvl2Data
