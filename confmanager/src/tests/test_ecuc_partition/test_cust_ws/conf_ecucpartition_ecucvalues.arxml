AUTOSAR XML (schema 4-0-2)
package /RB/UBK/Project/EcucModuleConfigurationValuess
  module config EcuC
    EcucPartitionCollection
      4 x EcucPartition:
        EcucPartition_OsApp_A: EcucPartitionBswModuleExecution=false, PartitionCanBeRestarted=false, EcucPartitionSoftwareComponentInstanceRef=CPT_MDG1_FlatView.CPT_A1, EcucPartitionSoftwareComponentInstanceRef=CPT_MDG1_FlatView.CPT_A3, EcucPartitionSoftwareComponentInstanceRef=CPT_MDG1_FlatView.CPT_A2, EcucPartitionSoftwareComponentInstanceRef=CPT_MDG1_FlatView.CPT_A7, EcucPartitionSoftwareComponentInstanceRef=CPT_MDG1_FlatView.CPT_A6
        EcucPartition_OsApp_B: EcucPartitionBswModuleExecution=false, PartitionCanBeRestarted=false, EcucPartitionSoftwareComponentInstanceRef=CPT_MDG1_FlatView.CPT_B1, EcucPartitionSoftwareComponentInstanceRef=CPT_MDG1_FlatView.CPT_B2, EcucPartitionSoftwareComponentInstanceRef=CPT_MDG1_FlatView.CPT_B7, EcucPartitionSoftwareComponentInstanceRef=CPT_MDG1_FlatView.CPT_B3, EcucPartitionSoftwareComponentInstanceRef=CPT_MDG1_FlatView.CPT_B6
        EcucPartition_OsApp_D
        EcucPartition_OsApp_C: EcucPartitionBswModuleExecution=false, PartitionCanBeRestarted=false, EcucPartitionSoftwareComponentInstanceRef=CPT_MDG1_FlatView.CPT_C2, EcucPartitionSoftwareComponentInstanceRef=CPT_MDG1_FlatView.CPT_C1
