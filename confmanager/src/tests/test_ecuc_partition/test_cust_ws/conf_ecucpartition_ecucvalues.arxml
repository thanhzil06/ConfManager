AUTOSAR XML (schema 4-0-2)
package /RB/UBK/Project/EcucModuleConfigurationValuess
  module config EcuC
    EcucPartitionCollection
      3 x EcucPartition, all with EcucPartitionBswModuleExecution=false, PartitionCanBeRestarted=false:
        EcucPartition_OsApp_A: EcucPartitionSoftwareComponentInstanceRef=CPT_MDG1_FlatView.CPT_A1, EcucPartitionSoftwareComponentInstanceRef=CPT_MDG1_FlatView.CPT_A3, EcucPartitionSoftwareComponentInstanceRef=CPT_MDG1_FlatView.CPT_A2, EcucPartitionSoftwareComponentInstanceRef=CPT_MDG1_FlatView.CPT_A7, EcucPartitionSoftwareComponentInstanceRef=CPT_MDG1_FlatView.CPT_A6
        EcucPartition_OsApp_B: EcucPartitionSoftwareComponentInstanceRef=CPT_MDG1_FlatView.CPT_B1, EcucPartitionSoftwareComponentInstanceRef=CPT_MDG1_FlatView.CPT_B2, EcucPartitionSoftwareComponentInstanceRef=CPT_MDG1_FlatView.CPT_B7, EcucPartitionSoftwareComponentInstanceRef=CPT_MDG1_FlatView.CPT_B3, EcucPartitionSoftwareComponentInstanceRef=CPT_MDG1_FlatView.CPT_B6
        EcucPartition_OsApp_C: EcucPartitionSoftwareComponentInstanceRef=CPT_MDG1_FlatView.CPT_C2, EcucPartitionSoftwareComponentInstanceRef=CPT_MDG1_FlatView.CPT_C1
