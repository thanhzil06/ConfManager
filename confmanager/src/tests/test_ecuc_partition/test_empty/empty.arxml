AUTOSAR XML (schema 4-3-0)
package /RB/UBK/Project/EcucModuleConfigurationValuess
  module config EcuC
    EcucPartitionCollection
      EcucPartition_OsApp_D (EcucPartition)
      EcucPartition_OsApp_C (EcucPartition): EcucPartitionBswModuleExecution=false, PartitionCanBeRestarted=false, EcucPartitionSoftwareComponentInstanceRef=CPT_MDG1_FlatView.CPT_C1
