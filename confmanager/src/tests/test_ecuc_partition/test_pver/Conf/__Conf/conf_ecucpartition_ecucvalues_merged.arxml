AUTOSAR XML (schema 4-0-2)
package /RB/UBK/Project/EcucModuleConfigurationValuess
  module config EcuC
    EcucPartitionCollection
      4 x EcucPartition, all with EcucPartitionBswModuleExecution=false, PartitionCanBeRestarted=false:
        EcucPartition_OsApp_0_A_1
        EcucPartition_OsApp_1_A_1: EcucPartitionSoftwareComponentInstanceRef=CPT_esc_stack
        EcucPartition_OsApp_0_B_1: EcucPartitionSoftwareComponentInstanceRef=CPT_FiM, EcucPartitionSoftwareComponentInstanceRef=CPT_esc_stack, EcucPartitionSoftwareComponentInstanceRef=CPT_SWAdp
        EcucPartition_OsApp_1_B_1: EcucPartitionSoftwareComponentInstanceRef=CPT_Dem, EcucPartitionSoftwareComponentInstanceRef=CPT_rba_SyC_States_Cfg_1_B_1, EcucPartitionSoftwareComponentInstanceRef=CPT_MoCCom_Co, EcucPartitionSoftwareComponentInstanceRef=EssOccptSenMgr, EcucPartitionSoftwareComponentInstanceRef=CPT_ComScl_NetMtrxTxAdapt
