AUTOSAR XML (schema 4-0-2)
package /RB/UBK/Project/EcucModuleConfigurationValuess
  module config EcuC
    EcucPartitionCollection
      3 x EcucPartition:
        EcucPartition_OsApp_A: EcucPartitionSoftwareComponentInstanceRef=Comp_A1, EcucPartitionSoftwareComponentInstanceRef=Comp_A3, EcucPartitionSoftwareComponentInstanceRef=Comp_A2
        EcucPartition_OsApp_C: EcucPartitionSoftwareComponentInstanceRef=Comp_C4, EcucPartitionSoftwareComponentInstanceRef=Comp_C2
        EcucPartition_OsApp_B: EcucPartitionSoftwareComponentInstanceRef=Comp_B3, EcucPartitionSoftwareComponentInstanceRef=Comp_B2, EcucPartitionSoftwareComponentInstanceRef=Comp_B1
