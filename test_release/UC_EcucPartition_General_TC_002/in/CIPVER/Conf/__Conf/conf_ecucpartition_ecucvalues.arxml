AUTOSAR XML (schema 4-0-2)
package /RB/UBK/Project/EcucModuleConfigurationValuess
  module config EcuC
    EcucPartitionCollection
      EcucPartition_OsApp_A (EcucPartition):
        EcucPartitionSoftwareComponentInstanceRef = Comp_B{1..3}
