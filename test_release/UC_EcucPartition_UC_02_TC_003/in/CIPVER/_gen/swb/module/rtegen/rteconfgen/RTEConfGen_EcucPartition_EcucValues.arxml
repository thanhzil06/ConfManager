AUTOSAR XML (schema 00050)
package /RB/UBK/Project/EcucModuleConfigurationValuess
  module config EcuC
    EcucPartitionCollection
      EcucPartition_OsApp_C (EcucPartition): EcucPartitionSoftwareComponentInstanceRef=Comp_C1, EcucPartitionSoftwareComponentInstanceRef=Comp_C3
      EcucPartition_OsApp_D (EcucPartition): EcucPartitionSoftwareComponentInstanceRef=Comp_D1, EcucPartitionSoftwareComponentInstanceRef=Comp_D3
