AUTOSAR XML (schema 00050)
package /RB/UBK/Project/EcucModuleConfigurationValuess
  module config EcuC
    EcucPartitionCollection
      EcucPartition_OsApp_A (EcucPartition):
        EcucPartitionSoftwareComponentInstanceRef = Comp_A3
        EcucPartitionSoftwareComponentInstanceRef = Comp_A2
        EcucPartitionSoftwareComponentInstanceRef = Comp_A1
