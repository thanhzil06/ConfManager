AUTOSAR XML (schema 00050)
package /RB/UBK/Project/EcucModuleConfigurationValuess
  module config EcuC
    EcucPartitionCollection
      EcucPartition_OsApp_C (EcucPartition):
        EcucPartitionSoftwareComponentInstanceRef = Comp_C2
        EcucPartitionSoftwareComponentInstanceRef = Comp_C3
        EcucPartitionSoftwareComponentInstanceRef = Comp_C1
      EcucPartition_OsApp_D (EcucPartition):
        EcucPartitionSoftwareComponentInstanceRef = Comp_D2
        EcucPartitionSoftwareComponentInstanceRef = Comp_D3
        EcucPartitionSoftwareComponentInstanceRef = Comp_D1
