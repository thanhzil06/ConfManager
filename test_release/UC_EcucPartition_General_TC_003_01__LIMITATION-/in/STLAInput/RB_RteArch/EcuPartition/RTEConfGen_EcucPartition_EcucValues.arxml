AUTOSAR XML (schema 4-0-2)
package /RB/UBK/Project/EcucModuleConfigurationValuess
  module config EcuC
    EcucPartitionCollection
      EcucPartition_OsApp_C (EcucPartition): EcucPartitionSoftwareComponentInstanceRef=Comp_C2, EcucPartitionSoftwareComponentInstanceRef=Comp_C1
      EcucPartition_OsApp_A (EcucPartition):
        EcucPartitionSoftwareComponentInstanceRef = Comp_A6
        EcucPartitionSoftwareComponentInstanceRef = Comp_A5
        EcucPartitionSoftwareComponentInstanceRef = Comp_A4
