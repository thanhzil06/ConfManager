AUTOSAR XML (schema 00050)
package /RB/UBK/Project/EcucModuleConfigurationValuess
  module config EcuC
    EcucPartitionCollection
      EcucPartition_OsApp_A (EcucPartition):
        EcucPartitionSoftwareComponentInstanceRef = Comp_A{4..6}
