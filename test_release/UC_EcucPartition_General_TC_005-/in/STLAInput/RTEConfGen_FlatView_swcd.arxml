AUTOSAR XML (schema 00050)
package /RB/PT/PCT_MDG1_FlatView/SwComponentTypes
  composition sw component type MDG1_FlatView
    component CPT_ATS_Std: type=ATS_Std
    connect CPT_rba_OsArSchedExtn_OS.PP_rba_OsArSchedExtn_DSM_Reini_TRIGSRC -> CPT_rba_OsArSchedExtn.RP_rba_OsArSchedExtn_DSM_Reini_TRIGSRC
