AUTOSAR XML (schema 00050)
package /RB/UBK/Project/EcucModuleConfigurationValuess
  module config EcuC
    EcucPartitionCollection
      3 x EcucPartition:
        EcucPartition_OsApp_C: EcucPartitionSoftwareComponentInstanceRef=Comp_C1, EcucPartitionSoftwareComponentInstanceRef=Comp_C3
        EcucPartition_OsApp_D: EcucPartitionSoftwareComponentInstanceRef=Comp_D1, EcucPartitionSoftwareComponentInstanceRef=Comp_D3
        EcucPartition_OsApp_C
