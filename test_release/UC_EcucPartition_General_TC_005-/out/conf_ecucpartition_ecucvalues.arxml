AUTOSAR XML (schema 4-3-0)
package /RB/UBK/Project/EcucModuleConfigurationValuess
  module config EcuC
    EcucPartitionCollection
      5 x EcucPartition:
        EcucPartition_OsApp_A: EcucPartitionSoftwareComponentInstanceRef=Comp_A1, EcucPartitionSoftwareComponentInstanceRef=Comp_A3
        EcucPartition_OsApp_A: EcucPartitionSoftwareComponentInstanceRef=Comp_A1
        EcucPartition_OsApp_B: EcucPartitionSoftwareComponentInstanceRef=Comp_B1, EcucPartitionSoftwareComponentInstanceRef=Comp_B3
        EcucPartition_OsApp_B: EcucPartitionSoftwareComponentInstanceRef=Comp_B1, EcucPartitionSoftwareComponentInstanceRef=Comp_B3
        EcucPartition_OsApp_C: EcucPartitionSoftwareComponentInstanceRef=Comp_C1, EcucPartitionSoftwareComponentInstanceRef=Comp_C3
