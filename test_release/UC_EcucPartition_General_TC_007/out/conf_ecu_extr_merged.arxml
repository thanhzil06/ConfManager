AUTOSAR XML (schema 4-3-0)
package /RB/PT/PCFG_ECU
  system MDG1_EXTR: category=ECU_EXTRACT, ecu-extract-version=1.0.0, system-version=1.0.0
    system mapping SYSMPG_MDG1
      data-mappings:
        sender-receiver-to-signal-group-mapping={data-element=CPT_MDG1_FlatView.PP_COM_Tx_ENGINE_FD_DIESEL.VD_COM_Tx_ENGINE_FD_DIESEL, signal-group=SystemSignalGroup_COM_Tx_ENGINE_FD_DIESEL, type-mapping=sender-rec-record-type-mapping=record-element-mappings=[{application-record-element=AdblueRemainDist, system-signal=SystemSignal_COM_Tx_AdblueRemainDist}, {application-record-element=Adblue_FL_LVL, system-signal=SystemSignal_COM_Tx_Adblue_FL_LVL}]}
        sender-receiver-to-signal-mapping={data-element=CPT_MDG1_FlatView.RP_COM_Rx_AGS2_ECM_STATUS.VD_COM_Rx_AGS2_BoostStat, system-signal=SystemSignal_COM_Rx_AGS2_BoostStat}
        sender-receiver-to-signal-mapping={data-element=CPT_MDG1_FlatView.PP_COM_Tx_ENGINE_HYBD_FD_3.VD_COM_Tx_AGSposn, system-signal=SystemSignal_COM_Tx_AGSposn}
      sw-impl-mappings:
        swc to impl mapping SwcToImplMapping_ATS_Std: component-implementation=Impl_ATS_Std, component=CPT_MDG1_FlatView.CPT_ATS_Std
      sw-mappings:
        swc to ecu mapping SwcToEcuMapping_0: component=[CPT_MDG1_FlatView.AC_CluRlyDigOutp, CPT_MDG1_FlatView.AirCdngPSnsrAdcInpSwc], ecu-instance=MDG1
        swc to ecu mapping SwcToEcuMapping_MSR2AR: component=CPT_MDG1_FlatView.CPT_ATS_Std, ecu-instance=MDG1
    root-software-compositions:
      root sw composition prototype CPT_MDG1_FlatView: flat-map=MDG1_FlatMap, software-composition=MDG1_FlatView
