AUTOSAR XML (schema 4-3-0)
package /RB/UBK/Project/EcucModuleConfigurationValuess
  module config EcuC
    EcucPartitionCollection
      EcucPartition_OsApp_A (EcucPartition): EcucPartitionSoftwareComponentInstanceRef=Comp_A1, EcucPartitionSoftwareComponentInstanceRef=Comp_A2
      EcucPartition_OsApp_B (EcucPartition):
        EcucPartitionSoftwareComponentInstanceRef = Comp_B{1..3}
