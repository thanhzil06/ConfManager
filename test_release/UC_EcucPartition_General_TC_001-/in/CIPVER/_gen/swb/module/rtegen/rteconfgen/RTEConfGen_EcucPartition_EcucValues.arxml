AUTOSAR XML (schema 00050)
package /RB/UBK/Project/EcucModuleConfigurationValuess
  module config EcuC
    EcucPartitionCollection
      4 x EcucPartition:
        EcucPartition_OsApp_A: EcucPartitionSoftwareComponentInstanceRef=CPT_A4, EcucPartitionSoftwareComponentInstanceRef=CPT_A5
        EcucPartition_OsApp_B: EcucPartitionSoftwareComponentInstanceRef=CPT_B4
        EcucPartition_OsApp_C: EcucPartitionSoftwareComponentInstanceRef=CPT_C1
        EcucPartition_OsApp_E
