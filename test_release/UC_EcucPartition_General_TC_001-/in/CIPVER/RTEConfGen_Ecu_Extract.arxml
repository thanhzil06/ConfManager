AUTOSAR XML (schema 00050)
package /RB/PT/PCFG_ECU
  system MDG1_EXTR: category=ECU_EXTRACT
    system mapping SYSMPG_MDG1
      sw-impl-mappings:
        swc to impl mapping SwcToImplMapping_ATS_Std: component-implementation=Impl_ATS_Std, component=CPT_MDG1_FlatView.CPT_ATS_Std
      sw-mappings:
        swc to ecu mapping SwcToEcuMapping_MSR2AR: component=CPT_MDG1_FlatView.CPT_ATS_Std, ecu-instance=MDG1
