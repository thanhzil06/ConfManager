AUTOSAR XML (schema 4-3-0)
package /RB/UBK/Project/EcucModuleConfigurationValuess
  module config EcuC
    EcucPartitionCollection
      4 x EcucPartition:
        EcucPartition_OsApp_A: EcucPartitionSoftwareComponentInstanceRef=Comp_A1, EcucPartitionSoftwareComponentInstanceRef=Comp_A3, EcucPartitionSoftwareComponentInstanceRef=Comp_A4
        EcucPartition_OsApp_B: EcucPartitionSoftwareComponentInstanceRef=Comp_B1, EcucPartitionSoftwareComponentInstanceRef=Comp_B3, EcucPartitionSoftwareComponentInstanceRef=Comp_B4
        EcucPartition_OsApp_C: EcucPartitionSoftwareComponentInstanceRef=Comp_C2, EcucPartitionSoftwareComponentInstanceRef=Comp_C4, EcucPartitionSoftwareComponentInstanceRef=Comp_C5, EcucPartitionSoftwareComponentInstanceRef=Comp_C6
        EcucPartition_OsApp_D: EcucPartitionSoftwareComponentInstanceRef=Comp_D2, EcucPartitionSoftwareComponentInstanceRef=Comp_D4, EcucPartitionSoftwareComponentInstanceRef=Comp_D5, EcucPartitionSoftwareComponentInstanceRef=Comp_D6
