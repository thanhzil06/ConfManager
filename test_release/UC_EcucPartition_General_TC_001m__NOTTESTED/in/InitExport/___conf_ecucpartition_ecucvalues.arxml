AUTOSAR XML (schema 4-0-2)
package /RB/UBK/Project/EcucModuleConfigurationValuess
  module config EcuC
    EcucPartitionCollection
      EcucPartition_OsApp_A (EcucPartition)
